## soc/hpmicro/Kconfig.soc
```kconfig
# Copyright (c) 2026 The HPM Zephyr Module Contributors
# SPDX-License-Identifier: Apache-2.0

config SOC_FAMILY_HPM
	bool

config SOC_FAMILY
	default "hpmicro" if SOC_FAMILY_HPM

rsource "HPM5300/Kconfig.soc"
```

## soc/hpmicro/hpm5300/Kconfig
```kconfig
# Copyright (c) 2026 The HPM Zephyr Module Contributors
# SPDX-License-Identifier: Apache-2.0

config SOC_SERIES_HPM5300
	select RISCV
	select RISCV_PRIVILEGED
	select RISCV_HAS_PLIC
	select RISCV_SOC_HAS_GP_RELATIVE_ADDRESSING
	select DYNAMIC_INTERRUPTS

config SOC_HPM5361
	select ATOMIC_OPERATIONS_C
	select INCLUDE_RESET_VECTOR
	select RISCV_ISA_EXT_M
	select RISCV_ISA_EXT_A
	select RISCV_ISA_EXT_C
	select RISCV_ISA_EXT_ZICSR
	select RISCV_ISA_EXT_ZIFENCEI
	select CPU_HAS_DCACHE
	select CPU_HAS_ICACHE
	select ARCH_HAS_NOCACHE_MEMORY_SUPPORT
	select RISCV_PMP if !MCUBOOT
	select USE_HPMSDK_PCFG
	select USE_HPMSDK_PLLCTLV2
	help
	  HPM5361 single-core RISC-V MCU. The CPU has no programmable PMA.
	  Uncached sections use the fixed data local memory (DLM), as in the
	  vendor linker scripts; no memory attribute CSRs need programming.
```

## soc/hpmicro/hpm5300/Kconfig.defconfig
```kconfig
# Copyright (c) 2026 The HPM Zephyr Module Contributors
# SPDX-License-Identifier: Apache-2.0

rsource "Kconfig.defconfig.series"
rsource "Kconfig.defconfig.HPM5361"
```

## soc/hpmicro/hpm5300/Kconfig.soc
```kconfig
# Copyright (c) 2026 The HPM Zephyr Module Contributors
# SPDX-License-Identifier: Apache-2.0

config SOC_SERIES_HPM5300
	bool
	select SOC_FAMILY_HPM
	select HAS_HPMSDK_PLLCTLV2
	select HAS_HPMSDK_PCFG
	select HAS_HPMSDK_MCHTMR

config SOC_SERIES
	default "hpm5300" if SOC_SERIES_HPM5300

config SOC_HPM5361
	bool
	select SOC_SERIES_HPM5300

config SOC
	default "hpm5361" if SOC_HPM5361
```

## tests/hardware/testcase.yaml
```yaml
# SPDX-License-Identifier: Apache-2.0

common:
  tags:
    - hpmicro
    - hardware
  platform_allow:
    - hpm5300evk/hpm5361
  harness: ztest
  timeout: 90
  integration_platforms:
    - hpm5300evk/hpm5361
tests:
  hpmicro.hardware.core:
    extra_args:
      - EXTRA_CONF_FILE=profiles/core.conf
      - DTC_OVERLAY_FILE=profiles/core.overlay
    harness_config:
      fixture: hpm5300evk
  hpmicro.hardware.dma:
    extra_args:
      - EXTRA_CONF_FILE=profiles/dma.conf
      - DTC_OVERLAY_FILE=profiles/dma.overlay
    harness_config:
      fixture: hpm5300evk

  hpmicro.hardware.crypto:
    extra_args:
      - EXTRA_CONF_FILE=profiles/crypto.conf
      - DTC_OVERLAY_FILE=profiles/crypto.overlay
    harness_config:
      fixture: hpm5300evk
  hpmicro.hardware.flash:
    extra_args:
      - EXTRA_CONF_FILE=profiles/flash.conf
      - DTC_OVERLAY_FILE=profiles/flash.overlay
    harness_config:
      fixture: hpm_flash_scratch
  hpmicro.hardware.watchdog:
    extra_args:
      - EXTRA_CONF_FILE=profiles/watchdog.conf
      - DTC_OVERLAY_FILE=profiles/watchdog.overlay
    harness_config:
      fixture: hpm5300evk
  hpmicro.hardware.can:
    extra_args:
      - EXTRA_CONF_FILE=profiles/can.conf
      - DTC_OVERLAY_FILE=profiles/can.overlay
    harness_config:
      fixture: hpm5300evk
  hpmicro.hardware.motor:
    extra_args:
      - EXTRA_CONF_FILE=profiles/motor.conf
      - DTC_OVERLAY_FILE=profiles/motor.overlay
    harness_config:
      fixture: hpm5300evk
  hpmicro.hardware.gpio:
    extra_args:
      - EXTRA_CONF_FILE=profiles/gpio.conf
      - DTC_OVERLAY_FILE=profiles/gpio.overlay
    harness_config:
      fixture: hpm_gpio_loop
  hpmicro.hardware.uart:
    extra_args:
      - EXTRA_CONF_FILE=profiles/uart.conf
      - DTC_OVERLAY_FILE=profiles/uart.overlay
    harness_config:
      fixture: hpm_uart_loop
  hpmicro.hardware.i2c:
    extra_args:
      - EXTRA_CONF_FILE=profiles/i2c.conf
      - DTC_OVERLAY_FILE=profiles/i2c.overlay
    harness_config:
      fixture: hpm_i2c_pair
  hpmicro.hardware.spi:
    extra_args:
      - EXTRA_CONF_FILE=profiles/spi.conf
      - DTC_OVERLAY_FILE=profiles/spi.overlay
    harness_config:
      fixture: hpm_spi_loop
  hpmicro.hardware.analog:
    extra_args:
      - EXTRA_CONF_FILE=profiles/analog.conf
      - DTC_OVERLAY_FILE=profiles/analog.overlay
    harness_config:
      fixture: hpm_analog_loop
  hpmicro.hardware.front_end:
    extra_args:
      - EXTRA_CONF_FILE=profiles/front_end.conf
      - DTC_OVERLAY_FILE=profiles/front_end.overlay
    harness_config:
      fixture: hpm_front_end_loop
  hpmicro.hardware.pwm:
    extra_args:
      - EXTRA_CONF_FILE=profiles/pwm.conf
      - DTC_OVERLAY_FILE=profiles/pwm.overlay
    harness_config:
      fixture: hpm_pwm_loop
```

## tests/hpm5300evk/testcase.yaml
```yaml
# Copyright (c) 2026 The HPM Zephyr Module Contributors
# SPDX-License-Identifier: Apache-2.0

tests:
  boards.hpmicro.hpm5300evk.smoke:
    tags:
      - hpmicro
      - smoke
    platform_allow:
      - hpm5300evk/hpm5361
      - hpm5361icb/hpm5361
    build_only: true
    integration_platforms:
      - hpm5300evk
      - hpm5361icb

  boards.hpmicro.hpm5361icb.all_hal:
    tags:
      - hpmicro
      - smoke
      - hal
    platform_allow:
      - hpm5361icb/hpm5361
    build_only: true
    integration_platforms:
      - hpm5361icb
    extra_args: CONFIG_HPM_SDK_BUILD_ALL_DRIVERS=y

  boards.hpmicro.hpm5300evk.peripherals:
    tags:
      - hpmicro
      - drivers
    platform_allow:
      - hpm5300evk/hpm5361
    build_only: true
    extra_args:
      - EXTRA_DTC_OVERLAY_FILE=peripherals.overlay
      - EXTRA_CONF_FILE=peripherals.conf

  boards.hpmicro.hpm5300evk.otp_control:
    tags:
      - hpmicro
      - drivers
      - otp
    platform_allow:
      - hpm5300evk/hpm5361
    build_only: true
    extra_args:
      - EXTRA_DTC_OVERLAY_FILE=peripherals.overlay
      - EXTRA_CONF_FILE=peripherals.conf
      - EXTRA_CONF_FILE=otp_control.conf

  boards.hpmicro.hpm5300evk.spi_async:
    tags:
      - hpmicro
      - drivers
      - spi
    platform_allow:
      - hpm5300evk/hpm5361
    build_only: true
    extra_args:
      - EXTRA_DTC_OVERLAY_FILE=peripherals.overlay
      - EXTRA_CONF_FILE=peripherals.conf
      - EXTRA_CONF_FILE=spi_async.conf

  boards.hpmicro.hpm5300evk.uart_async:
    tags:
      - hpmicro
      - drivers
      - uart
    platform_allow:
      - hpm5300evk/hpm5361
      - hpm5361icb/hpm5361
    build_only: true
    extra_args:
      - EXTRA_DTC_OVERLAY_FILE=peripherals.overlay
      - EXTRA_CONF_FILE=peripherals.conf
      - EXTRA_CONF_FILE=uart_async.conf

  boards.hpmicro.hpm5300evk.adc_polling:
    tags:
      - hpmicro
      - drivers
      - adc
    platform_allow:
      - hpm5300evk/hpm5361
    build_only: true
    extra_args:
      - EXTRA_DTC_OVERLAY_FILE=peripherals.overlay
      - EXTRA_CONF_FILE=peripherals.conf
      - EXTRA_CONF_FILE=adc_polling.conf

  boards.hpmicro.hpm5300evk.sei_without_synt:
    tags:
      - hpmicro
      - drivers
    platform_allow:
      - hpm5300evk/hpm5361
    build_only: true
    extra_args:
      - EXTRA_DTC_OVERLAY_FILE=sei_no_synt.overlay
      - EXTRA_CONF_FILE=sei_no_synt.conf

  boards.hpmicro.hpm5300evk.usb_device:
    tags:
      - hpmicro
      - usb
    platform_allow:
      - hpm5300evk/hpm5361
      - hpm5361icb/hpm5361
    build_only: true
    extra_args:
      - EXTRA_DTC_OVERLAY_FILE=usb_device.overlay
      - EXTRA_CONF_FILE=usb_device.conf

  boards.hpmicro.hpm5300evk.usb_host:
    tags:
      - hpmicro
      - usb
    platform_allow:
      - hpm5300evk/hpm5361
      - hpm5361icb/hpm5361
    build_only: true
    extra_args:
      - EXTRA_DTC_OVERLAY_FILE=usb_host.overlay
      - EXTRA_CONF_FILE=usb_host.conf

  boards.hpmicro.hpm5300evk.crypto:
    tags:
      - hpmicro
      - crypto
    platform_allow:
      - hpm5300evk/hpm5361
      - hpm5361icb/hpm5361
    build_only: true
    extra_args:
      - EXTRA_DTC_OVERLAY_FILE=crypto.overlay
      - EXTRA_CONF_FILE=crypto.conf

  boards.hpmicro.hpm5300evk.crypto_xip:
    tags:
      - hpmicro
      - crypto
    platform_allow:
      - hpm5300evk/hpm5361
      - hpm5361icb/hpm5361
    build_only: true
    extra_args:
      - EXTRA_DTC_OVERLAY_FILE=crypto.overlay
      - EXTRA_CONF_FILE=crypto.conf
      - EXTRA_CONF_FILE=crypto_xip.conf
```

## tests/motor_math/testcase.yaml
```yaml
# Copyright (c) 2026 The HPM Zephyr Module Contributors
# SPDX-License-Identifier: Apache-2.0

tests:
  hpm-zephyr.motor.math:
    tags:
      - hpmicro
      - motor
    platform_allow:
      - native_sim
    integration_platforms:
      - native_sim
```
