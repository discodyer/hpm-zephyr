## Kconfig.hpm
```kconfig
# Copyright (c) 2026 The HPM Zephyr Module Contributors
# SPDX-License-Identifier: Apache-2.0

rsource "modules/hpm_sdk/Kconfig"
rsource "drivers/Kconfig"
```

## boards/hpmicro/hpm5300evk/Kconfig
```kconfig
# Copyright (c) 2026 The HPM Zephyr Module Contributors
# SPDX-License-Identifier: Apache-2.0

if BOARD_HPM5300EVK

config HPMICRO_BOARD_SUPPORT_EMMC
	bool "Enable eMMC support"
	help
	  Enable board-level eMMC support.

endif # BOARD_HPM5300EVK
```

## boards/hpmicro/hpm5300evk/Kconfig.defconfig
```kconfig
# Copyright (c) 2026 The HPM Zephyr Module Contributors
# SPDX-License-Identifier: Apache-2.0

if BOARD_HPM5300EVK

config BUILD_OUTPUT_HEX
	default y if XIP

config HEAP_MEM_POOL_SIZE
	default 16384

config UART_INTERRUPT_DRIVEN
	default y

endif # BOARD_HPM5300EVK
```

## boards/hpmicro/hpm5300evk/Kconfig.hpm5300evk
```kconfig
# Copyright (c) 2026 The HPM Zephyr Module Contributors
# SPDX-License-Identifier: Apache-2.0

config BOARD_HPM5300EVK
	bool
	select SOC_HPM5361
```

## boards/hpmicro/hpm5300evk/board.yml
```yaml
# Copyright (c) 2026 The HPM Zephyr Module Contributors
# SPDX-License-Identifier: Apache-2.0

board:
  name: hpm5300evk
  full_name: HPMicro HPM5300EVK
  vendor: hpmicro
  socs:
    - name: hpm5361
```

## boards/hpmicro/hpm5300evk/hpm5300evk_defconfig
```kconfig
CONFIG_CONSOLE=y
CONFIG_SERIAL=y
CONFIG_UART_CONSOLE=y
CONFIG_PINCTRL=y
CONFIG_GPIO=y
CONFIG_XIP=y
```

## boards/hpmicro/hpm5361icb/Kconfig.defconfig
```kconfig
# Copyright (c) 2026 The HPM Zephyr Module Contributors
# SPDX-License-Identifier: Apache-2.0

if BOARD_HPM5361ICB

config BUILD_OUTPUT_HEX
	default y if XIP

config HEAP_MEM_POOL_SIZE
	default 8192

config UART_INTERRUPT_DRIVEN
	default y

endif # BOARD_HPM5361ICB
```

## boards/hpmicro/hpm5361icb/Kconfig.hpm5361icb
```kconfig
# Copyright (c) 2026 The HPM Zephyr Module Contributors
# SPDX-License-Identifier: Apache-2.0

config BOARD_HPM5361ICB
	bool
	select SOC_HPM5361
```

## boards/hpmicro/hpm5361icb/board.yml
```yaml
# Copyright (c) 2026 The HPM Zephyr Module Contributors
# SPDX-License-Identifier: Apache-2.0

board:
  name: hpm5361icb
  full_name: HPMicro HPM5361 ICB
  vendor: hpmicro
  socs:
    - name: hpm5361
```

## boards/hpmicro/hpm5361icb/hpm5361icb_defconfig
```kconfig
CONFIG_CONSOLE=y
CONFIG_SERIAL=y
CONFIG_UART_CONSOLE=y
CONFIG_PINCTRL=y
CONFIG_GPIO=y
CONFIG_FLASH=y
CONFIG_XIP=y
CONFIG_USE_DT_CODE_PARTITION=y
```

## drivers/Kconfig
```kconfig
# Copyright (c) 2026 The HPM Zephyr Module Contributors
# SPDX-License-Identifier: Apache-2.0

rsource "clock_control/Kconfig.hpmicro"
rsource "pinctrl/Kconfig.hpmicro"
rsource "serial/Kconfig.hpmicro"
rsource "gpio/Kconfig.hpmicro"
rsource "gpiom/Kconfig.hpmicro"
rsource "flash/Kconfig.hpmicro"
rsource "dma/Kconfig.hpmicro"
rsource "i2c/Kconfig.hpmicro"
rsource "spi/Kconfig.hpmicro"
rsource "watchdog/Kconfig.hpmicro"
rsource "counter/Kconfig.hpmicro"
rsource "pwm/Kconfig.hpmicro"
rsource "can/Kconfig.hpmicro"
rsource "mbox/Kconfig.hpmicro"
rsource "adc/Kconfig.hpmicro"
rsource "dac/Kconfig.hpmicro"
rsource "comparator/Kconfig.hpmicro"
rsource "opamp/Kconfig.hpmicro"
rsource "entropy/Kconfig.hpmicro"
rsource "crc/Kconfig.hpmicro"
rsource "ptp_clock/Kconfig.hpmicro"
rsource "otp/Kconfig.hpmicro"
rsource "sensor/hpmicro/Kconfig"
rsource "motor/Kconfig.hpmicro"
rsource "mux/Kconfig.hpmicro"
rsource "usb/udc/Kconfig.hpmicro"
rsource "crypto/Kconfig.hpmicro"
```

## drivers/adc/Kconfig.hpmicro
```kconfig
# Copyright (c) 2026 The HPM Zephyr Module Contributors
# SPDX-License-Identifier: Apache-2.0

DT_COMPAT_HPM_ADC16 := hpmicro,hpm-adc16

config ADC_HPMICRO_ADC16
	bool "HPMicro ADC16 driver"
	default y
	depends on ADC
	depends on DT_HAS_HPMICRO_HPM_ADC16_ENABLED
	depends on HAS_HPMSDK_ADC16
	select USE_HPMSDK_ADC16
	help

	  Enable the HPMicro ADC16 driver. When the selected SoC supports
	  non-cacheable memory, the driver uses the ADC internal sequence DMA
	  engine and the sequence-complete interrupt for hardware-driven reads.

if ADC_HPMICRO_ADC16

config ADC_HPMICRO_ADC16_SEQUENCE_DMA
	bool "Use ADC16 internal sequence DMA"
	default y
	depends on ARCH_HAS_NOCACHE_MEMORY_SUPPORT
	select NOCACHE_MEMORY
	help
	  Use ADC16 sequence mode with its internal DMA engine, writing packed
	  conversion records to non-cacheable memory and completing through the
	  ADC interrupt. Disable to use the oneshot polling fallback.

config ADC_HPMICRO_ADC16_SEQUENCE_TIMEOUT_MS
	int "ADC16 sequence completion timeout"
	depends on ADC_HPMICRO_ADC16_SEQUENCE_DMA
	default 1000
	range 1 60000
	help
	  Maximum time to wait for a synchronous sequence conversion.

endif # ADC_HPMICRO_ADC16
```

## drivers/can/Kconfig.hpmicro
```kconfig
# Copyright (c) 2026 The HPM Zephyr Module Contributors
# SPDX-License-Identifier: Apache-2.0

DT_COMPAT_HPM_MCAN := hpmicro,hpm-mcan

config CAN_HPMICRO
	bool "HPMicro MCAN CAN-FD driver"
	depends on CAN
	default y
	depends on DT_HAS_HPMICRO_HPM_MCAN_ENABLED
	depends on HAS_HPMSDK_MCAN
	select CAN_MCAN
	select CAN_RX_TIMESTAMP
	select PINCTRL
	help
	  Enable the HPMicro MCAN driver using the generic Bosch M_CAN backend.
	  The HPM extension configures the M_CAN timestamping unit and supports
	  selecting PTPC0 or PTPC1 as its external timebase. Enabling this driver
	  also enables the generic CAN receive timestamp field, which carries a
	  TSU slot reference while external TSU timestamping is active.
```

## drivers/clock_control/Kconfig.hpmicro
```kconfig
# Copyright (c) 2026 The HPM Zephyr Module Contributors
# SPDX-License-Identifier: Apache-2.0

config CLOCK_CONTROL_HPMICRO
	bool "HPMicro clock control driver"
	default y
	depends on DT_HAS_HPMICRO_HPM_PLLV2_ENABLED
	depends on HAS_HPMSDK_PLLCTLV2
	select CLOCK_CONTROL
	select USE_HPMSDK_PLLCTLV2
	help
	  Enable the HPMicro clock controller driver.
```

## drivers/comparator/Kconfig.hpmicro
```kconfig
# Copyright (c) 2026 The HPM Zephyr Module Contributors
# SPDX-License-Identifier: Apache-2.0

DT_COMPAT_HPM_ACMP_COMP := hpmicro,hpm-acmp-comp

config COMPARATOR_HPMICRO_ACMP
	bool "HPMicro ACMP driver"
	default y
	depends on COMPARATOR
	depends on CLOCK_CONTROL
	depends on DT_HAS_HPMICRO_HPM_ACMP_COMP_ENABLED
	depends on HAS_HPMSDK_ACMP
	select PINCTRL
	select USE_HPMSDK_ACMP
	help
	  Enable the HPMicro analog comparator driver. Each enabled child node
	  represents one comparator channel sharing the ACMP register block.
```

## drivers/counter/Kconfig.hpmicro
```kconfig
# Copyright (c) 2026 The HPM Zephyr Module Contributors
# SPDX-License-Identifier: Apache-2.0

DT_COMPAT_HPM_GPTMR := hpmicro,hpm-gptmr

config COUNTER_HPMICRO
	bool "HPMicro GPTMR/PTMR counter driver"
	depends on COUNTER
	default y
	depends on DT_HAS_HPMICRO_HPM_GPTMR_ENABLED
	depends on HAS_HPMSDK_GPTMR
	select USE_HPMSDK_GPTMR
	help
	  Enable the HPMicro general-purpose and power timer counter driver.
```

## drivers/crc/Kconfig.hpmicro
```kconfig
# Copyright (c) 2026 The HPM Zephyr Module Contributors
# SPDX-License-Identifier: Apache-2.0

DT_COMPAT_HPM_CRC := hpmicro,hpm-crc

config CRC_HPMICRO
	bool "HPMicro CRC accelerator driver"
	default y
	depends on CRC_DRIVER
	depends on CLOCK_CONTROL
	depends on DT_HAS_HPMICRO_HPM_CRC_ENABLED
	depends on HAS_HPMSDK_CRC
	select USE_HPMSDK_CRC
	select CRC_DRIVER_HAS_CRC8
	select CRC_DRIVER_HAS_CRC8_CCITT
	select CRC_DRIVER_HAS_CRC8_ROHC
	select CRC_DRIVER_HAS_CRC16
	select CRC_DRIVER_HAS_CRC16_CCITT
	select CRC_DRIVER_HAS_CRC16_ITU_T
	select CRC_DRIVER_HAS_CRC16_REFLECT
	select CRC_DRIVER_HAS_CRC16_ANSI
	select CRC_DRIVER_HAS_CRC32_C
	select CRC_DRIVER_HAS_CRC32_IEEE
	select CRC_DRIVER_HAS_CRC32_MPEG2
	help
	  Enable the HPMicro multi-channel CRC accelerator driver.
```

## drivers/crypto/Kconfig.hpmicro
```kconfig
# Copyright (c) 2026 The HPM Zephyr Module Contributors
# SPDX-License-Identifier: Apache-2.0

DT_COMPAT_HPM_SDP := hpmicro,hpm-sdp

config CRYPTO_HPMICRO
	bool "HPMicro SDP crypto accelerator driver"
	default y
	depends on CRYPTO
	depends on CLOCK_CONTROL
	depends on DT_HAS_HPMICRO_HPM_SDP_ENABLED
	depends on HAS_HPMSDK_SDP
	depends on ARCH_HAS_NOCACHE_MEMORY_SUPPORT
	select NOCACHE_MEMORY
	select USE_HPMSDK_SDP
	help
	  Zephyr crypto driver for the HPMicro secure data processor (SDP).
	  The driver exposes synchronous AES-128/256 ECB, CBC, CTR and CCM,
	  SHA-256, plus HPMicro-only SHA-1, CRC-32, SM3 and SM4 extensions
	  through direct HAL calls. CTR accepts 32- to 120-bit counters.

if CRYPTO_HPMICRO

config CRYPTO_HPMICRO_MAX_SESSIONS
	int "Maximum number of SDP crypto sessions"
	range 1 4
	default 2
	help
	  Number of concurrent cipher or hash sessions tracked by the driver.
	  Hardware operations themselves are serialized.

config CRYPTO_HPMICRO_BOUNCE_SIZE
	int "SDP DMA bounce buffer size"
	range 256 4096
	default 1024
	help
	  Size of each non-cacheable staging buffer used for SDP input and
	  output. Larger requests are processed in chunks. The buffers are
	  placed in the Zephyr nocache RAM region.

config CRYPTO_HPMICRO_TIMEOUT_US
	int "SDP operation timeout (microseconds)"
	range 1 60000000
	default 1000000
	help
	  Maximum time to wait for an SDP operation to complete. SDP HAL calls
	  are synchronous and poll the hardware status. A timeout prevents a
	  stalled or misconfigured controller from blocking the calling thread
	  indefinitely.

endif # CRYPTO_HPMICRO
```

## drivers/dac/Kconfig.hpmicro
```kconfig
# Copyright (c) 2026 The HPM Zephyr Module Contributors
# SPDX-License-Identifier: Apache-2.0

DT_COMPAT_HPM_DAC := hpmicro,hpm-dac

config DAC_HPMICRO
	bool "HPMicro DAC12 driver"
	default y
	depends on DAC
	depends on DT_HAS_HPMICRO_HPM_DAC_ENABLED
	depends on HAS_HPMSDK_DAC
	select USE_HPMSDK_DAC
	help
	  Enable the HPMicro 12-bit DAC driver. The standard DAC API exposes
	  direct mode. The HPMicro extension API also exposes the four step
	  generators, dual internal buffers, software/hardware triggers and
	  completion status flags.
```

## drivers/dma/Kconfig.hpmicro
```kconfig
# Copyright (c) 2026 The HPM Zephyr Module Contributors
# SPDX-License-Identifier: Apache-2.0

DT_COMPAT_HPM_DMA := hpmicro,hpm-dma

config DMA_HPMICRO
	bool "HPMicro HDMA/DMAMUX driver"
	default y
	depends on DMA
	depends on CLOCK_CONTROL
	depends on ARCH_HAS_NOCACHE_MEMORY_SUPPORT
	depends on DT_HAS_HPMICRO_HPM_DMA_ENABLED
	depends on HAS_HPMSDK_DMAV2
	depends on HAS_HPMSDK_DMAMUX
	select USE_HPMSDK_DMAV2
	select USE_HPMSDK_DMAMUX
	select NOCACHE_MEMORY
	help
	  Enable the HPMicro DMAV2 controller with its channel-coupled DMAMUX.
	  Memory-to-memory, memory-to-peripheral and peripheral-to-memory
	  transfers are supported. Multiple transfer blocks are connected with
	  hardware linked descriptors.

if DMA_HPMICRO

config DMA_HPMICRO_MAX_BLOCKS
	int "Maximum DMA transfer blocks per channel"
	range 1 256
	default 16
	help
	  Maximum number of blocks in one Zephyr dma_config() transfer list.
	  The driver allocates this many linked descriptors for every channel.
	  Each descriptor requires 32 bytes of non-cacheable RAM.

endif # DMA_HPMICRO
```

## drivers/entropy/Kconfig.hpmicro
```kconfig
# Copyright (c) 2026 The HPM Zephyr Module Contributors
# SPDX-License-Identifier: Apache-2.0

DT_COMPAT_HPM_RNG := hpmicro,hpm-rng

config ENTROPY_HPMICRO_RNG
	bool "HPMicro RNG entropy driver"
	default y
	depends on ENTROPY_GENERATOR
	depends on CLOCK_CONTROL
	depends on DT_HAS_HPMICRO_HPM_RNG_ENABLED
	depends on HAS_HPMSDK_RNG
	select ENTROPY_HAS_DRIVER
	select USE_HPMSDK_RNG
	help
	  Enable the HPMicro hardware true random number generator.
```

## drivers/flash/Kconfig.hpmicro
```kconfig
# Copyright (c) 2026 The HPM Zephyr Module Contributors
# SPDX-License-Identifier: Apache-2.0

DT_COMPAT_HPMICRO_XPI := hpmicro,xpi

config FLASH_HPMICRO
	bool "HPMicro XPI NOR flash driver"
	default y
	depends on FLASH
	depends on DT_HAS_HPMICRO_XPI_ENABLED
	select FLASH_HAS_DRIVER_ENABLED
	select FLASH_HAS_EXPLICIT_ERASE
	select FLASH_HAS_PAGE_LAYOUT
	help
	  Enable the HPMicro XPI NOR flash driver backed by the HPM SDK ROM APIs.
```

## drivers/gpio/Kconfig.hpmicro
```kconfig
# Copyright (c) 2026 The HPM Zephyr Module Contributors
# SPDX-License-Identifier: Apache-2.0

DT_COMPAT_HPMICRO_HPM_GPIO := hpmicro,hpm-gpio

config GPIO_HPMICRO
	bool "HPMicro GPIO driver"
	default y
	depends on DT_HAS_HPMICRO_HPM_GPIO_ENABLED
	depends on HAS_HPMSDK_GPIO
	select USE_HPMSDK_GPIO
	help
	  Enable the HPMicro GPIO driver.
```

## drivers/gpiom/Kconfig.hpmicro
```kconfig
# Copyright (c) 2026 The HPM Zephyr Module Contributors
# SPDX-License-Identifier: Apache-2.0

DT_COMPAT_HPM_GPIOM := hpmicro,hpm-gpiom

config GPIOM_HPMICRO
	bool "HPMicro GPIO manager driver"
	default y
	depends on DT_HAS_HPMICRO_HPM_GPIOM_ENABLED
	depends on HAS_HPMSDK_GPIOM
	select USE_HPMSDK_GPIOM
	help
	  Enable the HPMicro GPIO manager. It assigns each GPIO pin to GPIO0 or
	  FGPIO0, controls input visibility and provides irreversible pin locks.

if GPIOM_HPMICRO

config GPIOM_HPMICRO_INIT_PRIORITY
	int "HPMicro GPIO manager init priority"
	default 40
	help
	  Initialization priority for the HPMicro GPIO manager. It must run
	  before GPIO consumers that configure GPIOM-owned pins.

endif # GPIOM_HPMICRO
```

## drivers/hwinfo/Kconfig.hpmicro
```kconfig
# Copyright (c) 2026 The HPM Zephyr Module Contributors
# SPDX-License-Identifier: Apache-2.0

DT_COMPAT_HPM_HWINFO := hpmicro,hpm-hwinfo

config HWINFO_HPMICRO
	bool "HPMicro hardware information driver"
	default y
	depends on HWINFO
	depends on DT_HAS_HPMICRO_HPM_HWINFO_ENABLED
	depends on HAS_HPMSDK_PPOR
	depends on HAS_HPMSDK_OTP
	select HWINFO_HAS_DRIVER
	help
	  Enable HPMicro hardware information reporting. PPOR supplies the
	  reset-cause flags and the factory-programmed OTP UUID supplies the
	  128-bit device identifier. The driver never programs or locks OTP.
```
