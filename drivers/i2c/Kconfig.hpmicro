## drivers/i2c/Kconfig.hpmicro
```kconfig
# Copyright (c) 2026 The HPM Zephyr Module Contributors
# SPDX-License-Identifier: Apache-2.0

DT_COMPAT_HPMICRO_HPM_I2C := hpmicro,hpm-i2c

config I2C_HPMICRO
	bool "HPMicro I2C driver"
	default y
	depends on I2C
	depends on DT_HAS_HPMICRO_HPM_I2C_ENABLED
	depends on HAS_HPMSDK_I2C
	select USE_HPMSDK_I2C
	help
	  Enable the HPMicro I2C controller driver.

if I2C_HPMICRO

config I2C_HPMICRO_DMA
	bool "Use DMA for controller transfers"
	default y if DT_HAS_HPMICRO_HPM_DMA_ENABLED
	select DMA
	help
	  Use DMA for controller-mode data phases when the I2C node has a
	  matching DMA channel. The I2C controller still owns address and
	  start/stop phases. Disable to use the polling path.

config I2C_HPMICRO_DMA_TIMEOUT_MS
	int "I2C DMA transaction timeout"
	depends on I2C_HPMICRO_DMA
	default 1000
	range 1 60000
	help
	  Maximum time to wait for the DMA channel and I2C transaction-complete
	  interrupt during a controller-mode transfer.

endif # I2C_HPMICRO
```

## drivers/lin/Kconfig.hpmicro
```kconfig
# Copyright (c) 2026 The HPM Zephyr Module Contributors
# SPDX-License-Identifier: Apache-2.0

DT_COMPAT_HPM_UART_LIN := hpmicro,hpm-uart-lin

config LIN_HPMICRO
	bool "HPMicro UART-based LIN driver"
	default y
	depends on LIN
	depends on DT_HAS_HPMICRO_HPM_UART_LIN_ENABLED
	depends on HAS_HPMSDK_UART
	depends on GPIO
	depends on PINCTRL
	select USE_HPMSDK_UART
	help
	  Enable the HPMicro LIN controller implemented with an HPM UART and
	  GPIO-controlled break generation.
```

## drivers/mbox/Kconfig.hpmicro
```kconfig
# Copyright (c) 2026 The HPM Zephyr Module Contributors
# SPDX-License-Identifier: Apache-2.0

DT_COMPAT_HPM_MBX := hpmicro,hpm-mbx

config MBOX_HPMICRO
	bool "HPMicro MBX mailbox driver"
	default y
	depends on MBOX
	depends on CLOCK_CONTROL
	depends on DT_HAS_HPMICRO_HPM_MBX_ENABLED
	depends on HAS_HPMSDK_MBX
	select USE_HPMSDK_MBX
	help
	  Enable the HPMicro inter-core mailbox driver. Each MBX endpoint is
	  exposed as one Zephyr mailbox channel for the single-word register
	  path. The separate four-word FIFO path is not exposed.
```

## drivers/motor/Kconfig.hpmicro
```kconfig
# Copyright (c) 2026 The HPM Zephyr Module Contributors
# SPDX-License-Identifier: Apache-2.0

DT_COMPAT_HPM_QEO := hpmicro,hpm-qeo

config QEO_HPMICRO
	bool "HPMicro QEO encoder output driver"
	default y
	depends on CLOCK_CONTROL
	depends on DT_HAS_HPMICRO_HPM_QEO_ENABLED
	depends on HAS_HPMSDK_QEO
	select USE_HPMSDK_QEO
	help
	  Enable the HPMicro quadrature encoder output driver. The driver supports
	  ABZ output, three-channel WAVE output, PWM FORCE phase tables, PWM
	  safety mode, software position injection and internal position readback.
	  Position routing through TRGM/MMC is not included.

DT_COMPAT_HPM_SEI := hpmicro,hpm-sei

config SEI_HPMICRO
	bool "HPMicro serial encoder interface driver"
	default y
	depends on CLOCK_CONTROL
	depends on DT_HAS_HPMICRO_HPM_SEI_ENABLED
	depends on HAS_HPMSDK_SEI
	select USE_HPMSDK_SEI
	help
	  Enable the HPMicro serial encoder interface. This is a protocol-neutral
	  execution layer for transceiver, instruction, latch, SAMPLE/UPDATE,
	  engine, trigger and interrupt configuration. Encoder protocols are
	  implemented by consumers.

DT_COMPAT_HPM_MMC := hpmicro,hpm-mmc

config MMC_HPMICRO
	bool "HPMicro motion processing unit driver"
	default y
	depends on CLOCK_CONTROL
	depends on DT_HAS_HPMICRO_HPM_MMC_ENABLED
	depends on HAS_HPMSDK_MMC
	select USE_HPMSDK_MMC
	help
	  Enable the HPMicro motion processing unit. The driver exposes track and
	  predictor configuration, position and trigger inputs, result/status
	  access, module control and shared-IRQ event callbacks for the track and
	  both predictors. TRGM position routing remains the consumer's
	  responsibility.

DT_COMPAT_HPM_RDC := hpmicro,hpm-rdc

config RDC_HPMICRO
	bool "HPMicro resolver-to-digital converter driver"
	default y
	depends on CLOCK_CONTROL
	depends on DT_HAS_HPMICRO_HPM_RDC_ENABLED
	depends on HAS_HPMSDK_RDC
	select USE_HPMSDK_RDC
	help
	  Enable the HPMicro resolver-to-digital converter. The driver covers
	  excitation output, I/Q accumulation input, accumulation filtering,
	  trigger output, result access, integer-CORDIC phase calculation and
	  W1C interrupt event handling. TRGM or DAC routing remains the
	  consumer's responsibility.

DT_COMPAT_HPM_SYNT := hpmicro,hpm-synt

config SYNT_HPMICRO
	bool "HPMicro synchronization timer driver"
	default y
	depends on CLOCK_CONTROL
	depends on DT_HAS_HPMICRO_HPM_SYNT_ENABLED
	depends on HAS_HPMSDK_SYNT
	select USE_HPMSDK_SYNT
	help
	  Enable the HPMicro synchronization timer. It provides the motor-system
	  synchronization counter, comparator events and the shared timestamp.

DT_COMPAT_HPM_PLB := hpmicro,hpm-plb

config PLB_HPMICRO
	bool "HPMicro programmable logic block driver"
	default y
	depends on CLOCK_CONTROL
	depends on DT_HAS_HPMICRO_HPM_PLB_ENABLED
	depends on HAS_HPMSDK_PLB
	select USE_HPMSDK_PLB
	help
	  Enable the HPMicro programmable logic block. The driver exposes the
	  TYPE_A truth tables and TYPE_B slice, comparator and counter primitives;
	  SDK PLB filter and encoder components are not built.
```

## drivers/mux/Kconfig.hpmicro
```kconfig
# Copyright (c) 2026 The HPM Zephyr Module Contributors
# SPDX-License-Identifier: Apache-2.0

DT_COMPAT_HPM_TRGM := hpmicro,hpm-trgm

config MUX_HPMICRO_TRGM
	bool "HPMicro TRGM trigger routing driver"
	default y
	depends on MUX
	depends on CLOCK_CONTROL
	depends on DT_HAS_HPMICRO_HPM_TRGM_ENABLED
	depends on HAS_HPMSDK_TRGM
	select USE_HPMSDK_TRGM
	help
	  Enable the HPMicro TRGM driver as a Zephyr mux controller. Each
	  mux control selects one TRGM output; the mux state selects the TRGM
	  input source using the HPM_TRGM0_INPUT_SRC_* values from the SDK.
	  The HPM-specific extension also provides input filtering, output
	  polarity and edge-pulse conversion, DMA request routing, and the
	  ADC, DAC and position routing matrices. Named motor-control routes
	  connect SYNT, MMC, SEI, RDC, QEO and PLB without duplicating TRGM
	  output indices in those drivers.
```

## drivers/opamp/Kconfig.hpmicro
```kconfig
# Copyright (c) 2026 The HPM Zephyr Module Contributors
# SPDX-License-Identifier: Apache-2.0

DT_COMPAT_HPM_OPAMP := hpmicro,hpm-opamp

config OPAMP_HPMICRO
	bool "HPMicro OPAMP driver"
	default y
	depends on OPAMP
	depends on CLOCK_CONTROL
	depends on DT_HAS_HPMICRO_HPM_OPAMP_ENABLED
	depends on HAS_HPMSDK_OPAMP
	select PINCTRL
	select USE_HPMSDK_OPAMP
	help
	  Enable the HPMicro operational amplifier driver.

config OPAMP_HPMICRO_PROGRAMMABLE_GAIN
	bool "Enable runtime HPMicro OPAMP gain changes"
	depends on OPAMP_HPMICRO
	help
	  Expose opamp_set_gain() for HPMicro OPAMP instances. Gain changes are
	  applied to the direct configuration register and are only appropriate
	  for inverting or non-inverting amplification modes.
```

## drivers/otp/Kconfig.hpmicro
```kconfig
# Copyright (c) 2026 The HPM Zephyr Module Contributors
# SPDX-License-Identifier: Apache-2.0

DT_COMPAT_HPM_OTP := hpmicro,hpm-otp

config OTP_HPMICRO
	bool "HPMicro OTP controller driver"
	default y
	depends on OTP
	depends on DT_HAS_HPMICRO_HPM_OTP_ENABLED
	depends on HAS_HPMSDK_OTP
	select USE_HPMSDK_OTP
	help
	  Enable the HPMicro OTP controller driver. By default this driver is
	  read-only and accesses the fuse shadow registers. Enabling OTP_PROGRAM
	  additionally exposes irreversible fuse programming.

if OTP_HPMICRO

module = OTP_HPMICRO
module-str = OTP_HPMICRO
source "subsys/logging/Kconfig.template.log_config"

config OTP_HPMICRO_ALLOW_LOCK
	bool "Allow irreversible OTP lock operations"
	default n
	help
	  Expose the HPMicro fuse and shadow lock APIs. Lock settings can be
	  irreversible and may permanently disable fuse programming or reads.
	  Leave this disabled unless the product provisioning flow explicitly
	  requires it.

config OTP_HPMICRO_ALLOW_REGION_CONFIG
	bool "Allow configurable OTP region changes"
	default n
	help
	  Expose the ROM helper that redefines OTP region 3. Changing the region
	  can alter which fuse words are covered by provisioning and locks.

config OTP_HPMICRO_SIZE
	int "HPMicro OTP addressable bytes"
	default 512
	range 4 512
	help
	  Size of the HPM5361 OTP shadow array exposed through the Zephyr OTP
	  API. The hardware has 128 32-bit words.

endif # OTP_HPMICRO
```

## drivers/pinctrl/Kconfig.hpmicro
```kconfig
# Copyright (c) 2026 The HPM Zephyr Module Contributors
# SPDX-License-Identifier: Apache-2.0

DT_COMPAT_HPM_PINCTRL := hpmicro,hpm-pinctrl

config PINCTRL_HPMICRO
	bool "Pin controller driver for HPMicro MCUs"
	default y
	depends on DT_HAS_HPMICRO_HPM_PINCTRL_ENABLED
	depends on HAS_HPMSDK_IOC
	help
	  Enable the pin controller driver for HPMicro MCUs.
```

## drivers/power_domain/Kconfig.hpmicro
```kconfig
# Copyright (c) 2026 The HPM Zephyr Module Contributors
# Copyright (c) 2026 Cody Gu <gujiaqi@iscas.ac.cn>
# SPDX-License-Identifier: Apache-2.0

DT_COMPAT_HPM_POWER_DOMAIN := hpmicro,hpm-power-domain

config POWER_DOMAIN_HPMICRO
	bool "HPMicro SYSCTL power domain"
	default y
	depends on POWER_DOMAIN
	depends on SOC_SERIES_HPM5300
	depends on HAS_HPMSDK_SYSCTL
	depends on DT_HAS_HPMICRO_HPM_POWER_DOMAIN_ENABLED
	depends on PM_DEVICE
	depends on PM_DEVICE_POWER_DOMAIN
	select DEVICE_DEPS
	help
	  Enable power domains backed by HPMicro SYSCTL resources. Each domain
	  controls one removable peripheral resource with the RESOURCE[x].MODE
	  field. Boot-critical clocks, CPU and reset resources, XPI, watchdog
	  and other non-recoverable resources are excluded.

if POWER_DOMAIN_HPMICRO

config POWER_DOMAIN_HPMICRO_INIT_PRIORITY
	int "HPMicro SYSCTL power domain init priority"
	default POWER_DOMAIN_INIT_PRIORITY
	help
	  HPMicro SYSCTL power domain initialization priority.

config POWER_DOMAIN_HPMICRO_TIMEOUT_US
	int "HPMicro SYSCTL resource transition timeout"
	default 100000
	range 1 1000000
	help
	  Maximum time to wait for a SYSCTL resource transition to complete.

endif # POWER_DOMAIN_HPMICRO
```

## drivers/ptp_clock/Kconfig.hpmicro
```kconfig
# Copyright (c) 2026 The HPM Zephyr Module Contributors
# SPDX-License-Identifier: Apache-2.0

DT_COMPAT_HPM_PTPC := hpmicro,hpm-ptpc

config PTP_CLOCK_HPMICRO
	bool "HPMicro PTPC clock driver"
	default y
	depends on PTP_CLOCK
	depends on CLOCK_CONTROL
	depends on DT_HAS_HPMICRO_HPM_PTPC_ENABLED
	depends on HAS_HPMSDK_PTPC
	select USE_HPMSDK_PTPC
	select SHARED_INTERRUPTS
	help
	  Enable the HPMicro PTPC timestamp clock driver. Each enabled child
	  node represents one of the two independent timestamp counters. Both
	  channels share one hardware interrupt line, so shared interrupt support
	  is required when both children are enabled.

if PTP_CLOCK_HPMICRO

module = PTP_CLOCK_HPMICRO
module-str = PTP_CLOCK_HPMICRO
source "subsys/logging/Kconfig.template.log_config"

endif # PTP_CLOCK_HPMICRO
```

## drivers/pwm/Kconfig.hpmicro
```kconfig
# Copyright (c) 2026 The HPM Zephyr Module Contributors
# SPDX-License-Identifier: Apache-2.0

DT_COMPAT_HPM_PWM := hpmicro,hpm-pwm

config PWM_HPMICRO
	bool "HPMicro PWM driver"
	depends on PWM
	default y
	depends on DT_HAS_HPMICRO_HPM_PWM_ENABLED
	depends on HAS_HPMSDK_PWM
	select USE_HPMSDK_PWM
	help
	  Enable the HPMicro PWM driver. The standard PWM API provides basic
	  edge-aligned outputs. When PWM_CAPTURE is enabled, comparators configured
	  as capture inputs also support the standard Zephyr capture API using an
	  independent block with a free-running 28-bit counter. Capture cannot be
	  enabled on a block that has configured outputs during the current boot.
	  Measured periods must be shorter than one full 28-bit counter cycle.
	  The HPMicro extension API provides complementary outputs with dead-time
	  insertion, fault handling, and raw input-capture access.
```

## drivers/reset/Kconfig.hpmicro
```kconfig
# Copyright (c) 2026 The HPM Zephyr Module Contributors
# SPDX-License-Identifier: Apache-2.0

DT_COMPAT_HPM_SYSCTL := hpmicro,hpm-sysctl

config RESET_HPMICRO
	bool "HPMicro SYSCTL reset controller"
	default y
	depends on RESET
	depends on DT_HAS_HPMICRO_HPM_SYSCTL_ENABLED
	depends on HAS_HPMSDK_SYSCTL
	help
	  Enable the HPMicro SYSCTL reset controller. Only the SoC and CPU0
	  reset domains exposed by SYSCTL are supported. Asserting either domain
	  resets the running system and must not be used from ordinary tests.
```

## drivers/sensor/hpmicro/Kconfig
```kconfig
# Copyright (c) 2026 The HPM Zephyr Module Contributors
# SPDX-License-Identifier: Apache-2.0

DT_COMPAT_HPM_TSNS := hpmicro,hpm-tsns

config TSNS_HPMICRO
	bool "HPMicro TSNS die-temperature sensor driver"
	default y
	depends on SENSOR
	depends on CLOCK_CONTROL
	depends on DT_HAS_HPMICRO_HPM_TSNS_ENABLED
	depends on HAS_HPMSDK_TSNS
	select USE_HPMSDK_TSNS
	help
	  Enable the HPMicro on-chip temperature sensor driver.

config TSNS_HPMICRO_TIMEOUT_MS
	int "HPMicro TSNS sample timeout"
	default 100
	range 1 10000
	depends on TSNS_HPMICRO
	help
	  Maximum time to wait for a valid die-temperature sample.

rsource "Kconfig.qeiv2"
```

## drivers/sensor/hpmicro/Kconfig.qeiv2
```kconfig
# Copyright (c) 2026 The HPM Zephyr Module Contributors
# SPDX-License-Identifier: Apache-2.0

DT_COMPAT_HPM_QEIV2 := hpmicro,hpm-qeiv2

config QEIV2_HPMICRO
	bool "HPMicro QEIV2 quadrature encoder driver"
	default y
	depends on SENSOR
	depends on CLOCK_CONTROL
	depends on DT_HAS_HPMICRO_HPM_QEIV2_ENABLED
	depends on HAS_HPMSDK_QEIV2
	select USE_HPMSDK_QEIV2
	help
	  Enable the HPMicro QEIV2 quadrature encoder driver. It supports ABZ,
	  pulse/direction, up/down and UVW square-wave decoding through the sensor
	  API, plus HPM-specific speed-counter, comparator and event interfaces.
```

## drivers/serial/Kconfig.hpmicro
```kconfig
# Copyright (c) 2026 The HPM Zephyr Module Contributors
# SPDX-License-Identifier: Apache-2.0

DT_COMPAT_HPM_UART := hpmicro,hpm-uart

config UART_HPMICRO
	bool "HPMicro UART driver"
	default y
	depends on DT_HAS_HPMICRO_HPM_UART_ENABLED
	depends on HAS_HPMSDK_UART
	depends on PINCTRL
	select USE_HPMSDK_UART
	select SERIAL_HAS_DRIVER
	select SERIAL_SUPPORT_INTERRUPT
	select SERIAL_SUPPORT_ASYNC if DT_HAS_HPMICRO_HPM_DMA_ENABLED
	select DMA if UART_ASYNC_API
	help
	  Enable the HPMicro UART driver. DMA-backed asynchronous operation is
	  available when both the UART and HDMA devicetree nodes are enabled.
```

## drivers/smbus/Kconfig.hpmicro
```kconfig
# Copyright (c) 2026 The HPM Zephyr Module Contributors
# SPDX-License-Identifier: Apache-2.0

DT_COMPAT_HPM_SMBUS := hpmicro,hpm-smbus

config SMBUS_HPMICRO
	bool "HPMicro SMBus driver"
	default y
	depends on SMBUS
	depends on DT_HAS_HPMICRO_HPM_SMBUS_ENABLED
	depends on I2C_HPMICRO
	select SMBUS_SOFT_PEC
	help
	  Enable SMBus protocol support on top of the HPMicro I2C controller.
	  Byte, word, process-call and block transfers are supported through the
	  Zephyr SMBus API. Hardware SMBALERT and Host Notify are not exposed.

if SMBUS_HPMICRO

module = SMBUS_HPMICRO
module-str = SMBUS_HPMICRO
source "subsys/logging/Kconfig.template.log_config"

endif # SMBUS_HPMICRO
```
