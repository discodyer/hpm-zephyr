## drivers/spi/Kconfig.hpmicro
```kconfig
# Copyright (c) 2026 The HPM Zephyr Module Contributors
# SPDX-License-Identifier: Apache-2.0

DT_COMPAT_HPMICRO_HPM_SPI := hpmicro,hpm-spi

config SPI_HPMICRO
	bool "HPMicro SPI driver"
	default y
	depends on SPI
	depends on DT_HAS_HPMICRO_HPM_SPI_ENABLED
	depends on HAS_HPMSDK_SPI
	select USE_HPMSDK_SPI
	help
	  Enable the HPMicro SPI controller driver. Standard synchronous transfers
	  are always available. When CONFIG_SPI_ASYNC is enabled the driver also
	  provides the asynchronous callback API. Eligible single-line transfers
	  use the HDMA controller; other transfers run through the synchronous
	  engine on the system workqueue.

if SPI_HPMICRO

config SPI_HPMICRO_DMA
	bool "Use DMA for eligible asynchronous transfers"
	default y
	depends on SPI_ASYNC
	depends on DT_HAS_HPMICRO_HPM_DMA_ENABLED
	select DMA
	help
	  Use TX/RX DMA channels from devicetree for single-line asynchronous
	  transfers with contiguous, frame-aligned buffers. Without DMA, or for
	  transfers outside that contract, use the API-compatible workqueue path.

config SPI_HPMICRO_DMA_TIMEOUT_MS
	int "SPI DMA asynchronous transaction timeout"
	depends on SPI_HPMICRO_DMA
	default 1000
	range 1 60000
	help
	  Maximum time to wait for the SPI end interrupt and DMA channel
	  callbacks before completing an asynchronous transfer with -ETIMEDOUT.

endif # SPI_HPMICRO
```

## drivers/usb/Kconfig.hpmicro
```kconfig
# Copyright (c) 2026 The HPM Zephyr Module Contributors
# SPDX-License-Identifier: Apache-2.0

DT_COMPAT_HPM_USB := hpmicro,hpm-usb

choice HPMICRO_USB_ROLE
	prompt "HPMicro USB0 role"
	default HPMICRO_USB_ROLE_DEVICE
	depends on DT_HAS_HPMICRO_HPM_USB_ENABLED
	help
	  HPM USB0 is a single OTG controller with one interrupt. Select the
	  role compiled into this image. Runtime dual-role switching is not yet
	  supported because the Zephyr host and device stacks have independent
	  lifetimes.

config HPMICRO_USB_ROLE_DEVICE
	bool "Device"

config HPMICRO_USB_ROLE_HOST
	bool "Host"

endchoice
```

## drivers/usb/udc/Kconfig.hpmicro
```kconfig
# Copyright (c) 2026 The HPM Zephyr Module Contributors
# SPDX-License-Identifier: Apache-2.0

DT_COMPAT_HPM_USB := hpmicro,hpm-usb

config UDC_HPMICRO
	bool "HPMicro USB device controller driver"
	default y
	depends on DT_HAS_HPMICRO_HPM_USB_ENABLED
	depends on UDC_DRIVER
	depends on ARCH_HAS_NOCACHE_MEMORY_SUPPORT
	depends on CLOCK_CONTROL
	select EVENTS
	select NOCACHE_MEMORY
	select PINCTRL
	select USE_HPMSDK_USB
	select UDC_DRIVER_HAS_HIGH_SPEED_SUPPORT
	help
	  Zephyr UDC driver for the HPMicro USB0 controller. This driver uses
	  the unmodified HPM SDK device-mode qTD/dQHD implementation and supports
	  the HPM5361 high-speed and full-speed device modes.

if UDC_HPMICRO

config UDC_HPMICRO_STACK_SIZE
	int "HPMicro UDC driver thread stack size"
	default 2048
	help
	  Stack size for the HPMicro UDC deferred event thread.

config UDC_HPMICRO_THREAD_PRIORITY
	int "HPMicro UDC driver thread priority"
	default 8
	help
	  Priority for the HPMicro UDC deferred event thread.

config UDC_HPMICRO_VBUS_INTERNAL
	bool "Use the internal VBUS comparator"
	depends on SOC_HPM5361
	help
	  Override the USB PHY VBUS and session-valid inputs with the controller's
	  internal VBUS comparator. Enable this only on boards, or package variants,
	  without a bonded-out USB VBUS pin. HPM5300EVK keeps the external VBUS
	  input and must leave this option disabled.

endif # UDC_HPMICRO
```

## drivers/usb/uhc/Kconfig.hpmicro
```kconfig
# Copyright (c) 2026 The HPM Zephyr Module Contributors
# SPDX-License-Identifier: Apache-2.0

config UHC_HPMICRO
	bool "HPMicro USB host controller driver"
	default y if HPMICRO_USB_ROLE_HOST
	depends on DT_HAS_HPMICRO_HPM_USB_ENABLED
	depends on HPMICRO_USB_ROLE_HOST
	depends on UHC_DRIVER
	depends on CLOCK_CONTROL
	depends on PINCTRL
	depends on HAS_HPMSDK_USB
	depends on ARCH_HAS_NOCACHE_MEMORY_SUPPORT
	select USE_HPMSDK_USB
	select EVENTS
	select NOCACHE_MEMORY
	select UHC_BUF_FORCE_NOCACHE
	help
	  Zephyr UHC driver for the HPMicro USB0 controller. Host transfers use
	  Zephyr's native EHCI queue-head/qTD engine; the unmodified SDK HAL is
	  used only for PHY and controller bring-up.

if UHC_HPMICRO

config UHC_HPMICRO_THREAD_STACK_SIZE
	int "HPMicro UHC driver thread stack size"
	default 2048
	help
	  Stack size for the HPMicro UHC port event thread.

config UHC_HPMICRO_THREAD_PRIORITY
	int "HPMicro UHC driver thread priority"
	default 8
	help
	  Priority for the HPMicro UHC port event thread.

config UHC_HPMICRO_QH_COUNT
	int "Number of EHCI queue heads"
	range 2 32
	default 8
	help
	  Number of queue heads available to host transfers.

config UHC_HPMICRO_QTD_COUNT
	int "Number of EHCI transfer descriptors"
	range 8 128
	default 24
	help
	  Number of qTDs available to host transfers. Each qTD carries at most
	  4 KiB of transfer data.

config UHC_HPMICRO_ITD_COUNT
	int "Number of EHCI isochronous transfer descriptors"
	range 1 32
	default 8
	help
	  Number of high-speed isochronous transfer descriptors (iTDs). Each
	  pending isochronous transfer consumes one iTD.

config UHC_HPMICRO_SITD_COUNT
	int "Number of EHCI split isochronous transfer descriptors"
	range 1 32
	default 8
	help
	  Number of full-speed isochronous split transfer descriptors (siTDs).
	  Each pending full-speed isochronous transfer consumes one siTD. The
	  transfer contains one start split and its complete splits in the same
	  frame.

endif # UHC_HPMICRO
```

## drivers/watchdog/Kconfig.hpmicro
```kconfig
# Copyright (c) 2026 The HPM Zephyr Module Contributors
# SPDX-License-Identifier: Apache-2.0

DT_COMPAT_HPM_EWDG := hpmicro,hpm-ewdg

config WDT_HPMICRO
	bool "HPMicro EWDG watchdog driver"
	default y
	depends on DT_HAS_HPMICRO_HPM_EWDG_ENABLED
	depends on HAS_HPMSDK_EWDG
	select USE_HPMSDK_EWDG
	help
	  Enable the HPMicro enhanced watchdog (EWDG) driver.
```

## dts/bindings/adc/hpmicro,hpm-adc16.yaml
```yaml
# Copyright (c) 2026 The HPM Zephyr Module Contributors
# SPDX-License-Identifier: Apache-2.0

description: HPMicro ADC16 controller

compatible: "hpmicro,hpm-adc16"

include: [adc-controller.yaml, pinctrl-device.yaml]

properties:
  reg:
    required: true

  interrupts:
    required: true

  clocks:
    required: true

  clock-names:
    required: true

  clock-name:
    type: int
    required: true

  clock-src:
    type: int
    required: true

  ana-clock-name:
    type: int
    required: true

  ana-clock-src:
    type: int
    required: true

  vref-mv:
    type: int
    description: ADC reference voltage in millivolts

io-channel-cells:
  - input
```

## dts/bindings/can/hpmicro,hpm-mcan.yaml
```yaml
# Copyright (c) 2026 The HPM Zephyr Module Contributors
# SPDX-License-Identifier: Apache-2.0

description: HPMicro MCAN CAN-FD controller

compatible: "hpmicro,hpm-mcan"

include: ["bosch,m_can-base.yaml", pinctrl-device.yaml]

properties:
  reg:
    required: true

  reg-names:
    required: true

  interrupts:
    required: true

  clocks:
    required: true

  clock-names:
    required: true

  clock-name:
    type: int
    required: true

  clock-src:
    type: int
    required: true
```

## dts/bindings/clock/hpmicro,hpm-pllv2-clock.yaml
```yaml
# Copyright (c) 2024-2026 HPMicro
# SPDX-License-Identifier: Apache-2.0

description: HPMicro PLL version 2 controller

compatible: "hpmicro,hpm-pllv2"

include: [clock-controller.yaml, base.yaml]

properties:
  reg:
    required: true

  clock-frequency:
    type: int
    description: Nominal PLL reference frequency in Hz.

  "#clock-cells":
    const: 3

clock-cells:
  - name
  - source
  - divider
```

## dts/bindings/comparator/hpmicro,hpm-acmp-comp.yaml
```yaml
# Copyright (c) 2026 The HPM Zephyr Module Contributors
# SPDX-License-Identifier: Apache-2.0

description: |
  HPMicro analog comparator channel.

  Values for the input properties are defined in
  <dt-bindings/comparator/hpmicro-acmp.h>. Selecting HPM_ACMP_INPUT_DAC_OUT
  enables the channel's internal 8-bit DAC threshold.

compatible: "hpmicro,hpm-acmp-comp"

include: [base.yaml, pinctrl-device.yaml]

properties:
  reg:
    required: true
    description: Comparator channel index (0 or 1).

  interrupts:
    required: true

  positive-input:
    type: int
    enum: [0, 1, 2, 3, 4, 5, 6, 7]
    default: 0
    description: Non-inverting input selection.

  negative-input:
    type: int
    enum: [0, 1, 2, 3, 4, 5, 6, 7]
    default: 0
    description: Inverting input selection.

  hysteresis:
    type: int
    enum: [0, 1, 2, 3]
    default: 0
    description: |
      Hysteresis level: 0 is approximately 30 mV, 1 is 20 mV, 2 is 10 mV
      and 3 disables hysteresis.

  filter-mode:
    type: string
    enum: ["bypass", "immediate", "delay", "stable-low", "stable-high"]
    default: "bypass"
    description: Digital output filter mode.

  filter-length:
    type: int
    default: 0
    description: Digital filter length in ACMP clock cycles.

  invert-output:
    type: boolean
    description: Invert the comparator output polarity.

  enable-output-pin:
    type: boolean
    description: Enable the comparator output on its digital output pin.

  high-performance-mode:
    type: boolean
    description: Trade increased power consumption for lower output delay.

  dac-value:
    type: int
    default: 0
    description: Internal DAC threshold value, from 0 to 255.
```
