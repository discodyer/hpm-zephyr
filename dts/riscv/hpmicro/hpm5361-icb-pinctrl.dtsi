/*
 * Copyright (c) 2026 The HPM Zephyr Module Contributors
 * SPDX-License-Identifier: Apache-2.0
 *
 * Auto-generated by scripts/generate_hpm5361_pinctrl.py.
 * Source: HPM5361 LQFP100, 14x14 mm LQFP100, 0.5 mm pitch.
 */

#include <dt-bindings/pinctrl/hpmicro-pinctrl-common.h>

/ {
	hpm5361_package: hpm5361-package {
		compatible = "hpmicro,hpm5361-package";
		hpmicro,package = "lqfp100";
		hpmicro,model = "HPM5361ICB1";
		hpmicro,gpio-count = <56>;
		hpmicro,analog-pin-count = <16>;
		hpmicro,available-pads = "PA00", "PA01", "PA02", "PA03", "PA04", "PA05", "PA06",
					 "PA07", "PA08", "PA09", "PA10", "PA11", "PA12", "PA13",
					 "PA14", "PA15", "PA16", "PA17", "PA18", "PA19", "PA20",
					 "PA21", "PA22", "PA23", "PA24", "PA25", "PA26", "PA27",
					 "PA28", "PA29", "PA30", "PA31", "PB00", "PB01", "PB02",
					 "PB03", "PB04", "PB05", "PB06", "PB07", "PB08", "PB09",
					 "PB10", "PB11", "PB12", "PB13", "PB14", "PB15", "PY00",
					 "PY01", "PY02", "PY03", "PY04", "PY05", "PY06", "PY07";
	};
};

&pinctrl {
	/* Port A */
	/omit-if-no-ref/ pa00_gpio_a_00: pa00_gpio_a_00 {
		group0 {
			pinmux = <HPMICRO_PINMUX(HPMICRO_PIN(HPMICRO_PORTA, 0), IOC_TYPE_IOC, 0, 0)>;
		};
	};

	/omit-if-no-ref/ pa00_gptmr1_comp_0: pa00_gptmr1_comp_0 {
		group0 {
			pinmux = <HPMICRO_PINMUX(HPMICRO_PIN(HPMICRO_PORTA, 0), IOC_TYPE_IOC, 0, 1)>;
		};
	};

	/omit-if-no-ref/ pa00_uart0_txd: pa00_uart0_txd {
		group0 {
			pinmux = <HPMICRO_PINMUX(HPMICRO_PIN(HPMICRO_PORTA, 0), IOC_TYPE_IOC, 0, 2)>;
		};
	};

	/omit-if-no-ref/ pa00_mcan0_txd: pa00_mcan0_txd {
		group0 {
			pinmux = <HPMICRO_PINMUX(HPMICRO_PIN(HPMICRO_PORTA, 0), IOC_TYPE_IOC, 0, 7)>;
		};
	};

	/omit-if-no-ref/ pa00_pwm0_fault_0: pa00_pwm0_fault_0 {
		group0 {
			pinmux = <HPMICRO_PINMUX(HPMICRO_PIN(HPMICRO_PORTA, 0), IOC_TYPE_IOC, 0, 16)>;
		};
	};

	/omit-if-no-ref/ pa00_pwm1_p_0: pa00_pwm1_p_0 {
		group0 {
			pinmux = <HPMICRO_PINMUX(HPMICRO_PIN(HPMICRO_PORTA, 0), IOC_TYPE_IOC, 0, 17)>;
		};
	};

	/omit-if-no-ref/ pa00_trgm0_p_00: pa00_trgm0_p_00 {
		group0 {
			pinmux = <HPMICRO_PINMUX(HPMICRO_PIN(HPMICRO_PORTA, 0), IOC_TYPE_IOC, 0, 18)>;
		};
	};

	/omit-if-no-ref/ pa00_pwm1_fault_0: pa00_pwm1_fault_0 {
		group0 {
			pinmux = <HPMICRO_PINMUX(HPMICRO_PIN(HPMICRO_PORTA, 0), IOC_TYPE_IOC, 0, 19)>;
		};
	};

	/omit-if-no-ref/ pa00_sysctl_clk_obs_0: pa00_sysctl_clk_obs_0 {
		group0 {
			pinmux = <HPMICRO_PINMUX(HPMICRO_PIN(HPMICRO_PORTA, 0), IOC_TYPE_IOC, 0, 24)>;
		};
	};

	/omit-if-no-ref/ pa01_gpio_a_01: pa01_gpio_a_01 {
		group0 {
			pinmux = <HPMICRO_PINMUX(HPMICRO_PIN(HPMICRO_PORTA, 1), IOC_TYPE_IOC, 0, 0)>;
		};
	};

	/omit-if-no-ref/ pa01_gptmr1_capt_0: pa01_gptmr1_capt_0 {
		group0 {
			pinmux = <HPMICRO_PINMUX(HPMICRO_PIN(HPMICRO_PORTA, 1), IOC_TYPE_IOC, 0, 1)>;
		};
	};

	/omit-if-no-ref/ pa01_uart0_rxd: pa01_uart0_rxd {
		group0 {
			pinmux = <HPMICRO_PINMUX(HPMICRO_PIN(HPMICRO_PORTA, 1), IOC_TYPE_IOC, 0, 2)>;
		};
	};

	/omit-if-no-ref/ pa01_mcan0_rxd: pa01_mcan0_rxd {
		group0 {
			pinmux = <HPMICRO_PINMUX(HPMICRO_PIN(HPMICRO_PORTA, 1), IOC_TYPE_IOC, 0, 7)>;
		};
	};

	/omit-if-no-ref/ pa01_pwm0_fault_1: pa01_pwm0_fault_1 {
		group0 {
			pinmux = <HPMICRO_PINMUX(HPMICRO_PIN(HPMICRO_PORTA, 1), IOC_TYPE_IOC, 0, 16)>;
		};
	};

	/omit-if-no-ref/ pa01_pwm1_p_1: pa01_pwm1_p_1 {
		group0 {
			pinmux = <HPMICRO_PINMUX(HPMICRO_PIN(HPMICRO_PORTA, 1), IOC_TYPE_IOC, 0, 17)>;
		};
	};

	/omit-if-no-ref/ pa01_trgm0_p_01: pa01_trgm0_p_01 {
		group0 {
			pinmux = <HPMICRO_PINMUX(HPMICRO_PIN(HPMICRO_PORTA, 1), IOC_TYPE_IOC, 0, 18)>;
		};
	};

	/omit-if-no-ref/ pa01_acmp_comp_0: pa01_acmp_comp_0 {
		group0 {
			pinmux = <HPMICRO_PINMUX(HPMICRO_PIN(HPMICRO_PORTA, 1), IOC_TYPE_IOC, 0, 19)>;
		};
	};

	/omit-if-no-ref/ pa01_sysctl_clk_obs_1: pa01_sysctl_clk_obs_1 {
		group0 {
			pinmux = <HPMICRO_PINMUX(HPMICRO_PIN(HPMICRO_PORTA, 1), IOC_TYPE_IOC, 0, 24)>;
		};
	};

	/omit-if-no-ref/ pa02_gpio_a_02: pa02_gpio_a_02 {
		group0 {
			pinmux = <HPMICRO_PINMUX(HPMICRO_PIN(HPMICRO_PORTA, 2), IOC_TYPE_IOC, 0, 0)>;
		};
	};

	/omit-if-no-ref/ pa02_gptmr1_comp_1: pa02_gptmr1_comp_1 {
		group0 {
			pinmux = <HPMICRO_PINMUX(HPMICRO_PIN(HPMICRO_PORTA, 2), IOC_TYPE_IOC, 0, 1)>;
		};
	};

	/omit-if-no-ref/ pa02_uart0_de: pa02_uart0_de {
		group0 {
			pinmux = <HPMICRO_PINMUX(HPMICRO_PIN(HPMICRO_PORTA, 2), IOC_TYPE_IOC, 0, 2)>;
		};
	};

	/omit-if-no-ref/ pa02_uart0_rts: pa02_uart0_rts {
		group0 {
			pinmux = <HPMICRO_PINMUX(HPMICRO_PIN(HPMICRO_PORTA, 2), IOC_TYPE_IOC, 0, 3)>;
		};
	};

	/omit-if-no-ref/ pa02_i2c0_scl: pa02_i2c0_scl {
		group0 {
			pinmux = <HPMICRO_PINMUX(HPMICRO_PIN(HPMICRO_PORTA, 2), IOC_TYPE_IOC, 0, 4)>;
		};
	};

	/omit-if-no-ref/ pa02_mcan0_stby: pa02_mcan0_stby {
		group0 {
			pinmux = <HPMICRO_PINMUX(HPMICRO_PIN(HPMICRO_PORTA, 2), IOC_TYPE_IOC, 0, 7)>;
		};
	};

	/omit-if-no-ref/ pa02_acmp_comp_0: pa02_acmp_comp_0 {
		group0 {
			pinmux = <HPMICRO_PINMUX(HPMICRO_PIN(HPMICRO_PORTA, 2), IOC_TYPE_IOC, 0, 16)>;
		};
	};

	/omit-if-no-ref/ pa02_pwm1_p_2: pa02_pwm1_p_2 {
		group0 {
			pinmux = <HPMICRO_PINMUX(HPMICRO_PIN(HPMICRO_PORTA, 2), IOC_TYPE_IOC, 0, 17)>;
		};
	};

	/omit-if-no-ref/ pa02_trgm0_p_02: pa02_trgm0_p_02 {
		group0 {
			pinmux = <HPMICRO_PINMUX(HPMICRO_PIN(HPMICRO_PORTA, 2), IOC_TYPE_IOC, 0, 18)>;
		};
	};

	/omit-if-no-ref/ pa02_acmp_comp_1: pa02_acmp_comp_1 {
		group0 {
			pinmux = <HPMICRO_PINMUX(HPMICRO_PIN(HPMICRO_PORTA, 2), IOC_TYPE_IOC, 0, 19)>;
		};
	};

	/omit-if-no-ref/ pa02_qei1_f: pa02_qei1_f {
		group0 {
			pinmux = <HPMICRO_PINMUX(HPMICRO_PIN(HPMICRO_PORTA, 2), IOC_TYPE_IOC, 0, 20)>;
		};
	};

	/omit-if-no-ref/ pa02_sysctl_clk_obs_2: pa02_sysctl_clk_obs_2 {
		group0 {
			pinmux = <HPMICRO_PINMUX(HPMICRO_PIN(HPMICRO_PORTA, 2), IOC_TYPE_IOC, 0, 24)>;
		};
	};

	/omit-if-no-ref/ pa03_gpio_a_03: pa03_gpio_a_03 {
		group0 {
			pinmux = <HPMICRO_PINMUX(HPMICRO_PIN(HPMICRO_PORTA, 3), IOC_TYPE_IOC, 0, 0)>;
		};
	};

	/omit-if-no-ref/ pa03_gptmr1_capt_1: pa03_gptmr1_capt_1 {
		group0 {
			pinmux = <HPMICRO_PINMUX(HPMICRO_PIN(HPMICRO_PORTA, 3), IOC_TYPE_IOC, 0, 1)>;
		};
	};

	/omit-if-no-ref/ pa03_uart0_cts: pa03_uart0_cts {
		group0 {
			pinmux = <HPMICRO_PINMUX(HPMICRO_PIN(HPMICRO_PORTA, 3), IOC_TYPE_IOC, 0, 3)>;
		};
	};

	/omit-if-no-ref/ pa03_i2c0_sda: pa03_i2c0_sda {
		group0 {
			pinmux = <HPMICRO_PINMUX(HPMICRO_PIN(HPMICRO_PORTA, 3), IOC_TYPE_IOC, 0, 4)>;
		};
	};

	/omit-if-no-ref/ pa03_spi3_cs_3: pa03_spi3_cs_3 {
		group0 {
			pinmux = <HPMICRO_PINMUX(HPMICRO_PIN(HPMICRO_PORTA, 3), IOC_TYPE_IOC, 0, 5)>;
		};
	};

	/omit-if-no-ref/ pa03_mcan1_stby: pa03_mcan1_stby {
		group0 {
			pinmux = <HPMICRO_PINMUX(HPMICRO_PIN(HPMICRO_PORTA, 3), IOC_TYPE_IOC, 0, 7)>;
		};
	};

	/omit-if-no-ref/ pa03_acmp_comp_1: pa03_acmp_comp_1 {
		group0 {
			pinmux = <HPMICRO_PINMUX(HPMICRO_PIN(HPMICRO_PORTA, 3), IOC_TYPE_IOC, 0, 16)>;
		};
	};

	/omit-if-no-ref/ pa03_pwm1_p_3: pa03_pwm1_p_3 {
		group0 {
			pinmux = <HPMICRO_PINMUX(HPMICRO_PIN(HPMICRO_PORTA, 3), IOC_TYPE_IOC, 0, 17)>;
		};
	};

	/omit-if-no-ref/ pa03_trgm0_p_03: pa03_trgm0_p_03 {
		group0 {
			pinmux = <HPMICRO_PINMUX(HPMICRO_PIN(HPMICRO_PORTA, 3), IOC_TYPE_IOC, 0, 18)>;
		};
	};

	/omit-if-no-ref/ pa03_pwm1_fault_1: pa03_pwm1_fault_1 {
		group0 {
			pinmux = <HPMICRO_PINMUX(HPMICRO_PIN(HPMICRO_PORTA, 3), IOC_TYPE_IOC, 0, 19)>;
		};
	};

	/omit-if-no-ref/ pa03_qei1_h1: pa03_qei1_h1 {
		group0 {
			pinmux = <HPMICRO_PINMUX(HPMICRO_PIN(HPMICRO_PORTA, 3), IOC_TYPE_IOC, 0, 20)>;
		};
	};

	/omit-if-no-ref/ pa03_sysctl_clk_obs_3: pa03_sysctl_clk_obs_3 {
		group0 {
			pinmux = <HPMICRO_PINMUX(HPMICRO_PIN(HPMICRO_PORTA, 3), IOC_TYPE_IOC, 0, 24)>;
		};
	};

	/omit-if-no-ref/ pa04_gpio_a_04: pa04_gpio_a_04 {
		group0 {
			pinmux = <HPMICRO_PINMUX(HPMICRO_PIN(HPMICRO_PORTA, 4), IOC_TYPE_IOC, 0, 0)>;
		};
	};

	/omit-if-no-ref/ pa04_uart1_cts: pa04_uart1_cts {
		group0 {
			pinmux = <HPMICRO_PINMUX(HPMICRO_PIN(HPMICRO_PORTA, 4), IOC_TYPE_IOC, 0, 3)>;
		};
	};

	/omit-if-no-ref/ pa04_spi0_cs_0: pa04_spi0_cs_0 {
		group0 {
			pinmux = <HPMICRO_PINMUX(HPMICRO_PIN(HPMICRO_PORTA, 4), IOC_TYPE_IOC, 0, 5)>;
		};
	};

	/omit-if-no-ref/ pa04_mcan1_rxd: pa04_mcan1_rxd {
		group0 {
			pinmux = <HPMICRO_PINMUX(HPMICRO_PIN(HPMICRO_PORTA, 4), IOC_TYPE_IOC, 0, 7)>;
		};
	};

	/omit-if-no-ref/ pa04_pwm0_p_0: pa04_pwm0_p_0 {
		group0 {
			pinmux = <HPMICRO_PINMUX(HPMICRO_PIN(HPMICRO_PORTA, 4), IOC_TYPE_IOC, 0, 16)>;
		};
	};

	/omit-if-no-ref/ pa04_pwm1_p_4: pa04_pwm1_p_4 {
		group0 {
			pinmux = <HPMICRO_PINMUX(HPMICRO_PIN(HPMICRO_PORTA, 4), IOC_TYPE_IOC, 0, 17)>;
		};
	};

	/omit-if-no-ref/ pa04_trgm0_p_04: pa04_trgm0_p_04 {
		group0 {
			pinmux = <HPMICRO_PINMUX(HPMICRO_PIN(HPMICRO_PORTA, 4), IOC_TYPE_IOC, 0, 18)>;
		};
	};

	/omit-if-no-ref/ pa04_rdc0_exc_p: pa04_rdc0_exc_p {
		group0 {
			pinmux = <HPMICRO_PINMUX(HPMICRO_PIN(HPMICRO_PORTA, 4), IOC_TYPE_IOC, 0, 19)>;
		};
	};

	/omit-if-no-ref/ pa04_qei1_a: pa04_qei1_a {
		group0 {
			pinmux = <HPMICRO_PINMUX(HPMICRO_PIN(HPMICRO_PORTA, 4), IOC_TYPE_IOC, 0, 20)>;
		};
	};

	/omit-if-no-ref/ pa04_qeo1_a: pa04_qeo1_a {
		group0 {
			pinmux = <HPMICRO_PINMUX(HPMICRO_PIN(HPMICRO_PORTA, 4), IOC_TYPE_IOC, 0, 21)>;
		};
	};

	/omit-if-no-ref/ pa04_sei1_de: pa04_sei1_de {
		group0 {
			pinmux = <HPMICRO_PINMUX(HPMICRO_PIN(HPMICRO_PORTA, 4), IOC_TYPE_IOC, 0, 22)>;
		};
	};

	/omit-if-no-ref/ pa04_jtag_tdo: pa04_jtag_tdo {
		group0 {
			pinmux = <HPMICRO_PINMUX(HPMICRO_PIN(HPMICRO_PORTA, 4), IOC_TYPE_IOC, 0, 24)>;
		};
	};

	/omit-if-no-ref/ pa05_gpio_a_05: pa05_gpio_a_05 {
		group0 {
			pinmux = <HPMICRO_PINMUX(HPMICRO_PIN(HPMICRO_PORTA, 5), IOC_TYPE_IOC, 0, 0)>;
		};
	};

	/omit-if-no-ref/ pa05_gptmr1_comp_2: pa05_gptmr1_comp_2 {
		group0 {
			pinmux = <HPMICRO_PINMUX(HPMICRO_PIN(HPMICRO_PORTA, 5), IOC_TYPE_IOC, 0, 1)>;
		};
	};

	/omit-if-no-ref/ pa05_uart1_de: pa05_uart1_de {
		group0 {
			pinmux = <HPMICRO_PINMUX(HPMICRO_PIN(HPMICRO_PORTA, 5), IOC_TYPE_IOC, 0, 2)>;
		};
	};

	/omit-if-no-ref/ pa05_uart1_rts: pa05_uart1_rts {
		group0 {
			pinmux = <HPMICRO_PINMUX(HPMICRO_PIN(HPMICRO_PORTA, 5), IOC_TYPE_IOC, 0, 3)>;
		};
	};

	/omit-if-no-ref/ pa05_spi0_sclk: pa05_spi0_sclk {
		group0 {
			pinmux = <HPMICRO_PINMUX(HPMICRO_PIN(HPMICRO_PORTA, 5), IOC_TYPE_IOC, 0, 5)>;
		};
	};

	/omit-if-no-ref/ pa05_mcan1_txd: pa05_mcan1_txd {
		group0 {
			pinmux = <HPMICRO_PINMUX(HPMICRO_PIN(HPMICRO_PORTA, 5), IOC_TYPE_IOC, 0, 7)>;
		};
	};

	/omit-if-no-ref/ pa05_pwm0_p_1: pa05_pwm0_p_1 {
		group0 {
			pinmux = <HPMICRO_PINMUX(HPMICRO_PIN(HPMICRO_PORTA, 5), IOC_TYPE_IOC, 0, 16)>;
		};
	};

	/omit-if-no-ref/ pa05_pwm1_p_5: pa05_pwm1_p_5 {
		group0 {
			pinmux = <HPMICRO_PINMUX(HPMICRO_PIN(HPMICRO_PORTA, 5), IOC_TYPE_IOC, 0, 17)>;
		};
	};

	/omit-if-no-ref/ pa05_trgm0_p_05: pa05_trgm0_p_05 {
		group0 {
			pinmux = <HPMICRO_PINMUX(HPMICRO_PIN(HPMICRO_PORTA, 5), IOC_TYPE_IOC, 0, 18)>;
		};
	};

	/omit-if-no-ref/ pa05_rdc0_exc_n: pa05_rdc0_exc_n {
		group0 {
			pinmux = <HPMICRO_PINMUX(HPMICRO_PIN(HPMICRO_PORTA, 5), IOC_TYPE_IOC, 0, 19)>;
		};
	};

	/omit-if-no-ref/ pa05_qei1_b: pa05_qei1_b {
		group0 {
			pinmux = <HPMICRO_PINMUX(HPMICRO_PIN(HPMICRO_PORTA, 5), IOC_TYPE_IOC, 0, 20)>;
		};
	};

	/omit-if-no-ref/ pa05_qeo1_b: pa05_qeo1_b {
		group0 {
			pinmux = <HPMICRO_PINMUX(HPMICRO_PIN(HPMICRO_PORTA, 5), IOC_TYPE_IOC, 0, 21)>;
		};
	};

	/omit-if-no-ref/ pa05_sei1_ck: pa05_sei1_ck {
		group0 {
			pinmux = <HPMICRO_PINMUX(HPMICRO_PIN(HPMICRO_PORTA, 5), IOC_TYPE_IOC, 0, 22)>;
		};
	};

	/omit-if-no-ref/ pa05_jtag_tdi: pa05_jtag_tdi {
		group0 {
			pinmux = <HPMICRO_PINMUX(HPMICRO_PIN(HPMICRO_PORTA, 5), IOC_TYPE_IOC, 0, 24)>;
		};
	};

	/omit-if-no-ref/ pa06_gpio_a_06: pa06_gpio_a_06 {
		group0 {
			pinmux = <HPMICRO_PINMUX(HPMICRO_PIN(HPMICRO_PORTA, 6), IOC_TYPE_IOC, 0, 0)>;
		};
	};

	/omit-if-no-ref/ pa06_gptmr0_capt_0: pa06_gptmr0_capt_0 {
		group0 {
			pinmux = <HPMICRO_PINMUX(HPMICRO_PIN(HPMICRO_PORTA, 6), IOC_TYPE_IOC, 0, 1)>;
		};
	};

	/omit-if-no-ref/ pa06_uart1_rxd: pa06_uart1_rxd {
		group0 {
			pinmux = <HPMICRO_PINMUX(HPMICRO_PIN(HPMICRO_PORTA, 6), IOC_TYPE_IOC, 0, 2)>;
		};
	};

	/omit-if-no-ref/ pa06_i2c1_sda: pa06_i2c1_sda {
		group0 {
			pinmux = <HPMICRO_PINMUX(HPMICRO_PIN(HPMICRO_PORTA, 6), IOC_TYPE_IOC, 0, 4)>;
		};
	};

	/omit-if-no-ref/ pa06_spi0_miso: pa06_spi0_miso {
		group0 {
			pinmux = <HPMICRO_PINMUX(HPMICRO_PIN(HPMICRO_PORTA, 6), IOC_TYPE_IOC, 0, 5)>;
		};
	};

	/omit-if-no-ref/ pa06_pwm0_p_2: pa06_pwm0_p_2 {
		group0 {
			pinmux = <HPMICRO_PINMUX(HPMICRO_PIN(HPMICRO_PORTA, 6), IOC_TYPE_IOC, 0, 16)>;
		};
	};

	/omit-if-no-ref/ pa06_pwm1_p_6: pa06_pwm1_p_6 {
		group0 {
			pinmux = <HPMICRO_PINMUX(HPMICRO_PIN(HPMICRO_PORTA, 6), IOC_TYPE_IOC, 0, 17)>;
		};
	};

	/omit-if-no-ref/ pa06_trgm0_p_06: pa06_trgm0_p_06 {
		group0 {
			pinmux = <HPMICRO_PINMUX(HPMICRO_PIN(HPMICRO_PORTA, 6), IOC_TYPE_IOC, 0, 18)>;
		};
	};

	/omit-if-no-ref/ pa06_qei1_z: pa06_qei1_z {
		group0 {
			pinmux = <HPMICRO_PINMUX(HPMICRO_PIN(HPMICRO_PORTA, 6), IOC_TYPE_IOC, 0, 20)>;
		};
	};

	/omit-if-no-ref/ pa06_qeo1_z: pa06_qeo1_z {
		group0 {
			pinmux = <HPMICRO_PINMUX(HPMICRO_PIN(HPMICRO_PORTA, 6), IOC_TYPE_IOC, 0, 21)>;
		};
	};

	/omit-if-no-ref/ pa06_sei1_tx: pa06_sei1_tx {
		group0 {
			pinmux = <HPMICRO_PINMUX(HPMICRO_PIN(HPMICRO_PORTA, 6), IOC_TYPE_IOC, 0, 22)>;
		};
	};

	/omit-if-no-ref/ pa06_jtag_tck: pa06_jtag_tck {
		group0 {
			pinmux = <HPMICRO_PINMUX(HPMICRO_PIN(HPMICRO_PORTA, 6), IOC_TYPE_IOC, 0, 24)>;
		};
	};

	/omit-if-no-ref/ pa07_gpio_a_07: pa07_gpio_a_07 {
		group0 {
			pinmux = <HPMICRO_PINMUX(HPMICRO_PIN(HPMICRO_PORTA, 7), IOC_TYPE_IOC, 0, 0)>;
		};
	};

	/omit-if-no-ref/ pa07_gptmr0_comp_0: pa07_gptmr0_comp_0 {
		group0 {
			pinmux = <HPMICRO_PINMUX(HPMICRO_PIN(HPMICRO_PORTA, 7), IOC_TYPE_IOC, 0, 1)>;
		};
	};

	/omit-if-no-ref/ pa07_uart1_txd: pa07_uart1_txd {
		group0 {
			pinmux = <HPMICRO_PINMUX(HPMICRO_PIN(HPMICRO_PORTA, 7), IOC_TYPE_IOC, 0, 2)>;
		};
	};

	/omit-if-no-ref/ pa07_i2c1_scl: pa07_i2c1_scl {
		group0 {
			pinmux = <HPMICRO_PINMUX(HPMICRO_PIN(HPMICRO_PORTA, 7), IOC_TYPE_IOC, 0, 4)>;
		};
	};

	/omit-if-no-ref/ pa07_spi0_mosi: pa07_spi0_mosi {
		group0 {
			pinmux = <HPMICRO_PINMUX(HPMICRO_PIN(HPMICRO_PORTA, 7), IOC_TYPE_IOC, 0, 5)>;
		};
	};

	/omit-if-no-ref/ pa07_pwm0_p_3: pa07_pwm0_p_3 {
		group0 {
			pinmux = <HPMICRO_PINMUX(HPMICRO_PIN(HPMICRO_PORTA, 7), IOC_TYPE_IOC, 0, 16)>;
		};
	};

	/omit-if-no-ref/ pa07_pwm1_p_7: pa07_pwm1_p_7 {
		group0 {
			pinmux = <HPMICRO_PINMUX(HPMICRO_PIN(HPMICRO_PORTA, 7), IOC_TYPE_IOC, 0, 17)>;
		};
	};

	/omit-if-no-ref/ pa07_trgm0_p_07: pa07_trgm0_p_07 {
		group0 {
			pinmux = <HPMICRO_PINMUX(HPMICRO_PIN(HPMICRO_PORTA, 7), IOC_TYPE_IOC, 0, 18)>;
		};
	};

	/omit-if-no-ref/ pa07_qei1_h0: pa07_qei1_h0 {
		group0 {
			pinmux = <HPMICRO_PINMUX(HPMICRO_PIN(HPMICRO_PORTA, 7), IOC_TYPE_IOC, 0, 20)>;
		};
	};

	/omit-if-no-ref/ pa07_sei1_rx: pa07_sei1_rx {
		group0 {
			pinmux = <HPMICRO_PINMUX(HPMICRO_PIN(HPMICRO_PORTA, 7), IOC_TYPE_IOC, 0, 22)>;
		};
	};

	/omit-if-no-ref/ pa07_jtag_tms: pa07_jtag_tms {
		group0 {
			pinmux = <HPMICRO_PINMUX(HPMICRO_PIN(HPMICRO_PORTA, 7), IOC_TYPE_IOC, 0, 24)>;
		};
	};

	/omit-if-no-ref/ pa08_gpio_a_08: pa08_gpio_a_08 {
		group0 {
			pinmux = <HPMICRO_PINMUX(HPMICRO_PIN(HPMICRO_PORTA, 8), IOC_TYPE_IOC, 0, 0)>;
		};
	};

	/omit-if-no-ref/ pa08_gptmr0_comp_1: pa08_gptmr0_comp_1 {
		group0 {
			pinmux = <HPMICRO_PINMUX(HPMICRO_PIN(HPMICRO_PORTA, 8), IOC_TYPE_IOC, 0, 1)>;
		};
	};

	/omit-if-no-ref/ pa08_uart2_txd: pa08_uart2_txd {
		group0 {
			pinmux = <HPMICRO_PINMUX(HPMICRO_PIN(HPMICRO_PORTA, 8), IOC_TYPE_IOC, 0, 2)>;
		};
	};

	/omit-if-no-ref/ pa08_i2c2_scl: pa08_i2c2_scl {
		group0 {
			pinmux = <HPMICRO_PINMUX(HPMICRO_PIN(HPMICRO_PORTA, 8), IOC_TYPE_IOC, 0, 4)>;
		};
	};

	/omit-if-no-ref/ pa08_spi3_cs_2: pa08_spi3_cs_2 {
		group0 {
			pinmux = <HPMICRO_PINMUX(HPMICRO_PIN(HPMICRO_PORTA, 8), IOC_TYPE_IOC, 0, 5)>;
		};
	};

	/omit-if-no-ref/ pa08_mcan2_txd: pa08_mcan2_txd {
		group0 {
			pinmux = <HPMICRO_PINMUX(HPMICRO_PIN(HPMICRO_PORTA, 8), IOC_TYPE_IOC, 0, 7)>;
		};
	};

	/omit-if-no-ref/ pa08_pwm0_p_4: pa08_pwm0_p_4 {
		group0 {
			pinmux = <HPMICRO_PINMUX(HPMICRO_PIN(HPMICRO_PORTA, 8), IOC_TYPE_IOC, 0, 16)>;
		};
	};

	/omit-if-no-ref/ pa08_pwm0_fault_0: pa08_pwm0_fault_0 {
		group0 {
			pinmux = <HPMICRO_PINMUX(HPMICRO_PIN(HPMICRO_PORTA, 8), IOC_TYPE_IOC, 0, 18)>;
		};
	};

	/omit-if-no-ref/ pa08_jtag_trst: pa08_jtag_trst {
		group0 {
			pinmux = <HPMICRO_PINMUX(HPMICRO_PIN(HPMICRO_PORTA, 8), IOC_TYPE_IOC, 0, 24)>;
		};
	};

	/omit-if-no-ref/ pa09_gpio_a_09: pa09_gpio_a_09 {
		group0 {
			pinmux = <HPMICRO_PINMUX(HPMICRO_PIN(HPMICRO_PORTA, 9), IOC_TYPE_IOC, 0, 0)>;
		};
	};

	/omit-if-no-ref/ pa09_gptmr0_capt_1: pa09_gptmr0_capt_1 {
		group0 {
			pinmux = <HPMICRO_PINMUX(HPMICRO_PIN(HPMICRO_PORTA, 9), IOC_TYPE_IOC, 0, 1)>;
		};
	};

	/omit-if-no-ref/ pa09_uart2_rxd: pa09_uart2_rxd {
		group0 {
			pinmux = <HPMICRO_PINMUX(HPMICRO_PIN(HPMICRO_PORTA, 9), IOC_TYPE_IOC, 0, 2)>;
		};
	};

	/omit-if-no-ref/ pa09_i2c2_sda: pa09_i2c2_sda {
		group0 {
			pinmux = <HPMICRO_PINMUX(HPMICRO_PIN(HPMICRO_PORTA, 9), IOC_TYPE_IOC, 0, 4)>;
		};
	};

	/omit-if-no-ref/ pa09_spi3_cs_1: pa09_spi3_cs_1 {
		group0 {
			pinmux = <HPMICRO_PINMUX(HPMICRO_PIN(HPMICRO_PORTA, 9), IOC_TYPE_IOC, 0, 5)>;
		};
	};

	/omit-if-no-ref/ pa09_mcan2_rxd: pa09_mcan2_rxd {
		group0 {
			pinmux = <HPMICRO_PINMUX(HPMICRO_PIN(HPMICRO_PORTA, 9), IOC_TYPE_IOC, 0, 7)>;
		};
	};

	/omit-if-no-ref/ pa09_pwm0_p_5: pa09_pwm0_p_5 {
		group0 {
			pinmux = <HPMICRO_PINMUX(HPMICRO_PIN(HPMICRO_PORTA, 9), IOC_TYPE_IOC, 0, 16)>;
		};
	};

	/omit-if-no-ref/ pa09_pwm0_fault_1: pa09_pwm0_fault_1 {
		group0 {
			pinmux = <HPMICRO_PINMUX(HPMICRO_PIN(HPMICRO_PORTA, 9), IOC_TYPE_IOC, 0, 18)>;
		};
	};

	/omit-if-no-ref/ pa09_soc_ref0: pa09_soc_ref0 {
		group0 {
			pinmux = <HPMICRO_PINMUX(HPMICRO_PIN(HPMICRO_PORTA, 9), IOC_TYPE_IOC, 0, 24)>;
		};
	};

	/omit-if-no-ref/ pa10_gpio_a_10: pa10_gpio_a_10 {
		group0 {
			pinmux = <HPMICRO_PINMUX(HPMICRO_PIN(HPMICRO_PORTA, 10), IOC_TYPE_IOC, 0, 0)>;
		};
	};

	/omit-if-no-ref/ pa10_gptmr0_comp_2: pa10_gptmr0_comp_2 {
		group0 {
			pinmux = <HPMICRO_PINMUX(HPMICRO_PIN(HPMICRO_PORTA, 10), IOC_TYPE_IOC, 0, 1)>;
		};
	};

	/omit-if-no-ref/ pa10_uart2_de: pa10_uart2_de {
		group0 {
			pinmux = <HPMICRO_PINMUX(HPMICRO_PIN(HPMICRO_PORTA, 10), IOC_TYPE_IOC, 0, 2)>;
		};
	};

	/omit-if-no-ref/ pa10_uart2_rts: pa10_uart2_rts {
		group0 {
			pinmux = <HPMICRO_PINMUX(HPMICRO_PIN(HPMICRO_PORTA, 10), IOC_TYPE_IOC, 0, 3)>;
		};
	};

	/omit-if-no-ref/ pa10_spi3_cs_0: pa10_spi3_cs_0 {
		group0 {
			pinmux = <HPMICRO_PINMUX(HPMICRO_PIN(HPMICRO_PORTA, 10), IOC_TYPE_IOC, 0, 5)>;
		};
	};

	/omit-if-no-ref/ pa10_mcan2_stby: pa10_mcan2_stby {
		group0 {
			pinmux = <HPMICRO_PINMUX(HPMICRO_PIN(HPMICRO_PORTA, 10), IOC_TYPE_IOC, 0, 7)>;
		};
	};

	/omit-if-no-ref/ pa10_pwm0_p_6: pa10_pwm0_p_6 {
		group0 {
			pinmux = <HPMICRO_PINMUX(HPMICRO_PIN(HPMICRO_PORTA, 10), IOC_TYPE_IOC, 0, 16)>;
		};
	};

	/omit-if-no-ref/ pa10_pwm1_fault_0: pa10_pwm1_fault_0 {
		group0 {
			pinmux = <HPMICRO_PINMUX(HPMICRO_PIN(HPMICRO_PORTA, 10), IOC_TYPE_IOC, 0, 17)>;
		};
	};

	/omit-if-no-ref/ pa10_acmp_comp_0: pa10_acmp_comp_0 {
		group0 {
			pinmux = <HPMICRO_PINMUX(HPMICRO_PIN(HPMICRO_PORTA, 10), IOC_TYPE_IOC, 0, 18)>;
		};
	};

	/omit-if-no-ref/ pa10_qei1_a: pa10_qei1_a {
		group0 {
			pinmux = <HPMICRO_PINMUX(HPMICRO_PIN(HPMICRO_PORTA, 10), IOC_TYPE_IOC, 0, 20)>;
		};
	};

	/omit-if-no-ref/ pa10_qeo0_a: pa10_qeo0_a {
		group0 {
			pinmux = <HPMICRO_PINMUX(HPMICRO_PIN(HPMICRO_PORTA, 10), IOC_TYPE_IOC, 0, 21)>;
		};
	};

	/omit-if-no-ref/ pa10_sei1_de: pa10_sei1_de {
		group0 {
			pinmux = <HPMICRO_PINMUX(HPMICRO_PIN(HPMICRO_PORTA, 10), IOC_TYPE_IOC, 0, 22)>;
		};
	};

	/omit-if-no-ref/ pa11_gpio_a_11: pa11_gpio_a_11 {
		group0 {
			pinmux = <HPMICRO_PINMUX(HPMICRO_PIN(HPMICRO_PORTA, 11), IOC_TYPE_IOC, 0, 0)>;
		};
	};

	/omit-if-no-ref/ pa11_uart2_cts: pa11_uart2_cts {
		group0 {
			pinmux = <HPMICRO_PINMUX(HPMICRO_PIN(HPMICRO_PORTA, 11), IOC_TYPE_IOC, 0, 3)>;
		};
	};

	/omit-if-no-ref/ pa11_spi3_sclk: pa11_spi3_sclk {
		group0 {
			pinmux = <HPMICRO_PINMUX(HPMICRO_PIN(HPMICRO_PORTA, 11), IOC_TYPE_IOC, 0, 5)>;
		};
	};

	/omit-if-no-ref/ pa11_pwm0_p_7: pa11_pwm0_p_7 {
		group0 {
			pinmux = <HPMICRO_PINMUX(HPMICRO_PIN(HPMICRO_PORTA, 11), IOC_TYPE_IOC, 0, 16)>;
		};
	};

	/omit-if-no-ref/ pa11_pwm1_fault_1: pa11_pwm1_fault_1 {
		group0 {
			pinmux = <HPMICRO_PINMUX(HPMICRO_PIN(HPMICRO_PORTA, 11), IOC_TYPE_IOC, 0, 17)>;
		};
	};

	/omit-if-no-ref/ pa11_acmp_comp_1: pa11_acmp_comp_1 {
		group0 {
			pinmux = <HPMICRO_PINMUX(HPMICRO_PIN(HPMICRO_PORTA, 11), IOC_TYPE_IOC, 0, 18)>;
		};
	};

	/omit-if-no-ref/ pa11_qei1_b: pa11_qei1_b {
		group0 {
			pinmux = <HPMICRO_PINMUX(HPMICRO_PIN(HPMICRO_PORTA, 11), IOC_TYPE_IOC, 0, 20)>;
		};
	};

	/omit-if-no-ref/ pa11_qeo0_b: pa11_qeo0_b {
		group0 {
			pinmux = <HPMICRO_PINMUX(HPMICRO_PIN(HPMICRO_PORTA, 11), IOC_TYPE_IOC, 0, 21)>;
		};
	};

	/omit-if-no-ref/ pa11_sei1_ck: pa11_sei1_ck {
		group0 {
			pinmux = <HPMICRO_PINMUX(HPMICRO_PIN(HPMICRO_PORTA, 11), IOC_TYPE_IOC, 0, 22)>;
		};
	};

	/omit-if-no-ref/ pa11_ewdg0_rst: pa11_ewdg0_rst {
		group0 {
			pinmux = <HPMICRO_PINMUX(HPMICRO_PIN(HPMICRO_PORTA, 11), IOC_TYPE_IOC, 0, 24)>;
		};
	};

	/omit-if-no-ref/ pa12_gpio_a_12: pa12_gpio_a_12 {
		group0 {
			pinmux = <HPMICRO_PINMUX(HPMICRO_PIN(HPMICRO_PORTA, 12), IOC_TYPE_IOC, 0, 0)>;
		};
	};

	/omit-if-no-ref/ pa12_uart3_cts: pa12_uart3_cts {
		group0 {
			pinmux = <HPMICRO_PINMUX(HPMICRO_PIN(HPMICRO_PORTA, 12), IOC_TYPE_IOC, 0, 3)>;
		};
	};

	/omit-if-no-ref/ pa12_i2c3_sda: pa12_i2c3_sda {
		group0 {
			pinmux = <HPMICRO_PINMUX(HPMICRO_PIN(HPMICRO_PORTA, 12), IOC_TYPE_IOC, 0, 4)>;
		};
	};

	/omit-if-no-ref/ pa12_spi3_miso: pa12_spi3_miso {
		group0 {
			pinmux = <HPMICRO_PINMUX(HPMICRO_PIN(HPMICRO_PORTA, 12), IOC_TYPE_IOC, 0, 5)>;
		};
	};

	/omit-if-no-ref/ pa12_pwm0_p_0: pa12_pwm0_p_0 {
		group0 {
			pinmux = <HPMICRO_PINMUX(HPMICRO_PIN(HPMICRO_PORTA, 12), IOC_TYPE_IOC, 0, 16)>;
		};
	};

	/omit-if-no-ref/ pa12_pwm1_fault_0: pa12_pwm1_fault_0 {
		group0 {
			pinmux = <HPMICRO_PINMUX(HPMICRO_PIN(HPMICRO_PORTA, 12), IOC_TYPE_IOC, 0, 17)>;
		};
	};

	/omit-if-no-ref/ pa12_pwm0_fault_0: pa12_pwm0_fault_0 {
		group0 {
			pinmux = <HPMICRO_PINMUX(HPMICRO_PIN(HPMICRO_PORTA, 12), IOC_TYPE_IOC, 0, 18)>;
		};
	};

	/omit-if-no-ref/ pa12_rdc0_exc_p: pa12_rdc0_exc_p {
		group0 {
			pinmux = <HPMICRO_PINMUX(HPMICRO_PIN(HPMICRO_PORTA, 12), IOC_TYPE_IOC, 0, 19)>;
		};
	};

	/omit-if-no-ref/ pa12_qei1_z: pa12_qei1_z {
		group0 {
			pinmux = <HPMICRO_PINMUX(HPMICRO_PIN(HPMICRO_PORTA, 12), IOC_TYPE_IOC, 0, 20)>;
		};
	};

	/omit-if-no-ref/ pa12_qeo0_z: pa12_qeo0_z {
		group0 {
			pinmux = <HPMICRO_PINMUX(HPMICRO_PIN(HPMICRO_PORTA, 12), IOC_TYPE_IOC, 0, 21)>;
		};
	};

	/omit-if-no-ref/ pa12_sei1_tx: pa12_sei1_tx {
		group0 {
			pinmux = <HPMICRO_PINMUX(HPMICRO_PIN(HPMICRO_PORTA, 12), IOC_TYPE_IOC, 0, 22)>;
		};
	};

	/omit-if-no-ref/ pa13_gpio_a_13: pa13_gpio_a_13 {
		group0 {
			pinmux = <HPMICRO_PINMUX(HPMICRO_PIN(HPMICRO_PORTA, 13), IOC_TYPE_IOC, 0, 0)>;
		};
	};

	/omit-if-no-ref/ pa13_gptmr1_comp_3: pa13_gptmr1_comp_3 {
		group0 {
			pinmux = <HPMICRO_PINMUX(HPMICRO_PIN(HPMICRO_PORTA, 13), IOC_TYPE_IOC, 0, 1)>;
		};
	};

	/omit-if-no-ref/ pa13_uart3_de: pa13_uart3_de {
		group0 {
			pinmux = <HPMICRO_PINMUX(HPMICRO_PIN(HPMICRO_PORTA, 13), IOC_TYPE_IOC, 0, 2)>;
		};
	};

	/omit-if-no-ref/ pa13_uart3_rts: pa13_uart3_rts {
		group0 {
			pinmux = <HPMICRO_PINMUX(HPMICRO_PIN(HPMICRO_PORTA, 13), IOC_TYPE_IOC, 0, 3)>;
		};
	};

	/omit-if-no-ref/ pa13_i2c3_scl: pa13_i2c3_scl {
		group0 {
			pinmux = <HPMICRO_PINMUX(HPMICRO_PIN(HPMICRO_PORTA, 13), IOC_TYPE_IOC, 0, 4)>;
		};
	};

	/omit-if-no-ref/ pa13_spi3_mosi: pa13_spi3_mosi {
		group0 {
			pinmux = <HPMICRO_PINMUX(HPMICRO_PIN(HPMICRO_PORTA, 13), IOC_TYPE_IOC, 0, 5)>;
		};
	};

	/omit-if-no-ref/ pa13_mcan3_stby: pa13_mcan3_stby {
		group0 {
			pinmux = <HPMICRO_PINMUX(HPMICRO_PIN(HPMICRO_PORTA, 13), IOC_TYPE_IOC, 0, 7)>;
		};
	};

	/omit-if-no-ref/ pa13_pwm0_p_1: pa13_pwm0_p_1 {
		group0 {
			pinmux = <HPMICRO_PINMUX(HPMICRO_PIN(HPMICRO_PORTA, 13), IOC_TYPE_IOC, 0, 16)>;
		};
	};

	/omit-if-no-ref/ pa13_pwm1_fault_1: pa13_pwm1_fault_1 {
		group0 {
			pinmux = <HPMICRO_PINMUX(HPMICRO_PIN(HPMICRO_PORTA, 13), IOC_TYPE_IOC, 0, 17)>;
		};
	};

	/omit-if-no-ref/ pa13_pwm0_fault_1: pa13_pwm0_fault_1 {
		group0 {
			pinmux = <HPMICRO_PINMUX(HPMICRO_PIN(HPMICRO_PORTA, 13), IOC_TYPE_IOC, 0, 18)>;
		};
	};

	/omit-if-no-ref/ pa13_rdc0_exc_n: pa13_rdc0_exc_n {
		group0 {
			pinmux = <HPMICRO_PINMUX(HPMICRO_PIN(HPMICRO_PORTA, 13), IOC_TYPE_IOC, 0, 19)>;
		};
	};

	/omit-if-no-ref/ pa13_qei1_h0: pa13_qei1_h0 {
		group0 {
			pinmux = <HPMICRO_PINMUX(HPMICRO_PIN(HPMICRO_PORTA, 13), IOC_TYPE_IOC, 0, 20)>;
		};
	};

	/omit-if-no-ref/ pa13_sei1_rx: pa13_sei1_rx {
		group0 {
			pinmux = <HPMICRO_PINMUX(HPMICRO_PIN(HPMICRO_PORTA, 13), IOC_TYPE_IOC, 0, 22)>;
		};
	};

	/omit-if-no-ref/ pa14_gpio_a_14: pa14_gpio_a_14 {
		group0 {
			pinmux = <HPMICRO_PINMUX(HPMICRO_PIN(HPMICRO_PORTA, 14), IOC_TYPE_IOC, 0, 0)>;
		};
	};

	/omit-if-no-ref/ pa14_uart3_rxd: pa14_uart3_rxd {
		group0 {
			pinmux = <HPMICRO_PINMUX(HPMICRO_PIN(HPMICRO_PORTA, 14), IOC_TYPE_IOC, 0, 2)>;
		};
	};

	/omit-if-no-ref/ pa14_spi3_dat2: pa14_spi3_dat2 {
		group0 {
			pinmux = <HPMICRO_PINMUX(HPMICRO_PIN(HPMICRO_PORTA, 14), IOC_TYPE_IOC, 0, 5)>;
		};
	};

	/omit-if-no-ref/ pa14_mcan3_rxd: pa14_mcan3_rxd {
		group0 {
			pinmux = <HPMICRO_PINMUX(HPMICRO_PIN(HPMICRO_PORTA, 14), IOC_TYPE_IOC, 0, 7)>;
		};
	};

	/omit-if-no-ref/ pa14_pwm0_p_2: pa14_pwm0_p_2 {
		group0 {
			pinmux = <HPMICRO_PINMUX(HPMICRO_PIN(HPMICRO_PORTA, 14), IOC_TYPE_IOC, 0, 16)>;
		};
	};

	/omit-if-no-ref/ pa14_acmp_comp_0: pa14_acmp_comp_0 {
		group0 {
			pinmux = <HPMICRO_PINMUX(HPMICRO_PIN(HPMICRO_PORTA, 14), IOC_TYPE_IOC, 0, 18)>;
		};
	};

	/omit-if-no-ref/ pa14_qei1_h1: pa14_qei1_h1 {
		group0 {
			pinmux = <HPMICRO_PINMUX(HPMICRO_PIN(HPMICRO_PORTA, 14), IOC_TYPE_IOC, 0, 20)>;
		};
	};

	/omit-if-no-ref/ pa14_ewdg1_rst: pa14_ewdg1_rst {
		group0 {
			pinmux = <HPMICRO_PINMUX(HPMICRO_PIN(HPMICRO_PORTA, 14), IOC_TYPE_IOC, 0, 24)>;
		};
	};

	/omit-if-no-ref/ pa15_gpio_a_15: pa15_gpio_a_15 {
		group0 {
			pinmux = <HPMICRO_PINMUX(HPMICRO_PIN(HPMICRO_PORTA, 15), IOC_TYPE_IOC, 0, 0)>;
		};
	};

	/omit-if-no-ref/ pa15_gptmr0_comp_3: pa15_gptmr0_comp_3 {
		group0 {
			pinmux = <HPMICRO_PINMUX(HPMICRO_PIN(HPMICRO_PORTA, 15), IOC_TYPE_IOC, 0, 1)>;
		};
	};

	/omit-if-no-ref/ pa15_uart3_txd: pa15_uart3_txd {
		group0 {
			pinmux = <HPMICRO_PINMUX(HPMICRO_PIN(HPMICRO_PORTA, 15), IOC_TYPE_IOC, 0, 2)>;
		};
	};

	/omit-if-no-ref/ pa15_spi3_dat3: pa15_spi3_dat3 {
		group0 {
			pinmux = <HPMICRO_PINMUX(HPMICRO_PIN(HPMICRO_PORTA, 15), IOC_TYPE_IOC, 0, 5)>;
		};
	};

	/omit-if-no-ref/ pa15_mcan3_txd: pa15_mcan3_txd {
		group0 {
			pinmux = <HPMICRO_PINMUX(HPMICRO_PIN(HPMICRO_PORTA, 15), IOC_TYPE_IOC, 0, 7)>;
		};
	};

	/omit-if-no-ref/ pa15_pwm0_p_3: pa15_pwm0_p_3 {
		group0 {
			pinmux = <HPMICRO_PINMUX(HPMICRO_PIN(HPMICRO_PORTA, 15), IOC_TYPE_IOC, 0, 16)>;
		};
	};

	/omit-if-no-ref/ pa15_acmp_comp_1: pa15_acmp_comp_1 {
		group0 {
			pinmux = <HPMICRO_PINMUX(HPMICRO_PIN(HPMICRO_PORTA, 15), IOC_TYPE_IOC, 0, 18)>;
		};
	};

	/omit-if-no-ref/ pa15_qei1_f: pa15_qei1_f {
		group0 {
			pinmux = <HPMICRO_PINMUX(HPMICRO_PIN(HPMICRO_PORTA, 15), IOC_TYPE_IOC, 0, 20)>;
		};
	};

	/omit-if-no-ref/ pa15_soc_ref0: pa15_soc_ref0 {
		group0 {
			pinmux = <HPMICRO_PINMUX(HPMICRO_PIN(HPMICRO_PORTA, 15), IOC_TYPE_IOC, 0, 24)>;
		};
	};

	/omit-if-no-ref/ pa16_gpio_a_16: pa16_gpio_a_16 {
		group0 {
			pinmux = <HPMICRO_PINMUX(HPMICRO_PIN(HPMICRO_PORTA, 16), IOC_TYPE_IOC, 0, 0)>;
		};
	};

	/omit-if-no-ref/ pa16_gptmr3_comp_0: pa16_gptmr3_comp_0 {
		group0 {
			pinmux = <HPMICRO_PINMUX(HPMICRO_PIN(HPMICRO_PORTA, 16), IOC_TYPE_IOC, 0, 1)>;
		};
	};

	/omit-if-no-ref/ pa16_uart4_txd: pa16_uart4_txd {
		group0 {
			pinmux = <HPMICRO_PINMUX(HPMICRO_PIN(HPMICRO_PORTA, 16), IOC_TYPE_IOC, 0, 2)>;
		};
	};

	/omit-if-no-ref/ pa16_mcan0_txd: pa16_mcan0_txd {
		group0 {
			pinmux = <HPMICRO_PINMUX(HPMICRO_PIN(HPMICRO_PORTA, 16), IOC_TYPE_IOC, 0, 7)>;
		};
	};

	/omit-if-no-ref/ pa16_pwm0_p_4: pa16_pwm0_p_4 {
		group0 {
			pinmux = <HPMICRO_PINMUX(HPMICRO_PIN(HPMICRO_PORTA, 16), IOC_TYPE_IOC, 0, 16)>;
		};
	};

	/omit-if-no-ref/ pa16_pwm1_p_0: pa16_pwm1_p_0 {
		group0 {
			pinmux = <HPMICRO_PINMUX(HPMICRO_PIN(HPMICRO_PORTA, 16), IOC_TYPE_IOC, 0, 17)>;
		};
	};

	/omit-if-no-ref/ pa16_trgm0_p_04: pa16_trgm0_p_04 {
		group0 {
			pinmux = <HPMICRO_PINMUX(HPMICRO_PIN(HPMICRO_PORTA, 16), IOC_TYPE_IOC, 0, 18)>;
		};
	};

	/omit-if-no-ref/ pa16_qeo0_a: pa16_qeo0_a {
		group0 {
			pinmux = <HPMICRO_PINMUX(HPMICRO_PIN(HPMICRO_PORTA, 16), IOC_TYPE_IOC, 0, 21)>;
		};
	};

	/omit-if-no-ref/ pa16_sei1_de: pa16_sei1_de {
		group0 {
			pinmux = <HPMICRO_PINMUX(HPMICRO_PIN(HPMICRO_PORTA, 16), IOC_TYPE_IOC, 0, 22)>;
		};
	};

	/omit-if-no-ref/ pa17_gpio_a_17: pa17_gpio_a_17 {
		group0 {
			pinmux = <HPMICRO_PINMUX(HPMICRO_PIN(HPMICRO_PORTA, 17), IOC_TYPE_IOC, 0, 0)>;
		};
	};

	/omit-if-no-ref/ pa17_gptmr3_capt_0: pa17_gptmr3_capt_0 {
		group0 {
			pinmux = <HPMICRO_PINMUX(HPMICRO_PIN(HPMICRO_PORTA, 17), IOC_TYPE_IOC, 0, 1)>;
		};
	};

	/omit-if-no-ref/ pa17_uart4_rxd: pa17_uart4_rxd {
		group0 {
			pinmux = <HPMICRO_PINMUX(HPMICRO_PIN(HPMICRO_PORTA, 17), IOC_TYPE_IOC, 0, 2)>;
		};
	};

	/omit-if-no-ref/ pa17_mcan0_rxd: pa17_mcan0_rxd {
		group0 {
			pinmux = <HPMICRO_PINMUX(HPMICRO_PIN(HPMICRO_PORTA, 17), IOC_TYPE_IOC, 0, 7)>;
		};
	};

	/omit-if-no-ref/ pa17_pwm0_p_5: pa17_pwm0_p_5 {
		group0 {
			pinmux = <HPMICRO_PINMUX(HPMICRO_PIN(HPMICRO_PORTA, 17), IOC_TYPE_IOC, 0, 16)>;
		};
	};

	/omit-if-no-ref/ pa17_pwm1_p_1: pa17_pwm1_p_1 {
		group0 {
			pinmux = <HPMICRO_PINMUX(HPMICRO_PIN(HPMICRO_PORTA, 17), IOC_TYPE_IOC, 0, 17)>;
		};
	};

	/omit-if-no-ref/ pa17_trgm0_p_05: pa17_trgm0_p_05 {
		group0 {
			pinmux = <HPMICRO_PINMUX(HPMICRO_PIN(HPMICRO_PORTA, 17), IOC_TYPE_IOC, 0, 18)>;
		};
	};

	/omit-if-no-ref/ pa17_qeo0_b: pa17_qeo0_b {
		group0 {
			pinmux = <HPMICRO_PINMUX(HPMICRO_PIN(HPMICRO_PORTA, 17), IOC_TYPE_IOC, 0, 21)>;
		};
	};

	/omit-if-no-ref/ pa17_sei1_ck: pa17_sei1_ck {
		group0 {
			pinmux = <HPMICRO_PINMUX(HPMICRO_PIN(HPMICRO_PORTA, 17), IOC_TYPE_IOC, 0, 22)>;
		};
	};

	/omit-if-no-ref/ pa18_gpio_a_18: pa18_gpio_a_18 {
		group0 {
			pinmux = <HPMICRO_PINMUX(HPMICRO_PIN(HPMICRO_PORTA, 18), IOC_TYPE_IOC, 0, 0)>;
		};
	};

	/omit-if-no-ref/ pa18_gptmr3_comp_1: pa18_gptmr3_comp_1 {
		group0 {
			pinmux = <HPMICRO_PINMUX(HPMICRO_PIN(HPMICRO_PORTA, 18), IOC_TYPE_IOC, 0, 1)>;
		};
	};

	/omit-if-no-ref/ pa18_uart4_de: pa18_uart4_de {
		group0 {
			pinmux = <HPMICRO_PINMUX(HPMICRO_PIN(HPMICRO_PORTA, 18), IOC_TYPE_IOC, 0, 2)>;
		};
	};

	/omit-if-no-ref/ pa18_uart4_rts: pa18_uart4_rts {
		group0 {
			pinmux = <HPMICRO_PINMUX(HPMICRO_PIN(HPMICRO_PORTA, 18), IOC_TYPE_IOC, 0, 3)>;
		};
	};

	/omit-if-no-ref/ pa18_i2c0_scl: pa18_i2c0_scl {
		group0 {
			pinmux = <HPMICRO_PINMUX(HPMICRO_PIN(HPMICRO_PORTA, 18), IOC_TYPE_IOC, 0, 4)>;
		};
	};

	/omit-if-no-ref/ pa18_mcan0_stby: pa18_mcan0_stby {
		group0 {
			pinmux = <HPMICRO_PINMUX(HPMICRO_PIN(HPMICRO_PORTA, 18), IOC_TYPE_IOC, 0, 7)>;
		};
	};

	/omit-if-no-ref/ pa18_pwm0_p_6: pa18_pwm0_p_6 {
		group0 {
			pinmux = <HPMICRO_PINMUX(HPMICRO_PIN(HPMICRO_PORTA, 18), IOC_TYPE_IOC, 0, 16)>;
		};
	};

	/omit-if-no-ref/ pa18_pwm1_p_2: pa18_pwm1_p_2 {
		group0 {
			pinmux = <HPMICRO_PINMUX(HPMICRO_PIN(HPMICRO_PORTA, 18), IOC_TYPE_IOC, 0, 17)>;
		};
	};

	/omit-if-no-ref/ pa18_trgm0_p_06: pa18_trgm0_p_06 {
		group0 {
			pinmux = <HPMICRO_PINMUX(HPMICRO_PIN(HPMICRO_PORTA, 18), IOC_TYPE_IOC, 0, 18)>;
		};
	};

	/omit-if-no-ref/ pa18_qeo0_z: pa18_qeo0_z {
		group0 {
			pinmux = <HPMICRO_PINMUX(HPMICRO_PIN(HPMICRO_PORTA, 18), IOC_TYPE_IOC, 0, 21)>;
		};
	};

	/omit-if-no-ref/ pa18_sei1_tx: pa18_sei1_tx {
		group0 {
			pinmux = <HPMICRO_PINMUX(HPMICRO_PIN(HPMICRO_PORTA, 18), IOC_TYPE_IOC, 0, 22)>;
		};
	};

	/omit-if-no-ref/ pa19_gpio_a_19: pa19_gpio_a_19 {
		group0 {
			pinmux = <HPMICRO_PINMUX(HPMICRO_PIN(HPMICRO_PORTA, 19), IOC_TYPE_IOC, 0, 0)>;
		};
	};

	/omit-if-no-ref/ pa19_gptmr3_capt_1: pa19_gptmr3_capt_1 {
		group0 {
			pinmux = <HPMICRO_PINMUX(HPMICRO_PIN(HPMICRO_PORTA, 19), IOC_TYPE_IOC, 0, 1)>;
		};
	};

	/omit-if-no-ref/ pa19_uart4_cts: pa19_uart4_cts {
		group0 {
			pinmux = <HPMICRO_PINMUX(HPMICRO_PIN(HPMICRO_PORTA, 19), IOC_TYPE_IOC, 0, 3)>;
		};
	};

	/omit-if-no-ref/ pa19_i2c0_sda: pa19_i2c0_sda {
		group0 {
			pinmux = <HPMICRO_PINMUX(HPMICRO_PIN(HPMICRO_PORTA, 19), IOC_TYPE_IOC, 0, 4)>;
		};
	};

	/omit-if-no-ref/ pa19_spi1_cs_3: pa19_spi1_cs_3 {
		group0 {
			pinmux = <HPMICRO_PINMUX(HPMICRO_PIN(HPMICRO_PORTA, 19), IOC_TYPE_IOC, 0, 5)>;
		};
	};

	/omit-if-no-ref/ pa19_mcan1_stby: pa19_mcan1_stby {
		group0 {
			pinmux = <HPMICRO_PINMUX(HPMICRO_PIN(HPMICRO_PORTA, 19), IOC_TYPE_IOC, 0, 7)>;
		};
	};

	/omit-if-no-ref/ pa19_pwm0_p_7: pa19_pwm0_p_7 {
		group0 {
			pinmux = <HPMICRO_PINMUX(HPMICRO_PIN(HPMICRO_PORTA, 19), IOC_TYPE_IOC, 0, 16)>;
		};
	};

	/omit-if-no-ref/ pa19_pwm1_p_3: pa19_pwm1_p_3 {
		group0 {
			pinmux = <HPMICRO_PINMUX(HPMICRO_PIN(HPMICRO_PORTA, 19), IOC_TYPE_IOC, 0, 17)>;
		};
	};

	/omit-if-no-ref/ pa19_trgm0_p_07: pa19_trgm0_p_07 {
		group0 {
			pinmux = <HPMICRO_PINMUX(HPMICRO_PIN(HPMICRO_PORTA, 19), IOC_TYPE_IOC, 0, 18)>;
		};
	};

	/omit-if-no-ref/ pa19_sei1_rx: pa19_sei1_rx {
		group0 {
			pinmux = <HPMICRO_PINMUX(HPMICRO_PIN(HPMICRO_PORTA, 19), IOC_TYPE_IOC, 0, 22)>;
		};
	};

	/omit-if-no-ref/ pa20_gpio_a_20: pa20_gpio_a_20 {
		group0 {
			pinmux = <HPMICRO_PINMUX(HPMICRO_PIN(HPMICRO_PORTA, 20), IOC_TYPE_IOC, 0, 0)>;
		};
	};

	/omit-if-no-ref/ pa20_uart5_cts: pa20_uart5_cts {
		group0 {
			pinmux = <HPMICRO_PINMUX(HPMICRO_PIN(HPMICRO_PORTA, 20), IOC_TYPE_IOC, 0, 3)>;
		};
	};

	/omit-if-no-ref/ pa20_spi2_cs_0: pa20_spi2_cs_0 {
		group0 {
			pinmux = <HPMICRO_PINMUX(HPMICRO_PIN(HPMICRO_PORTA, 20), IOC_TYPE_IOC, 0, 5)>;
		};
	};

	/omit-if-no-ref/ pa20_mcan1_rxd: pa20_mcan1_rxd {
		group0 {
			pinmux = <HPMICRO_PINMUX(HPMICRO_PIN(HPMICRO_PORTA, 20), IOC_TYPE_IOC, 0, 7)>;
		};
	};

	/omit-if-no-ref/ pa20_pwm0_fault_0: pa20_pwm0_fault_0 {
		group0 {
			pinmux = <HPMICRO_PINMUX(HPMICRO_PIN(HPMICRO_PORTA, 20), IOC_TYPE_IOC, 0, 16)>;
		};
	};

	/omit-if-no-ref/ pa20_pwm1_p_4: pa20_pwm1_p_4 {
		group0 {
			pinmux = <HPMICRO_PINMUX(HPMICRO_PIN(HPMICRO_PORTA, 20), IOC_TYPE_IOC, 0, 17)>;
		};
	};

	/omit-if-no-ref/ pa20_trgm0_p_00: pa20_trgm0_p_00 {
		group0 {
			pinmux = <HPMICRO_PINMUX(HPMICRO_PIN(HPMICRO_PORTA, 20), IOC_TYPE_IOC, 0, 18)>;
		};
	};

	/omit-if-no-ref/ pa20_qei0_a: pa20_qei0_a {
		group0 {
			pinmux = <HPMICRO_PINMUX(HPMICRO_PIN(HPMICRO_PORTA, 20), IOC_TYPE_IOC, 0, 20)>;
		};
	};

	/omit-if-no-ref/ pa20_qeo0_a: pa20_qeo0_a {
		group0 {
			pinmux = <HPMICRO_PINMUX(HPMICRO_PIN(HPMICRO_PORTA, 20), IOC_TYPE_IOC, 0, 21)>;
		};
	};

	/omit-if-no-ref/ pa20_sei0_de: pa20_sei0_de {
		group0 {
			pinmux = <HPMICRO_PINMUX(HPMICRO_PIN(HPMICRO_PORTA, 20), IOC_TYPE_IOC, 0, 22)>;
		};
	};

	/omit-if-no-ref/ pa21_gpio_a_21: pa21_gpio_a_21 {
		group0 {
			pinmux = <HPMICRO_PINMUX(HPMICRO_PIN(HPMICRO_PORTA, 21), IOC_TYPE_IOC, 0, 0)>;
		};
	};

	/omit-if-no-ref/ pa21_gptmr3_comp_2: pa21_gptmr3_comp_2 {
		group0 {
			pinmux = <HPMICRO_PINMUX(HPMICRO_PIN(HPMICRO_PORTA, 21), IOC_TYPE_IOC, 0, 1)>;
		};
	};

	/omit-if-no-ref/ pa21_uart5_de: pa21_uart5_de {
		group0 {
			pinmux = <HPMICRO_PINMUX(HPMICRO_PIN(HPMICRO_PORTA, 21), IOC_TYPE_IOC, 0, 2)>;
		};
	};

	/omit-if-no-ref/ pa21_uart5_rts: pa21_uart5_rts {
		group0 {
			pinmux = <HPMICRO_PINMUX(HPMICRO_PIN(HPMICRO_PORTA, 21), IOC_TYPE_IOC, 0, 3)>;
		};
	};

	/omit-if-no-ref/ pa21_spi2_sclk: pa21_spi2_sclk {
		group0 {
			pinmux = <HPMICRO_PINMUX(HPMICRO_PIN(HPMICRO_PORTA, 21), IOC_TYPE_IOC, 0, 5)>;
		};
	};

	/omit-if-no-ref/ pa21_mcan1_txd: pa21_mcan1_txd {
		group0 {
			pinmux = <HPMICRO_PINMUX(HPMICRO_PIN(HPMICRO_PORTA, 21), IOC_TYPE_IOC, 0, 7)>;
		};
	};

	/omit-if-no-ref/ pa21_pwm0_fault_1: pa21_pwm0_fault_1 {
		group0 {
			pinmux = <HPMICRO_PINMUX(HPMICRO_PIN(HPMICRO_PORTA, 21), IOC_TYPE_IOC, 0, 16)>;
		};
	};

	/omit-if-no-ref/ pa21_pwm1_p_5: pa21_pwm1_p_5 {
		group0 {
			pinmux = <HPMICRO_PINMUX(HPMICRO_PIN(HPMICRO_PORTA, 21), IOC_TYPE_IOC, 0, 17)>;
		};
	};

	/omit-if-no-ref/ pa21_trgm0_p_01: pa21_trgm0_p_01 {
		group0 {
			pinmux = <HPMICRO_PINMUX(HPMICRO_PIN(HPMICRO_PORTA, 21), IOC_TYPE_IOC, 0, 18)>;
		};
	};

	/omit-if-no-ref/ pa21_qei0_b: pa21_qei0_b {
		group0 {
			pinmux = <HPMICRO_PINMUX(HPMICRO_PIN(HPMICRO_PORTA, 21), IOC_TYPE_IOC, 0, 20)>;
		};
	};

	/omit-if-no-ref/ pa21_qeo0_b: pa21_qeo0_b {
		group0 {
			pinmux = <HPMICRO_PINMUX(HPMICRO_PIN(HPMICRO_PORTA, 21), IOC_TYPE_IOC, 0, 21)>;
		};
	};

	/omit-if-no-ref/ pa21_sei0_ck: pa21_sei0_ck {
		group0 {
			pinmux = <HPMICRO_PINMUX(HPMICRO_PIN(HPMICRO_PORTA, 21), IOC_TYPE_IOC, 0, 22)>;
		};
	};

	/omit-if-no-ref/ pa22_gpio_a_22: pa22_gpio_a_22 {
		group0 {
			pinmux = <HPMICRO_PINMUX(HPMICRO_PIN(HPMICRO_PORTA, 22), IOC_TYPE_IOC, 0, 0)>;
		};
	};

	/omit-if-no-ref/ pa22_gptmr2_capt_0: pa22_gptmr2_capt_0 {
		group0 {
			pinmux = <HPMICRO_PINMUX(HPMICRO_PIN(HPMICRO_PORTA, 22), IOC_TYPE_IOC, 0, 1)>;
		};
	};

	/omit-if-no-ref/ pa22_uart5_rxd: pa22_uart5_rxd {
		group0 {
			pinmux = <HPMICRO_PINMUX(HPMICRO_PIN(HPMICRO_PORTA, 22), IOC_TYPE_IOC, 0, 2)>;
		};
	};

	/omit-if-no-ref/ pa22_i2c1_sda: pa22_i2c1_sda {
		group0 {
			pinmux = <HPMICRO_PINMUX(HPMICRO_PIN(HPMICRO_PORTA, 22), IOC_TYPE_IOC, 0, 4)>;
		};
	};

	/omit-if-no-ref/ pa22_spi2_miso: pa22_spi2_miso {
		group0 {
			pinmux = <HPMICRO_PINMUX(HPMICRO_PIN(HPMICRO_PORTA, 22), IOC_TYPE_IOC, 0, 5)>;
		};
	};

	/omit-if-no-ref/ pa22_pwm1_p_6: pa22_pwm1_p_6 {
		group0 {
			pinmux = <HPMICRO_PINMUX(HPMICRO_PIN(HPMICRO_PORTA, 22), IOC_TYPE_IOC, 0, 17)>;
		};
	};

	/omit-if-no-ref/ pa22_trgm0_p_02: pa22_trgm0_p_02 {
		group0 {
			pinmux = <HPMICRO_PINMUX(HPMICRO_PIN(HPMICRO_PORTA, 22), IOC_TYPE_IOC, 0, 18)>;
		};
	};

	/omit-if-no-ref/ pa22_pwm1_fault_0: pa22_pwm1_fault_0 {
		group0 {
			pinmux = <HPMICRO_PINMUX(HPMICRO_PIN(HPMICRO_PORTA, 22), IOC_TYPE_IOC, 0, 19)>;
		};
	};

	/omit-if-no-ref/ pa22_qei0_z: pa22_qei0_z {
		group0 {
			pinmux = <HPMICRO_PINMUX(HPMICRO_PIN(HPMICRO_PORTA, 22), IOC_TYPE_IOC, 0, 20)>;
		};
	};

	/omit-if-no-ref/ pa22_qeo0_z: pa22_qeo0_z {
		group0 {
			pinmux = <HPMICRO_PINMUX(HPMICRO_PIN(HPMICRO_PORTA, 22), IOC_TYPE_IOC, 0, 21)>;
		};
	};

	/omit-if-no-ref/ pa22_sei0_tx: pa22_sei0_tx {
		group0 {
			pinmux = <HPMICRO_PINMUX(HPMICRO_PIN(HPMICRO_PORTA, 22), IOC_TYPE_IOC, 0, 22)>;
		};
	};

	/omit-if-no-ref/ pa23_gpio_a_23: pa23_gpio_a_23 {
		group0 {
			pinmux = <HPMICRO_PINMUX(HPMICRO_PIN(HPMICRO_PORTA, 23), IOC_TYPE_IOC, 0, 0)>;
		};
	};

	/omit-if-no-ref/ pa23_gptmr2_comp_0: pa23_gptmr2_comp_0 {
		group0 {
			pinmux = <HPMICRO_PINMUX(HPMICRO_PIN(HPMICRO_PORTA, 23), IOC_TYPE_IOC, 0, 1)>;
		};
	};

	/omit-if-no-ref/ pa23_uart5_txd: pa23_uart5_txd {
		group0 {
			pinmux = <HPMICRO_PINMUX(HPMICRO_PIN(HPMICRO_PORTA, 23), IOC_TYPE_IOC, 0, 2)>;
		};
	};

	/omit-if-no-ref/ pa23_i2c1_scl: pa23_i2c1_scl {
		group0 {
			pinmux = <HPMICRO_PINMUX(HPMICRO_PIN(HPMICRO_PORTA, 23), IOC_TYPE_IOC, 0, 4)>;
		};
	};

	/omit-if-no-ref/ pa23_spi2_mosi: pa23_spi2_mosi {
		group0 {
			pinmux = <HPMICRO_PINMUX(HPMICRO_PIN(HPMICRO_PORTA, 23), IOC_TYPE_IOC, 0, 5)>;
		};
	};

	/omit-if-no-ref/ pa23_pwm1_p_7: pa23_pwm1_p_7 {
		group0 {
			pinmux = <HPMICRO_PINMUX(HPMICRO_PIN(HPMICRO_PORTA, 23), IOC_TYPE_IOC, 0, 17)>;
		};
	};

	/omit-if-no-ref/ pa23_trgm0_p_03: pa23_trgm0_p_03 {
		group0 {
			pinmux = <HPMICRO_PINMUX(HPMICRO_PIN(HPMICRO_PORTA, 23), IOC_TYPE_IOC, 0, 18)>;
		};
	};

	/omit-if-no-ref/ pa23_pwm1_fault_1: pa23_pwm1_fault_1 {
		group0 {
			pinmux = <HPMICRO_PINMUX(HPMICRO_PIN(HPMICRO_PORTA, 23), IOC_TYPE_IOC, 0, 19)>;
		};
	};

	/omit-if-no-ref/ pa23_qei0_h0: pa23_qei0_h0 {
		group0 {
			pinmux = <HPMICRO_PINMUX(HPMICRO_PIN(HPMICRO_PORTA, 23), IOC_TYPE_IOC, 0, 20)>;
		};
	};

	/omit-if-no-ref/ pa23_sei0_rx: pa23_sei0_rx {
		group0 {
			pinmux = <HPMICRO_PINMUX(HPMICRO_PIN(HPMICRO_PORTA, 23), IOC_TYPE_IOC, 0, 22)>;
		};
	};

	/omit-if-no-ref/ pa24_gpio_a_24: pa24_gpio_a_24 {
		group0 {
			pinmux = <HPMICRO_PINMUX(HPMICRO_PIN(HPMICRO_PORTA, 24), IOC_TYPE_IOC, 0, 0)>;
		};
	};

	/omit-if-no-ref/ pa24_gptmr2_comp_1: pa24_gptmr2_comp_1 {
		group0 {
			pinmux = <HPMICRO_PINMUX(HPMICRO_PIN(HPMICRO_PORTA, 24), IOC_TYPE_IOC, 0, 1)>;
		};
	};

	/omit-if-no-ref/ pa24_uart6_txd: pa24_uart6_txd {
		group0 {
			pinmux = <HPMICRO_PINMUX(HPMICRO_PIN(HPMICRO_PORTA, 24), IOC_TYPE_IOC, 0, 2)>;
		};
	};

	/omit-if-no-ref/ pa24_i2c2_scl: pa24_i2c2_scl {
		group0 {
			pinmux = <HPMICRO_PINMUX(HPMICRO_PIN(HPMICRO_PORTA, 24), IOC_TYPE_IOC, 0, 4)>;
		};
	};

	/omit-if-no-ref/ pa24_spi1_cs_2: pa24_spi1_cs_2 {
		group0 {
			pinmux = <HPMICRO_PINMUX(HPMICRO_PIN(HPMICRO_PORTA, 24), IOC_TYPE_IOC, 0, 5)>;
		};
	};

	/omit-if-no-ref/ pa24_mcan2_txd: pa24_mcan2_txd {
		group0 {
			pinmux = <HPMICRO_PINMUX(HPMICRO_PIN(HPMICRO_PORTA, 24), IOC_TYPE_IOC, 0, 7)>;
		};
	};

	/omit-if-no-ref/ pa24_xpi0_ca_cs1: pa24_xpi0_ca_cs1 {
		group0 {
			pinmux = <HPMICRO_PINMUX(HPMICRO_PIN(HPMICRO_PORTA, 24), IOC_TYPE_IOC, 0, 14)>;
		};
	};

	/omit-if-no-ref/ pa24_pwm0_p_0: pa24_pwm0_p_0 {
		group0 {
			pinmux = <HPMICRO_PINMUX(HPMICRO_PIN(HPMICRO_PORTA, 24), IOC_TYPE_IOC, 0, 16)>;
		};
	};

	/omit-if-no-ref/ pa24_pwm1_p_0: pa24_pwm1_p_0 {
		group0 {
			pinmux = <HPMICRO_PINMUX(HPMICRO_PIN(HPMICRO_PORTA, 24), IOC_TYPE_IOC, 0, 17)>;
		};
	};

	/omit-if-no-ref/ pa24_trgm0_p_00: pa24_trgm0_p_00 {
		group0 {
			pinmux = <HPMICRO_PINMUX(HPMICRO_PIN(HPMICRO_PORTA, 24), IOC_TYPE_IOC, 0, 18)>;
		};
	};

	/omit-if-no-ref/ pa24_qei0_h1: pa24_qei0_h1 {
		group0 {
			pinmux = <HPMICRO_PINMUX(HPMICRO_PIN(HPMICRO_PORTA, 24), IOC_TYPE_IOC, 0, 20)>;
		};
	};

	/omit-if-no-ref/ pa25_gpio_a_25: pa25_gpio_a_25 {
		group0 {
			pinmux = <HPMICRO_PINMUX(HPMICRO_PIN(HPMICRO_PORTA, 25), IOC_TYPE_IOC, 0, 0)>;
		};
	};

	/omit-if-no-ref/ pa25_gptmr2_capt_1: pa25_gptmr2_capt_1 {
		group0 {
			pinmux = <HPMICRO_PINMUX(HPMICRO_PIN(HPMICRO_PORTA, 25), IOC_TYPE_IOC, 0, 1)>;
		};
	};

	/omit-if-no-ref/ pa25_uart6_rxd: pa25_uart6_rxd {
		group0 {
			pinmux = <HPMICRO_PINMUX(HPMICRO_PIN(HPMICRO_PORTA, 25), IOC_TYPE_IOC, 0, 2)>;
		};
	};

	/omit-if-no-ref/ pa25_i2c2_sda: pa25_i2c2_sda {
		group0 {
			pinmux = <HPMICRO_PINMUX(HPMICRO_PIN(HPMICRO_PORTA, 25), IOC_TYPE_IOC, 0, 4)>;
		};
	};

	/omit-if-no-ref/ pa25_spi1_cs_1: pa25_spi1_cs_1 {
		group0 {
			pinmux = <HPMICRO_PINMUX(HPMICRO_PIN(HPMICRO_PORTA, 25), IOC_TYPE_IOC, 0, 5)>;
		};
	};

	/omit-if-no-ref/ pa25_mcan2_rxd: pa25_mcan2_rxd {
		group0 {
			pinmux = <HPMICRO_PINMUX(HPMICRO_PIN(HPMICRO_PORTA, 25), IOC_TYPE_IOC, 0, 7)>;
		};
	};

	/omit-if-no-ref/ pa25_xpi0_ca_dqs: pa25_xpi0_ca_dqs {
		group0 {
			pinmux = <HPMICRO_PINMUX(HPMICRO_PIN(HPMICRO_PORTA, 25), IOC_TYPE_IOC, 0, 14)>;
		};
	};

	/omit-if-no-ref/ pa25_pwm0_p_1: pa25_pwm0_p_1 {
		group0 {
			pinmux = <HPMICRO_PINMUX(HPMICRO_PIN(HPMICRO_PORTA, 25), IOC_TYPE_IOC, 0, 16)>;
		};
	};

	/omit-if-no-ref/ pa25_pwm1_p_1: pa25_pwm1_p_1 {
		group0 {
			pinmux = <HPMICRO_PINMUX(HPMICRO_PIN(HPMICRO_PORTA, 25), IOC_TYPE_IOC, 0, 17)>;
		};
	};

	/omit-if-no-ref/ pa25_trgm0_p_01: pa25_trgm0_p_01 {
		group0 {
			pinmux = <HPMICRO_PINMUX(HPMICRO_PIN(HPMICRO_PORTA, 25), IOC_TYPE_IOC, 0, 18)>;
		};
	};

	/omit-if-no-ref/ pa25_qei0_f: pa25_qei0_f {
		group0 {
			pinmux = <HPMICRO_PINMUX(HPMICRO_PIN(HPMICRO_PORTA, 25), IOC_TYPE_IOC, 0, 20)>;
		};
	};

	/omit-if-no-ref/ pa26_gpio_a_26: pa26_gpio_a_26 {
		group0 {
			pinmux = <HPMICRO_PINMUX(HPMICRO_PIN(HPMICRO_PORTA, 26), IOC_TYPE_IOC, 0, 0)>;
		};
	};

	/omit-if-no-ref/ pa26_gptmr2_comp_2: pa26_gptmr2_comp_2 {
		group0 {
			pinmux = <HPMICRO_PINMUX(HPMICRO_PIN(HPMICRO_PORTA, 26), IOC_TYPE_IOC, 0, 1)>;
		};
	};

	/omit-if-no-ref/ pa26_uart6_de: pa26_uart6_de {
		group0 {
			pinmux = <HPMICRO_PINMUX(HPMICRO_PIN(HPMICRO_PORTA, 26), IOC_TYPE_IOC, 0, 2)>;
		};
	};

	/omit-if-no-ref/ pa26_uart6_rts: pa26_uart6_rts {
		group0 {
			pinmux = <HPMICRO_PINMUX(HPMICRO_PIN(HPMICRO_PORTA, 26), IOC_TYPE_IOC, 0, 3)>;
		};
	};

	/omit-if-no-ref/ pa26_spi1_cs_0: pa26_spi1_cs_0 {
		group0 {
			pinmux = <HPMICRO_PINMUX(HPMICRO_PIN(HPMICRO_PORTA, 26), IOC_TYPE_IOC, 0, 5)>;
		};
	};

	/omit-if-no-ref/ pa26_mcan2_stby: pa26_mcan2_stby {
		group0 {
			pinmux = <HPMICRO_PINMUX(HPMICRO_PIN(HPMICRO_PORTA, 26), IOC_TYPE_IOC, 0, 7)>;
		};
	};

	/omit-if-no-ref/ pa26_xpi0_ca_d_3: pa26_xpi0_ca_d_3 {
		group0 {
			pinmux = <HPMICRO_PINMUX(HPMICRO_PIN(HPMICRO_PORTA, 26), IOC_TYPE_IOC, 0, 14)>;
		};
	};

	/omit-if-no-ref/ pa26_pwm0_p_2: pa26_pwm0_p_2 {
		group0 {
			pinmux = <HPMICRO_PINMUX(HPMICRO_PIN(HPMICRO_PORTA, 26), IOC_TYPE_IOC, 0, 16)>;
		};
	};

	/omit-if-no-ref/ pa26_pwm1_p_2: pa26_pwm1_p_2 {
		group0 {
			pinmux = <HPMICRO_PINMUX(HPMICRO_PIN(HPMICRO_PORTA, 26), IOC_TYPE_IOC, 0, 17)>;
		};
	};

	/omit-if-no-ref/ pa26_trgm0_p_02: pa26_trgm0_p_02 {
		group0 {
			pinmux = <HPMICRO_PINMUX(HPMICRO_PIN(HPMICRO_PORTA, 26), IOC_TYPE_IOC, 0, 18)>;
		};
	};

	/omit-if-no-ref/ pa26_qei0_a: pa26_qei0_a {
		group0 {
			pinmux = <HPMICRO_PINMUX(HPMICRO_PIN(HPMICRO_PORTA, 26), IOC_TYPE_IOC, 0, 20)>;
		};
	};

	/omit-if-no-ref/ pa26_qeo0_a: pa26_qeo0_a {
		group0 {
			pinmux = <HPMICRO_PINMUX(HPMICRO_PIN(HPMICRO_PORTA, 26), IOC_TYPE_IOC, 0, 21)>;
		};
	};

	/omit-if-no-ref/ pa26_sei0_de: pa26_sei0_de {
		group0 {
			pinmux = <HPMICRO_PINMUX(HPMICRO_PIN(HPMICRO_PORTA, 26), IOC_TYPE_IOC, 0, 22)>;
		};
	};

	/omit-if-no-ref/ pa26_sysctl_clk_obs_0: pa26_sysctl_clk_obs_0 {
		group0 {
			pinmux = <HPMICRO_PINMUX(HPMICRO_PIN(HPMICRO_PORTA, 26), IOC_TYPE_IOC, 0, 24)>;
		};
	};

	/omit-if-no-ref/ pa27_gpio_a_27: pa27_gpio_a_27 {
		group0 {
			pinmux = <HPMICRO_PINMUX(HPMICRO_PIN(HPMICRO_PORTA, 27), IOC_TYPE_IOC, 0, 0)>;
		};
	};

	/omit-if-no-ref/ pa27_uart6_cts: pa27_uart6_cts {
		group0 {
			pinmux = <HPMICRO_PINMUX(HPMICRO_PIN(HPMICRO_PORTA, 27), IOC_TYPE_IOC, 0, 3)>;
		};
	};

	/omit-if-no-ref/ pa27_spi1_sclk: pa27_spi1_sclk {
		group0 {
			pinmux = <HPMICRO_PINMUX(HPMICRO_PIN(HPMICRO_PORTA, 27), IOC_TYPE_IOC, 0, 5)>;
		};
	};

	/omit-if-no-ref/ pa27_xpi0_ca_sclk: pa27_xpi0_ca_sclk {
		group0 {
			pinmux = <HPMICRO_PINMUX(HPMICRO_PIN(HPMICRO_PORTA, 27), IOC_TYPE_IOC, 0, 14)>;
		};
	};

	/omit-if-no-ref/ pa27_pwm0_p_3: pa27_pwm0_p_3 {
		group0 {
			pinmux = <HPMICRO_PINMUX(HPMICRO_PIN(HPMICRO_PORTA, 27), IOC_TYPE_IOC, 0, 16)>;
		};
	};

	/omit-if-no-ref/ pa27_pwm1_p_3: pa27_pwm1_p_3 {
		group0 {
			pinmux = <HPMICRO_PINMUX(HPMICRO_PIN(HPMICRO_PORTA, 27), IOC_TYPE_IOC, 0, 17)>;
		};
	};

	/omit-if-no-ref/ pa27_trgm0_p_03: pa27_trgm0_p_03 {
		group0 {
			pinmux = <HPMICRO_PINMUX(HPMICRO_PIN(HPMICRO_PORTA, 27), IOC_TYPE_IOC, 0, 18)>;
		};
	};

	/omit-if-no-ref/ pa27_qei0_b: pa27_qei0_b {
		group0 {
			pinmux = <HPMICRO_PINMUX(HPMICRO_PIN(HPMICRO_PORTA, 27), IOC_TYPE_IOC, 0, 20)>;
		};
	};

	/omit-if-no-ref/ pa27_qeo0_b: pa27_qeo0_b {
		group0 {
			pinmux = <HPMICRO_PINMUX(HPMICRO_PIN(HPMICRO_PORTA, 27), IOC_TYPE_IOC, 0, 21)>;
		};
	};

	/omit-if-no-ref/ pa27_sei0_ck: pa27_sei0_ck {
		group0 {
			pinmux = <HPMICRO_PINMUX(HPMICRO_PIN(HPMICRO_PORTA, 27), IOC_TYPE_IOC, 0, 22)>;
		};
	};

	/omit-if-no-ref/ pa27_sysctl_clk_obs_1: pa27_sysctl_clk_obs_1 {
		group0 {
			pinmux = <HPMICRO_PINMUX(HPMICRO_PIN(HPMICRO_PORTA, 27), IOC_TYPE_IOC, 0, 24)>;
		};
	};

	/omit-if-no-ref/ pa28_gpio_a_28: pa28_gpio_a_28 {
		group0 {
			pinmux = <HPMICRO_PINMUX(HPMICRO_PIN(HPMICRO_PORTA, 28), IOC_TYPE_IOC, 0, 0)>;
		};
	};

	/omit-if-no-ref/ pa28_uart7_cts: pa28_uart7_cts {
		group0 {
			pinmux = <HPMICRO_PINMUX(HPMICRO_PIN(HPMICRO_PORTA, 28), IOC_TYPE_IOC, 0, 3)>;
		};
	};

	/omit-if-no-ref/ pa28_i2c3_sda: pa28_i2c3_sda {
		group0 {
			pinmux = <HPMICRO_PINMUX(HPMICRO_PIN(HPMICRO_PORTA, 28), IOC_TYPE_IOC, 0, 4)>;
		};
	};

	/omit-if-no-ref/ pa28_spi1_miso: pa28_spi1_miso {
		group0 {
			pinmux = <HPMICRO_PINMUX(HPMICRO_PIN(HPMICRO_PORTA, 28), IOC_TYPE_IOC, 0, 5)>;
		};
	};

	/omit-if-no-ref/ pa28_xpi0_ca_d_0: pa28_xpi0_ca_d_0 {
		group0 {
			pinmux = <HPMICRO_PINMUX(HPMICRO_PIN(HPMICRO_PORTA, 28), IOC_TYPE_IOC, 0, 14)>;
		};
	};

	/omit-if-no-ref/ pa28_pwm0_p_4: pa28_pwm0_p_4 {
		group0 {
			pinmux = <HPMICRO_PINMUX(HPMICRO_PIN(HPMICRO_PORTA, 28), IOC_TYPE_IOC, 0, 16)>;
		};
	};

	/omit-if-no-ref/ pa28_pwm1_p_4: pa28_pwm1_p_4 {
		group0 {
			pinmux = <HPMICRO_PINMUX(HPMICRO_PIN(HPMICRO_PORTA, 28), IOC_TYPE_IOC, 0, 17)>;
		};
	};

	/omit-if-no-ref/ pa28_trgm0_p_04: pa28_trgm0_p_04 {
		group0 {
			pinmux = <HPMICRO_PINMUX(HPMICRO_PIN(HPMICRO_PORTA, 28), IOC_TYPE_IOC, 0, 18)>;
		};
	};

	/omit-if-no-ref/ pa28_rdc0_exc_p: pa28_rdc0_exc_p {
		group0 {
			pinmux = <HPMICRO_PINMUX(HPMICRO_PIN(HPMICRO_PORTA, 28), IOC_TYPE_IOC, 0, 19)>;
		};
	};

	/omit-if-no-ref/ pa28_qei0_z: pa28_qei0_z {
		group0 {
			pinmux = <HPMICRO_PINMUX(HPMICRO_PIN(HPMICRO_PORTA, 28), IOC_TYPE_IOC, 0, 20)>;
		};
	};

	/omit-if-no-ref/ pa28_qeo0_z: pa28_qeo0_z {
		group0 {
			pinmux = <HPMICRO_PINMUX(HPMICRO_PIN(HPMICRO_PORTA, 28), IOC_TYPE_IOC, 0, 21)>;
		};
	};

	/omit-if-no-ref/ pa28_sei0_tx: pa28_sei0_tx {
		group0 {
			pinmux = <HPMICRO_PINMUX(HPMICRO_PIN(HPMICRO_PORTA, 28), IOC_TYPE_IOC, 0, 22)>;
		};
	};

	/omit-if-no-ref/ pa28_sysctl_clk_obs_2: pa28_sysctl_clk_obs_2 {
		group0 {
			pinmux = <HPMICRO_PINMUX(HPMICRO_PIN(HPMICRO_PORTA, 28), IOC_TYPE_IOC, 0, 24)>;
		};
	};

	/omit-if-no-ref/ pa29_gpio_a_29: pa29_gpio_a_29 {
		group0 {
			pinmux = <HPMICRO_PINMUX(HPMICRO_PIN(HPMICRO_PORTA, 29), IOC_TYPE_IOC, 0, 0)>;
		};
	};

	/omit-if-no-ref/ pa29_gptmr3_comp_3: pa29_gptmr3_comp_3 {
		group0 {
			pinmux = <HPMICRO_PINMUX(HPMICRO_PIN(HPMICRO_PORTA, 29), IOC_TYPE_IOC, 0, 1)>;
		};
	};

	/omit-if-no-ref/ pa29_uart7_de: pa29_uart7_de {
		group0 {
			pinmux = <HPMICRO_PINMUX(HPMICRO_PIN(HPMICRO_PORTA, 29), IOC_TYPE_IOC, 0, 2)>;
		};
	};

	/omit-if-no-ref/ pa29_uart7_rts: pa29_uart7_rts {
		group0 {
			pinmux = <HPMICRO_PINMUX(HPMICRO_PIN(HPMICRO_PORTA, 29), IOC_TYPE_IOC, 0, 3)>;
		};
	};

	/omit-if-no-ref/ pa29_i2c3_scl: pa29_i2c3_scl {
		group0 {
			pinmux = <HPMICRO_PINMUX(HPMICRO_PIN(HPMICRO_PORTA, 29), IOC_TYPE_IOC, 0, 4)>;
		};
	};

	/omit-if-no-ref/ pa29_spi1_mosi: pa29_spi1_mosi {
		group0 {
			pinmux = <HPMICRO_PINMUX(HPMICRO_PIN(HPMICRO_PORTA, 29), IOC_TYPE_IOC, 0, 5)>;
		};
	};

	/omit-if-no-ref/ pa29_mcan3_stby: pa29_mcan3_stby {
		group0 {
			pinmux = <HPMICRO_PINMUX(HPMICRO_PIN(HPMICRO_PORTA, 29), IOC_TYPE_IOC, 0, 7)>;
		};
	};

	/omit-if-no-ref/ pa29_xpi0_ca_d_2: pa29_xpi0_ca_d_2 {
		group0 {
			pinmux = <HPMICRO_PINMUX(HPMICRO_PIN(HPMICRO_PORTA, 29), IOC_TYPE_IOC, 0, 14)>;
		};
	};

	/omit-if-no-ref/ pa29_pwm0_p_5: pa29_pwm0_p_5 {
		group0 {
			pinmux = <HPMICRO_PINMUX(HPMICRO_PIN(HPMICRO_PORTA, 29), IOC_TYPE_IOC, 0, 16)>;
		};
	};

	/omit-if-no-ref/ pa29_pwm1_p_5: pa29_pwm1_p_5 {
		group0 {
			pinmux = <HPMICRO_PINMUX(HPMICRO_PIN(HPMICRO_PORTA, 29), IOC_TYPE_IOC, 0, 17)>;
		};
	};

	/omit-if-no-ref/ pa29_trgm0_p_05: pa29_trgm0_p_05 {
		group0 {
			pinmux = <HPMICRO_PINMUX(HPMICRO_PIN(HPMICRO_PORTA, 29), IOC_TYPE_IOC, 0, 18)>;
		};
	};

	/omit-if-no-ref/ pa29_rdc0_exc_n: pa29_rdc0_exc_n {
		group0 {
			pinmux = <HPMICRO_PINMUX(HPMICRO_PIN(HPMICRO_PORTA, 29), IOC_TYPE_IOC, 0, 19)>;
		};
	};

	/omit-if-no-ref/ pa29_qei0_h0: pa29_qei0_h0 {
		group0 {
			pinmux = <HPMICRO_PINMUX(HPMICRO_PIN(HPMICRO_PORTA, 29), IOC_TYPE_IOC, 0, 20)>;
		};
	};

	/omit-if-no-ref/ pa29_sei0_rx: pa29_sei0_rx {
		group0 {
			pinmux = <HPMICRO_PINMUX(HPMICRO_PIN(HPMICRO_PORTA, 29), IOC_TYPE_IOC, 0, 22)>;
		};
	};

	/omit-if-no-ref/ pa29_sysctl_clk_obs_3: pa29_sysctl_clk_obs_3 {
		group0 {
			pinmux = <HPMICRO_PINMUX(HPMICRO_PIN(HPMICRO_PORTA, 29), IOC_TYPE_IOC, 0, 24)>;
		};
	};

	/omit-if-no-ref/ pa29_usb0_oc: pa29_usb0_oc {
		group0 {
			pinmux = <HPMICRO_PINMUX(HPMICRO_PIN(HPMICRO_PORTA, 29), IOC_TYPE_IOC, 0, 25)>;
		};
	};

	/omit-if-no-ref/ pa30_gpio_a_30: pa30_gpio_a_30 {
		group0 {
			pinmux = <HPMICRO_PINMUX(HPMICRO_PIN(HPMICRO_PORTA, 30), IOC_TYPE_IOC, 0, 0)>;
		};
	};

	/omit-if-no-ref/ pa30_uart7_rxd: pa30_uart7_rxd {
		group0 {
			pinmux = <HPMICRO_PINMUX(HPMICRO_PIN(HPMICRO_PORTA, 30), IOC_TYPE_IOC, 0, 2)>;
		};
	};

	/omit-if-no-ref/ pa30_spi1_dat2: pa30_spi1_dat2 {
		group0 {
			pinmux = <HPMICRO_PINMUX(HPMICRO_PIN(HPMICRO_PORTA, 30), IOC_TYPE_IOC, 0, 5)>;
		};
	};

	/omit-if-no-ref/ pa30_mcan3_rxd: pa30_mcan3_rxd {
		group0 {
			pinmux = <HPMICRO_PINMUX(HPMICRO_PIN(HPMICRO_PORTA, 30), IOC_TYPE_IOC, 0, 7)>;
		};
	};

	/omit-if-no-ref/ pa30_xpi0_ca_d_1: pa30_xpi0_ca_d_1 {
		group0 {
			pinmux = <HPMICRO_PINMUX(HPMICRO_PIN(HPMICRO_PORTA, 30), IOC_TYPE_IOC, 0, 14)>;
		};
	};

	/omit-if-no-ref/ pa30_pwm0_p_6: pa30_pwm0_p_6 {
		group0 {
			pinmux = <HPMICRO_PINMUX(HPMICRO_PIN(HPMICRO_PORTA, 30), IOC_TYPE_IOC, 0, 16)>;
		};
	};

	/omit-if-no-ref/ pa30_pwm1_p_6: pa30_pwm1_p_6 {
		group0 {
			pinmux = <HPMICRO_PINMUX(HPMICRO_PIN(HPMICRO_PORTA, 30), IOC_TYPE_IOC, 0, 17)>;
		};
	};

	/omit-if-no-ref/ pa30_trgm0_p_06: pa30_trgm0_p_06 {
		group0 {
			pinmux = <HPMICRO_PINMUX(HPMICRO_PIN(HPMICRO_PORTA, 30), IOC_TYPE_IOC, 0, 18)>;
		};
	};

	/omit-if-no-ref/ pa30_qei0_h1: pa30_qei0_h1 {
		group0 {
			pinmux = <HPMICRO_PINMUX(HPMICRO_PIN(HPMICRO_PORTA, 30), IOC_TYPE_IOC, 0, 20)>;
		};
	};

	/omit-if-no-ref/ pa30_soc_ref0: pa30_soc_ref0 {
		group0 {
			pinmux = <HPMICRO_PINMUX(HPMICRO_PIN(HPMICRO_PORTA, 30), IOC_TYPE_IOC, 0, 24)>;
		};
	};

	/omit-if-no-ref/ pa30_usb0_pwr: pa30_usb0_pwr {
		group0 {
			pinmux = <HPMICRO_PINMUX(HPMICRO_PIN(HPMICRO_PORTA, 30), IOC_TYPE_IOC, 0, 25)>;
		};
	};

	/omit-if-no-ref/ pa31_gpio_a_31: pa31_gpio_a_31 {
		group0 {
			pinmux = <HPMICRO_PINMUX(HPMICRO_PIN(HPMICRO_PORTA, 31), IOC_TYPE_IOC, 0, 0)>;
		};
	};

	/omit-if-no-ref/ pa31_gptmr2_comp_3: pa31_gptmr2_comp_3 {
		group0 {
			pinmux = <HPMICRO_PINMUX(HPMICRO_PIN(HPMICRO_PORTA, 31), IOC_TYPE_IOC, 0, 1)>;
		};
	};

	/omit-if-no-ref/ pa31_uart7_txd: pa31_uart7_txd {
		group0 {
			pinmux = <HPMICRO_PINMUX(HPMICRO_PIN(HPMICRO_PORTA, 31), IOC_TYPE_IOC, 0, 2)>;
		};
	};

	/omit-if-no-ref/ pa31_spi1_dat3: pa31_spi1_dat3 {
		group0 {
			pinmux = <HPMICRO_PINMUX(HPMICRO_PIN(HPMICRO_PORTA, 31), IOC_TYPE_IOC, 0, 5)>;
		};
	};

	/omit-if-no-ref/ pa31_mcan3_txd: pa31_mcan3_txd {
		group0 {
			pinmux = <HPMICRO_PINMUX(HPMICRO_PIN(HPMICRO_PORTA, 31), IOC_TYPE_IOC, 0, 7)>;
		};
	};

	/omit-if-no-ref/ pa31_xpi0_ca_cs0: pa31_xpi0_ca_cs0 {
		group0 {
			pinmux = <HPMICRO_PINMUX(HPMICRO_PIN(HPMICRO_PORTA, 31), IOC_TYPE_IOC, 0, 14)>;
		};
	};

	/omit-if-no-ref/ pa31_pwm0_p_7: pa31_pwm0_p_7 {
		group0 {
			pinmux = <HPMICRO_PINMUX(HPMICRO_PIN(HPMICRO_PORTA, 31), IOC_TYPE_IOC, 0, 16)>;
		};
	};

	/omit-if-no-ref/ pa31_pwm1_p_7: pa31_pwm1_p_7 {
		group0 {
			pinmux = <HPMICRO_PINMUX(HPMICRO_PIN(HPMICRO_PORTA, 31), IOC_TYPE_IOC, 0, 17)>;
		};
	};

	/omit-if-no-ref/ pa31_trgm0_p_07: pa31_trgm0_p_07 {
		group0 {
			pinmux = <HPMICRO_PINMUX(HPMICRO_PIN(HPMICRO_PORTA, 31), IOC_TYPE_IOC, 0, 18)>;
		};
	};

	/omit-if-no-ref/ pa31_qei0_f: pa31_qei0_f {
		group0 {
			pinmux = <HPMICRO_PINMUX(HPMICRO_PIN(HPMICRO_PORTA, 31), IOC_TYPE_IOC, 0, 20)>;
		};
	};

	/omit-if-no-ref/ pa31_usb0_id: pa31_usb0_id {
		group0 {
			pinmux = <HPMICRO_PINMUX(HPMICRO_PIN(HPMICRO_PORTA, 31), IOC_TYPE_IOC, 0, 25)>;
		};
	};

	/* Port B */
	/omit-if-no-ref/ pb00_gpio_b_00: pb00_gpio_b_00 {
		group0 {
			pinmux = <HPMICRO_PINMUX(HPMICRO_PIN(HPMICRO_PORTB, 0), IOC_TYPE_IOC, 0, 0)>;
		};
	};

	/omit-if-no-ref/ pb00_gptmr1_comp_0: pb00_gptmr1_comp_0 {
		group0 {
			pinmux = <HPMICRO_PINMUX(HPMICRO_PIN(HPMICRO_PORTB, 0), IOC_TYPE_IOC, 0, 1)>;
		};
	};

	/omit-if-no-ref/ pb00_uart0_txd: pb00_uart0_txd {
		group0 {
			pinmux = <HPMICRO_PINMUX(HPMICRO_PIN(HPMICRO_PORTB, 0), IOC_TYPE_IOC, 0, 2)>;
		};
	};

	/omit-if-no-ref/ pb00_mcan0_txd: pb00_mcan0_txd {
		group0 {
			pinmux = <HPMICRO_PINMUX(HPMICRO_PIN(HPMICRO_PORTB, 0), IOC_TYPE_IOC, 0, 7)>;
		};
	};

	/omit-if-no-ref/ pb00_pwm0_p_0: pb00_pwm0_p_0 {
		group0 {
			pinmux = <HPMICRO_PINMUX(HPMICRO_PIN(HPMICRO_PORTB, 0), IOC_TYPE_IOC, 0, 16)>;
		};
	};

	/omit-if-no-ref/ pb00_pwm1_fault_0: pb00_pwm1_fault_0 {
		group0 {
			pinmux = <HPMICRO_PINMUX(HPMICRO_PIN(HPMICRO_PORTB, 0), IOC_TYPE_IOC, 0, 17)>;
		};
	};

	/omit-if-no-ref/ pb00_trgm0_p_04: pb00_trgm0_p_04 {
		group0 {
			pinmux = <HPMICRO_PINMUX(HPMICRO_PIN(HPMICRO_PORTB, 0), IOC_TYPE_IOC, 0, 18)>;
		};
	};

	/omit-if-no-ref/ pb00_acmp_comp_0: pb00_acmp_comp_0 {
		group0 {
			pinmux = <HPMICRO_PINMUX(HPMICRO_PIN(HPMICRO_PORTB, 0), IOC_TYPE_IOC, 0, 19)>;
		};
	};

	/omit-if-no-ref/ pb01_gpio_b_01: pb01_gpio_b_01 {
		group0 {
			pinmux = <HPMICRO_PINMUX(HPMICRO_PIN(HPMICRO_PORTB, 1), IOC_TYPE_IOC, 0, 0)>;
		};
	};

	/omit-if-no-ref/ pb01_gptmr1_capt_0: pb01_gptmr1_capt_0 {
		group0 {
			pinmux = <HPMICRO_PINMUX(HPMICRO_PIN(HPMICRO_PORTB, 1), IOC_TYPE_IOC, 0, 1)>;
		};
	};

	/omit-if-no-ref/ pb01_uart0_rxd: pb01_uart0_rxd {
		group0 {
			pinmux = <HPMICRO_PINMUX(HPMICRO_PIN(HPMICRO_PORTB, 1), IOC_TYPE_IOC, 0, 2)>;
		};
	};

	/omit-if-no-ref/ pb01_mcan0_rxd: pb01_mcan0_rxd {
		group0 {
			pinmux = <HPMICRO_PINMUX(HPMICRO_PIN(HPMICRO_PORTB, 1), IOC_TYPE_IOC, 0, 7)>;
		};
	};

	/omit-if-no-ref/ pb01_pwm0_p_1: pb01_pwm0_p_1 {
		group0 {
			pinmux = <HPMICRO_PINMUX(HPMICRO_PIN(HPMICRO_PORTB, 1), IOC_TYPE_IOC, 0, 16)>;
		};
	};

	/omit-if-no-ref/ pb01_pwm1_fault_1: pb01_pwm1_fault_1 {
		group0 {
			pinmux = <HPMICRO_PINMUX(HPMICRO_PIN(HPMICRO_PORTB, 1), IOC_TYPE_IOC, 0, 17)>;
		};
	};

	/omit-if-no-ref/ pb01_trgm0_p_05: pb01_trgm0_p_05 {
		group0 {
			pinmux = <HPMICRO_PINMUX(HPMICRO_PIN(HPMICRO_PORTB, 1), IOC_TYPE_IOC, 0, 18)>;
		};
	};

	/omit-if-no-ref/ pb01_acmp_comp_1: pb01_acmp_comp_1 {
		group0 {
			pinmux = <HPMICRO_PINMUX(HPMICRO_PIN(HPMICRO_PORTB, 1), IOC_TYPE_IOC, 0, 19)>;
		};
	};

	/omit-if-no-ref/ pb02_gpio_b_02: pb02_gpio_b_02 {
		group0 {
			pinmux = <HPMICRO_PINMUX(HPMICRO_PIN(HPMICRO_PORTB, 2), IOC_TYPE_IOC, 0, 0)>;
		};
	};

	/omit-if-no-ref/ pb02_gptmr1_comp_1: pb02_gptmr1_comp_1 {
		group0 {
			pinmux = <HPMICRO_PINMUX(HPMICRO_PIN(HPMICRO_PORTB, 2), IOC_TYPE_IOC, 0, 1)>;
		};
	};

	/omit-if-no-ref/ pb02_uart0_de: pb02_uart0_de {
		group0 {
			pinmux = <HPMICRO_PINMUX(HPMICRO_PIN(HPMICRO_PORTB, 2), IOC_TYPE_IOC, 0, 2)>;
		};
	};

	/omit-if-no-ref/ pb02_uart0_rts: pb02_uart0_rts {
		group0 {
			pinmux = <HPMICRO_PINMUX(HPMICRO_PIN(HPMICRO_PORTB, 2), IOC_TYPE_IOC, 0, 3)>;
		};
	};

	/omit-if-no-ref/ pb02_i2c0_scl: pb02_i2c0_scl {
		group0 {
			pinmux = <HPMICRO_PINMUX(HPMICRO_PIN(HPMICRO_PORTB, 2), IOC_TYPE_IOC, 0, 4)>;
		};
	};

	/omit-if-no-ref/ pb02_mcan0_stby: pb02_mcan0_stby {
		group0 {
			pinmux = <HPMICRO_PINMUX(HPMICRO_PIN(HPMICRO_PORTB, 2), IOC_TYPE_IOC, 0, 7)>;
		};
	};

	/omit-if-no-ref/ pb02_pwm0_p_2: pb02_pwm0_p_2 {
		group0 {
			pinmux = <HPMICRO_PINMUX(HPMICRO_PIN(HPMICRO_PORTB, 2), IOC_TYPE_IOC, 0, 16)>;
		};
	};

	/omit-if-no-ref/ pb02_acmp_comp_1: pb02_acmp_comp_1 {
		group0 {
			pinmux = <HPMICRO_PINMUX(HPMICRO_PIN(HPMICRO_PORTB, 2), IOC_TYPE_IOC, 0, 17)>;
		};
	};

	/omit-if-no-ref/ pb02_trgm0_p_06: pb02_trgm0_p_06 {
		group0 {
			pinmux = <HPMICRO_PINMUX(HPMICRO_PIN(HPMICRO_PORTB, 2), IOC_TYPE_IOC, 0, 18)>;
		};
	};

	/omit-if-no-ref/ pb02_pwm0_fault_0: pb02_pwm0_fault_0 {
		group0 {
			pinmux = <HPMICRO_PINMUX(HPMICRO_PIN(HPMICRO_PORTB, 2), IOC_TYPE_IOC, 0, 19)>;
		};
	};

	/omit-if-no-ref/ pb03_gpio_b_03: pb03_gpio_b_03 {
		group0 {
			pinmux = <HPMICRO_PINMUX(HPMICRO_PIN(HPMICRO_PORTB, 3), IOC_TYPE_IOC, 0, 0)>;
		};
	};

	/omit-if-no-ref/ pb03_gptmr1_capt_1: pb03_gptmr1_capt_1 {
		group0 {
			pinmux = <HPMICRO_PINMUX(HPMICRO_PIN(HPMICRO_PORTB, 3), IOC_TYPE_IOC, 0, 1)>;
		};
	};

	/omit-if-no-ref/ pb03_uart0_cts: pb03_uart0_cts {
		group0 {
			pinmux = <HPMICRO_PINMUX(HPMICRO_PIN(HPMICRO_PORTB, 3), IOC_TYPE_IOC, 0, 3)>;
		};
	};

	/omit-if-no-ref/ pb03_i2c0_sda: pb03_i2c0_sda {
		group0 {
			pinmux = <HPMICRO_PINMUX(HPMICRO_PIN(HPMICRO_PORTB, 3), IOC_TYPE_IOC, 0, 4)>;
		};
	};

	/omit-if-no-ref/ pb03_spi2_cs_3: pb03_spi2_cs_3 {
		group0 {
			pinmux = <HPMICRO_PINMUX(HPMICRO_PIN(HPMICRO_PORTB, 3), IOC_TYPE_IOC, 0, 5)>;
		};
	};

	/omit-if-no-ref/ pb03_mcan1_stby: pb03_mcan1_stby {
		group0 {
			pinmux = <HPMICRO_PINMUX(HPMICRO_PIN(HPMICRO_PORTB, 3), IOC_TYPE_IOC, 0, 7)>;
		};
	};

	/omit-if-no-ref/ pb03_pwm0_p_3: pb03_pwm0_p_3 {
		group0 {
			pinmux = <HPMICRO_PINMUX(HPMICRO_PIN(HPMICRO_PORTB, 3), IOC_TYPE_IOC, 0, 16)>;
		};
	};

	/omit-if-no-ref/ pb03_acmp_comp_0: pb03_acmp_comp_0 {
		group0 {
			pinmux = <HPMICRO_PINMUX(HPMICRO_PIN(HPMICRO_PORTB, 3), IOC_TYPE_IOC, 0, 17)>;
		};
	};

	/omit-if-no-ref/ pb03_trgm0_p_07: pb03_trgm0_p_07 {
		group0 {
			pinmux = <HPMICRO_PINMUX(HPMICRO_PIN(HPMICRO_PORTB, 3), IOC_TYPE_IOC, 0, 18)>;
		};
	};

	/omit-if-no-ref/ pb03_pwm0_fault_1: pb03_pwm0_fault_1 {
		group0 {
			pinmux = <HPMICRO_PINMUX(HPMICRO_PIN(HPMICRO_PORTB, 3), IOC_TYPE_IOC, 0, 19)>;
		};
	};

	/omit-if-no-ref/ pb04_gpio_b_04: pb04_gpio_b_04 {
		group0 {
			pinmux = <HPMICRO_PINMUX(HPMICRO_PIN(HPMICRO_PORTB, 4), IOC_TYPE_IOC, 0, 0)>;
		};
	};

	/omit-if-no-ref/ pb04_uart1_cts: pb04_uart1_cts {
		group0 {
			pinmux = <HPMICRO_PINMUX(HPMICRO_PIN(HPMICRO_PORTB, 4), IOC_TYPE_IOC, 0, 3)>;
		};
	};

	/omit-if-no-ref/ pb04_spi3_cs_0: pb04_spi3_cs_0 {
		group0 {
			pinmux = <HPMICRO_PINMUX(HPMICRO_PIN(HPMICRO_PORTB, 4), IOC_TYPE_IOC, 0, 5)>;
		};
	};

	/omit-if-no-ref/ pb04_mcan1_rxd: pb04_mcan1_rxd {
		group0 {
			pinmux = <HPMICRO_PINMUX(HPMICRO_PIN(HPMICRO_PORTB, 4), IOC_TYPE_IOC, 0, 7)>;
		};
	};

	/omit-if-no-ref/ pb04_pwm0_p_4: pb04_pwm0_p_4 {
		group0 {
			pinmux = <HPMICRO_PINMUX(HPMICRO_PIN(HPMICRO_PORTB, 4), IOC_TYPE_IOC, 0, 16)>;
		};
	};

	/omit-if-no-ref/ pb04_pwm1_p_0: pb04_pwm1_p_0 {
		group0 {
			pinmux = <HPMICRO_PINMUX(HPMICRO_PIN(HPMICRO_PORTB, 4), IOC_TYPE_IOC, 0, 17)>;
		};
	};

	/omit-if-no-ref/ pb04_trgm0_p_00: pb04_trgm0_p_00 {
		group0 {
			pinmux = <HPMICRO_PINMUX(HPMICRO_PIN(HPMICRO_PORTB, 4), IOC_TYPE_IOC, 0, 18)>;
		};
	};

	/omit-if-no-ref/ pb04_qei1_a: pb04_qei1_a {
		group0 {
			pinmux = <HPMICRO_PINMUX(HPMICRO_PIN(HPMICRO_PORTB, 4), IOC_TYPE_IOC, 0, 20)>;
		};
	};

	/omit-if-no-ref/ pb04_qeo1_a: pb04_qeo1_a {
		group0 {
			pinmux = <HPMICRO_PINMUX(HPMICRO_PIN(HPMICRO_PORTB, 4), IOC_TYPE_IOC, 0, 21)>;
		};
	};

	/omit-if-no-ref/ pb04_sei0_de: pb04_sei0_de {
		group0 {
			pinmux = <HPMICRO_PINMUX(HPMICRO_PIN(HPMICRO_PORTB, 4), IOC_TYPE_IOC, 0, 22)>;
		};
	};

	/omit-if-no-ref/ pb05_gpio_b_05: pb05_gpio_b_05 {
		group0 {
			pinmux = <HPMICRO_PINMUX(HPMICRO_PIN(HPMICRO_PORTB, 5), IOC_TYPE_IOC, 0, 0)>;
		};
	};

	/omit-if-no-ref/ pb05_gptmr1_comp_2: pb05_gptmr1_comp_2 {
		group0 {
			pinmux = <HPMICRO_PINMUX(HPMICRO_PIN(HPMICRO_PORTB, 5), IOC_TYPE_IOC, 0, 1)>;
		};
	};

	/omit-if-no-ref/ pb05_uart1_de: pb05_uart1_de {
		group0 {
			pinmux = <HPMICRO_PINMUX(HPMICRO_PIN(HPMICRO_PORTB, 5), IOC_TYPE_IOC, 0, 2)>;
		};
	};

	/omit-if-no-ref/ pb05_uart1_rts: pb05_uart1_rts {
		group0 {
			pinmux = <HPMICRO_PINMUX(HPMICRO_PIN(HPMICRO_PORTB, 5), IOC_TYPE_IOC, 0, 3)>;
		};
	};

	/omit-if-no-ref/ pb05_spi3_sclk: pb05_spi3_sclk {
		group0 {
			pinmux = <HPMICRO_PINMUX(HPMICRO_PIN(HPMICRO_PORTB, 5), IOC_TYPE_IOC, 0, 5)>;
		};
	};

	/omit-if-no-ref/ pb05_mcan1_txd: pb05_mcan1_txd {
		group0 {
			pinmux = <HPMICRO_PINMUX(HPMICRO_PIN(HPMICRO_PORTB, 5), IOC_TYPE_IOC, 0, 7)>;
		};
	};

	/omit-if-no-ref/ pb05_pwm0_p_5: pb05_pwm0_p_5 {
		group0 {
			pinmux = <HPMICRO_PINMUX(HPMICRO_PIN(HPMICRO_PORTB, 5), IOC_TYPE_IOC, 0, 16)>;
		};
	};

	/omit-if-no-ref/ pb05_pwm1_p_1: pb05_pwm1_p_1 {
		group0 {
			pinmux = <HPMICRO_PINMUX(HPMICRO_PIN(HPMICRO_PORTB, 5), IOC_TYPE_IOC, 0, 17)>;
		};
	};

	/omit-if-no-ref/ pb05_trgm0_p_01: pb05_trgm0_p_01 {
		group0 {
			pinmux = <HPMICRO_PINMUX(HPMICRO_PIN(HPMICRO_PORTB, 5), IOC_TYPE_IOC, 0, 18)>;
		};
	};

	/omit-if-no-ref/ pb05_qei1_b: pb05_qei1_b {
		group0 {
			pinmux = <HPMICRO_PINMUX(HPMICRO_PIN(HPMICRO_PORTB, 5), IOC_TYPE_IOC, 0, 20)>;
		};
	};

	/omit-if-no-ref/ pb05_qeo1_b: pb05_qeo1_b {
		group0 {
			pinmux = <HPMICRO_PINMUX(HPMICRO_PIN(HPMICRO_PORTB, 5), IOC_TYPE_IOC, 0, 21)>;
		};
	};

	/omit-if-no-ref/ pb05_sei0_ck: pb05_sei0_ck {
		group0 {
			pinmux = <HPMICRO_PINMUX(HPMICRO_PIN(HPMICRO_PORTB, 5), IOC_TYPE_IOC, 0, 22)>;
		};
	};

	/omit-if-no-ref/ pb06_gpio_b_06: pb06_gpio_b_06 {
		group0 {
			pinmux = <HPMICRO_PINMUX(HPMICRO_PIN(HPMICRO_PORTB, 6), IOC_TYPE_IOC, 0, 0)>;
		};
	};

	/omit-if-no-ref/ pb06_gptmr0_capt_0: pb06_gptmr0_capt_0 {
		group0 {
			pinmux = <HPMICRO_PINMUX(HPMICRO_PIN(HPMICRO_PORTB, 6), IOC_TYPE_IOC, 0, 1)>;
		};
	};

	/omit-if-no-ref/ pb06_uart1_rxd: pb06_uart1_rxd {
		group0 {
			pinmux = <HPMICRO_PINMUX(HPMICRO_PIN(HPMICRO_PORTB, 6), IOC_TYPE_IOC, 0, 2)>;
		};
	};

	/omit-if-no-ref/ pb06_i2c1_sda: pb06_i2c1_sda {
		group0 {
			pinmux = <HPMICRO_PINMUX(HPMICRO_PIN(HPMICRO_PORTB, 6), IOC_TYPE_IOC, 0, 4)>;
		};
	};

	/omit-if-no-ref/ pb06_spi3_miso: pb06_spi3_miso {
		group0 {
			pinmux = <HPMICRO_PINMUX(HPMICRO_PIN(HPMICRO_PORTB, 6), IOC_TYPE_IOC, 0, 5)>;
		};
	};

	/omit-if-no-ref/ pb06_pwm0_p_6: pb06_pwm0_p_6 {
		group0 {
			pinmux = <HPMICRO_PINMUX(HPMICRO_PIN(HPMICRO_PORTB, 6), IOC_TYPE_IOC, 0, 16)>;
		};
	};

	/omit-if-no-ref/ pb06_pwm1_p_2: pb06_pwm1_p_2 {
		group0 {
			pinmux = <HPMICRO_PINMUX(HPMICRO_PIN(HPMICRO_PORTB, 6), IOC_TYPE_IOC, 0, 17)>;
		};
	};

	/omit-if-no-ref/ pb06_trgm0_p_02: pb06_trgm0_p_02 {
		group0 {
			pinmux = <HPMICRO_PINMUX(HPMICRO_PIN(HPMICRO_PORTB, 6), IOC_TYPE_IOC, 0, 18)>;
		};
	};

	/omit-if-no-ref/ pb06_rdc0_exc_p: pb06_rdc0_exc_p {
		group0 {
			pinmux = <HPMICRO_PINMUX(HPMICRO_PIN(HPMICRO_PORTB, 6), IOC_TYPE_IOC, 0, 19)>;
		};
	};

	/omit-if-no-ref/ pb06_qei1_z: pb06_qei1_z {
		group0 {
			pinmux = <HPMICRO_PINMUX(HPMICRO_PIN(HPMICRO_PORTB, 6), IOC_TYPE_IOC, 0, 20)>;
		};
	};

	/omit-if-no-ref/ pb06_qeo1_z: pb06_qeo1_z {
		group0 {
			pinmux = <HPMICRO_PINMUX(HPMICRO_PIN(HPMICRO_PORTB, 6), IOC_TYPE_IOC, 0, 21)>;
		};
	};

	/omit-if-no-ref/ pb06_sei0_tx: pb06_sei0_tx {
		group0 {
			pinmux = <HPMICRO_PINMUX(HPMICRO_PIN(HPMICRO_PORTB, 6), IOC_TYPE_IOC, 0, 22)>;
		};
	};

	/omit-if-no-ref/ pb07_gpio_b_07: pb07_gpio_b_07 {
		group0 {
			pinmux = <HPMICRO_PINMUX(HPMICRO_PIN(HPMICRO_PORTB, 7), IOC_TYPE_IOC, 0, 0)>;
		};
	};

	/omit-if-no-ref/ pb07_gptmr0_comp_0: pb07_gptmr0_comp_0 {
		group0 {
			pinmux = <HPMICRO_PINMUX(HPMICRO_PIN(HPMICRO_PORTB, 7), IOC_TYPE_IOC, 0, 1)>;
		};
	};

	/omit-if-no-ref/ pb07_uart1_txd: pb07_uart1_txd {
		group0 {
			pinmux = <HPMICRO_PINMUX(HPMICRO_PIN(HPMICRO_PORTB, 7), IOC_TYPE_IOC, 0, 2)>;
		};
	};

	/omit-if-no-ref/ pb07_i2c1_scl: pb07_i2c1_scl {
		group0 {
			pinmux = <HPMICRO_PINMUX(HPMICRO_PIN(HPMICRO_PORTB, 7), IOC_TYPE_IOC, 0, 4)>;
		};
	};

	/omit-if-no-ref/ pb07_spi3_mosi: pb07_spi3_mosi {
		group0 {
			pinmux = <HPMICRO_PINMUX(HPMICRO_PIN(HPMICRO_PORTB, 7), IOC_TYPE_IOC, 0, 5)>;
		};
	};

	/omit-if-no-ref/ pb07_pwm0_p_7: pb07_pwm0_p_7 {
		group0 {
			pinmux = <HPMICRO_PINMUX(HPMICRO_PIN(HPMICRO_PORTB, 7), IOC_TYPE_IOC, 0, 16)>;
		};
	};

	/omit-if-no-ref/ pb07_pwm1_p_3: pb07_pwm1_p_3 {
		group0 {
			pinmux = <HPMICRO_PINMUX(HPMICRO_PIN(HPMICRO_PORTB, 7), IOC_TYPE_IOC, 0, 17)>;
		};
	};

	/omit-if-no-ref/ pb07_trgm0_p_03: pb07_trgm0_p_03 {
		group0 {
			pinmux = <HPMICRO_PINMUX(HPMICRO_PIN(HPMICRO_PORTB, 7), IOC_TYPE_IOC, 0, 18)>;
		};
	};

	/omit-if-no-ref/ pb07_rdc0_exc_n: pb07_rdc0_exc_n {
		group0 {
			pinmux = <HPMICRO_PINMUX(HPMICRO_PIN(HPMICRO_PORTB, 7), IOC_TYPE_IOC, 0, 19)>;
		};
	};

	/omit-if-no-ref/ pb07_qei1_h0: pb07_qei1_h0 {
		group0 {
			pinmux = <HPMICRO_PINMUX(HPMICRO_PIN(HPMICRO_PORTB, 7), IOC_TYPE_IOC, 0, 20)>;
		};
	};

	/omit-if-no-ref/ pb07_sei0_rx: pb07_sei0_rx {
		group0 {
			pinmux = <HPMICRO_PINMUX(HPMICRO_PIN(HPMICRO_PORTB, 7), IOC_TYPE_IOC, 0, 22)>;
		};
	};

	/omit-if-no-ref/ pb08_gpio_b_08: pb08_gpio_b_08 {
		group0 {
			pinmux = <HPMICRO_PINMUX(HPMICRO_PIN(HPMICRO_PORTB, 8), IOC_TYPE_IOC, 0, 0)>;
		};
	};

	/omit-if-no-ref/ pb08_gptmr0_comp_1: pb08_gptmr0_comp_1 {
		group0 {
			pinmux = <HPMICRO_PINMUX(HPMICRO_PIN(HPMICRO_PORTB, 8), IOC_TYPE_IOC, 0, 1)>;
		};
	};

	/omit-if-no-ref/ pb08_uart2_txd: pb08_uart2_txd {
		group0 {
			pinmux = <HPMICRO_PINMUX(HPMICRO_PIN(HPMICRO_PORTB, 8), IOC_TYPE_IOC, 0, 2)>;
		};
	};

	/omit-if-no-ref/ pb08_i2c2_scl: pb08_i2c2_scl {
		group0 {
			pinmux = <HPMICRO_PINMUX(HPMICRO_PIN(HPMICRO_PORTB, 8), IOC_TYPE_IOC, 0, 4)>;
		};
	};

	/omit-if-no-ref/ pb08_spi2_cs_2: pb08_spi2_cs_2 {
		group0 {
			pinmux = <HPMICRO_PINMUX(HPMICRO_PIN(HPMICRO_PORTB, 8), IOC_TYPE_IOC, 0, 5)>;
		};
	};

	/omit-if-no-ref/ pb08_mcan2_txd: pb08_mcan2_txd {
		group0 {
			pinmux = <HPMICRO_PINMUX(HPMICRO_PIN(HPMICRO_PORTB, 8), IOC_TYPE_IOC, 0, 7)>;
		};
	};

	/omit-if-no-ref/ pb08_acmp_comp_0: pb08_acmp_comp_0 {
		group0 {
			pinmux = <HPMICRO_PINMUX(HPMICRO_PIN(HPMICRO_PORTB, 8), IOC_TYPE_IOC, 0, 16)>;
		};
	};

	/omit-if-no-ref/ pb08_pwm1_p_4: pb08_pwm1_p_4 {
		group0 {
			pinmux = <HPMICRO_PINMUX(HPMICRO_PIN(HPMICRO_PORTB, 8), IOC_TYPE_IOC, 0, 17)>;
		};
	};

	/omit-if-no-ref/ pb08_qei1_h1: pb08_qei1_h1 {
		group0 {
			pinmux = <HPMICRO_PINMUX(HPMICRO_PIN(HPMICRO_PORTB, 8), IOC_TYPE_IOC, 0, 20)>;
		};
	};

	/omit-if-no-ref/ pb08_qeo1_a: pb08_qeo1_a {
		group0 {
			pinmux = <HPMICRO_PINMUX(HPMICRO_PIN(HPMICRO_PORTB, 8), IOC_TYPE_IOC, 0, 21)>;
		};
	};

	/omit-if-no-ref/ pb08_sei1_de: pb08_sei1_de {
		group0 {
			pinmux = <HPMICRO_PINMUX(HPMICRO_PIN(HPMICRO_PORTB, 8), IOC_TYPE_IOC, 0, 22)>;
		};
	};

	/omit-if-no-ref/ pb08_usb0_id: pb08_usb0_id {
		group0 {
			pinmux = <HPMICRO_PINMUX(HPMICRO_PIN(HPMICRO_PORTB, 8), IOC_TYPE_IOC, 0, 25)>;
		};
	};

	/omit-if-no-ref/ pb09_gpio_b_09: pb09_gpio_b_09 {
		group0 {
			pinmux = <HPMICRO_PINMUX(HPMICRO_PIN(HPMICRO_PORTB, 9), IOC_TYPE_IOC, 0, 0)>;
		};
	};

	/omit-if-no-ref/ pb09_gptmr0_capt_1: pb09_gptmr0_capt_1 {
		group0 {
			pinmux = <HPMICRO_PINMUX(HPMICRO_PIN(HPMICRO_PORTB, 9), IOC_TYPE_IOC, 0, 1)>;
		};
	};

	/omit-if-no-ref/ pb09_uart2_rxd: pb09_uart2_rxd {
		group0 {
			pinmux = <HPMICRO_PINMUX(HPMICRO_PIN(HPMICRO_PORTB, 9), IOC_TYPE_IOC, 0, 2)>;
		};
	};

	/omit-if-no-ref/ pb09_i2c2_sda: pb09_i2c2_sda {
		group0 {
			pinmux = <HPMICRO_PINMUX(HPMICRO_PIN(HPMICRO_PORTB, 9), IOC_TYPE_IOC, 0, 4)>;
		};
	};

	/omit-if-no-ref/ pb09_spi2_cs_1: pb09_spi2_cs_1 {
		group0 {
			pinmux = <HPMICRO_PINMUX(HPMICRO_PIN(HPMICRO_PORTB, 9), IOC_TYPE_IOC, 0, 5)>;
		};
	};

	/omit-if-no-ref/ pb09_mcan2_rxd: pb09_mcan2_rxd {
		group0 {
			pinmux = <HPMICRO_PINMUX(HPMICRO_PIN(HPMICRO_PORTB, 9), IOC_TYPE_IOC, 0, 7)>;
		};
	};

	/omit-if-no-ref/ pb09_acmp_comp_1: pb09_acmp_comp_1 {
		group0 {
			pinmux = <HPMICRO_PINMUX(HPMICRO_PIN(HPMICRO_PORTB, 9), IOC_TYPE_IOC, 0, 16)>;
		};
	};

	/omit-if-no-ref/ pb09_pwm1_p_5: pb09_pwm1_p_5 {
		group0 {
			pinmux = <HPMICRO_PINMUX(HPMICRO_PIN(HPMICRO_PORTB, 9), IOC_TYPE_IOC, 0, 17)>;
		};
	};

	/omit-if-no-ref/ pb09_qei1_f: pb09_qei1_f {
		group0 {
			pinmux = <HPMICRO_PINMUX(HPMICRO_PIN(HPMICRO_PORTB, 9), IOC_TYPE_IOC, 0, 20)>;
		};
	};

	/omit-if-no-ref/ pb09_qeo1_b: pb09_qeo1_b {
		group0 {
			pinmux = <HPMICRO_PINMUX(HPMICRO_PIN(HPMICRO_PORTB, 9), IOC_TYPE_IOC, 0, 21)>;
		};
	};

	/omit-if-no-ref/ pb09_sei1_ck: pb09_sei1_ck {
		group0 {
			pinmux = <HPMICRO_PINMUX(HPMICRO_PIN(HPMICRO_PORTB, 9), IOC_TYPE_IOC, 0, 22)>;
		};
	};

	/omit-if-no-ref/ pb09_usb0_oc: pb09_usb0_oc {
		group0 {
			pinmux = <HPMICRO_PINMUX(HPMICRO_PIN(HPMICRO_PORTB, 9), IOC_TYPE_IOC, 0, 25)>;
		};
	};

	/omit-if-no-ref/ pb10_gpio_b_10: pb10_gpio_b_10 {
		group0 {
			pinmux = <HPMICRO_PINMUX(HPMICRO_PIN(HPMICRO_PORTB, 10), IOC_TYPE_IOC, 0, 0)>;
		};
	};

	/omit-if-no-ref/ pb10_gptmr0_comp_2: pb10_gptmr0_comp_2 {
		group0 {
			pinmux = <HPMICRO_PINMUX(HPMICRO_PIN(HPMICRO_PORTB, 10), IOC_TYPE_IOC, 0, 1)>;
		};
	};

	/omit-if-no-ref/ pb10_uart2_de: pb10_uart2_de {
		group0 {
			pinmux = <HPMICRO_PINMUX(HPMICRO_PIN(HPMICRO_PORTB, 10), IOC_TYPE_IOC, 0, 2)>;
		};
	};

	/omit-if-no-ref/ pb10_uart2_rts: pb10_uart2_rts {
		group0 {
			pinmux = <HPMICRO_PINMUX(HPMICRO_PIN(HPMICRO_PORTB, 10), IOC_TYPE_IOC, 0, 3)>;
		};
	};

	/omit-if-no-ref/ pb10_spi2_cs_0: pb10_spi2_cs_0 {
		group0 {
			pinmux = <HPMICRO_PINMUX(HPMICRO_PIN(HPMICRO_PORTB, 10), IOC_TYPE_IOC, 0, 5)>;
		};
	};

	/omit-if-no-ref/ pb10_mcan2_stby: pb10_mcan2_stby {
		group0 {
			pinmux = <HPMICRO_PINMUX(HPMICRO_PIN(HPMICRO_PORTB, 10), IOC_TYPE_IOC, 0, 7)>;
		};
	};

	/omit-if-no-ref/ pb10_acmp_comp_0: pb10_acmp_comp_0 {
		group0 {
			pinmux = <HPMICRO_PINMUX(HPMICRO_PIN(HPMICRO_PORTB, 10), IOC_TYPE_IOC, 0, 16)>;
		};
	};

	/omit-if-no-ref/ pb10_pwm1_p_6: pb10_pwm1_p_6 {
		group0 {
			pinmux = <HPMICRO_PINMUX(HPMICRO_PIN(HPMICRO_PORTB, 10), IOC_TYPE_IOC, 0, 17)>;
		};
	};

	/omit-if-no-ref/ pb10_qei0_h1: pb10_qei0_h1 {
		group0 {
			pinmux = <HPMICRO_PINMUX(HPMICRO_PIN(HPMICRO_PORTB, 10), IOC_TYPE_IOC, 0, 20)>;
		};
	};

	/omit-if-no-ref/ pb10_qeo1_z: pb10_qeo1_z {
		group0 {
			pinmux = <HPMICRO_PINMUX(HPMICRO_PIN(HPMICRO_PORTB, 10), IOC_TYPE_IOC, 0, 21)>;
		};
	};

	/omit-if-no-ref/ pb10_sei1_tx: pb10_sei1_tx {
		group0 {
			pinmux = <HPMICRO_PINMUX(HPMICRO_PIN(HPMICRO_PORTB, 10), IOC_TYPE_IOC, 0, 22)>;
		};
	};

	/omit-if-no-ref/ pb10_usb0_pwr: pb10_usb0_pwr {
		group0 {
			pinmux = <HPMICRO_PINMUX(HPMICRO_PIN(HPMICRO_PORTB, 10), IOC_TYPE_IOC, 0, 25)>;
		};
	};

	/omit-if-no-ref/ pb11_gpio_b_11: pb11_gpio_b_11 {
		group0 {
			pinmux = <HPMICRO_PINMUX(HPMICRO_PIN(HPMICRO_PORTB, 11), IOC_TYPE_IOC, 0, 0)>;
		};
	};

	/omit-if-no-ref/ pb11_uart2_cts: pb11_uart2_cts {
		group0 {
			pinmux = <HPMICRO_PINMUX(HPMICRO_PIN(HPMICRO_PORTB, 11), IOC_TYPE_IOC, 0, 3)>;
		};
	};

	/omit-if-no-ref/ pb11_spi2_sclk: pb11_spi2_sclk {
		group0 {
			pinmux = <HPMICRO_PINMUX(HPMICRO_PIN(HPMICRO_PORTB, 11), IOC_TYPE_IOC, 0, 5)>;
		};
	};

	/omit-if-no-ref/ pb11_acmp_comp_1: pb11_acmp_comp_1 {
		group0 {
			pinmux = <HPMICRO_PINMUX(HPMICRO_PIN(HPMICRO_PORTB, 11), IOC_TYPE_IOC, 0, 16)>;
		};
	};

	/omit-if-no-ref/ pb11_pwm1_p_7: pb11_pwm1_p_7 {
		group0 {
			pinmux = <HPMICRO_PINMUX(HPMICRO_PIN(HPMICRO_PORTB, 11), IOC_TYPE_IOC, 0, 17)>;
		};
	};

	/omit-if-no-ref/ pb11_qei0_f: pb11_qei0_f {
		group0 {
			pinmux = <HPMICRO_PINMUX(HPMICRO_PIN(HPMICRO_PORTB, 11), IOC_TYPE_IOC, 0, 20)>;
		};
	};

	/omit-if-no-ref/ pb11_sei1_rx: pb11_sei1_rx {
		group0 {
			pinmux = <HPMICRO_PINMUX(HPMICRO_PIN(HPMICRO_PORTB, 11), IOC_TYPE_IOC, 0, 22)>;
		};
	};

	/omit-if-no-ref/ pb12_gpio_b_12: pb12_gpio_b_12 {
		group0 {
			pinmux = <HPMICRO_PINMUX(HPMICRO_PIN(HPMICRO_PORTB, 12), IOC_TYPE_IOC, 0, 0)>;
		};
	};

	/omit-if-no-ref/ pb12_uart3_cts: pb12_uart3_cts {
		group0 {
			pinmux = <HPMICRO_PINMUX(HPMICRO_PIN(HPMICRO_PORTB, 12), IOC_TYPE_IOC, 0, 3)>;
		};
	};

	/omit-if-no-ref/ pb12_i2c3_sda: pb12_i2c3_sda {
		group0 {
			pinmux = <HPMICRO_PINMUX(HPMICRO_PIN(HPMICRO_PORTB, 12), IOC_TYPE_IOC, 0, 4)>;
		};
	};

	/omit-if-no-ref/ pb12_spi2_miso: pb12_spi2_miso {
		group0 {
			pinmux = <HPMICRO_PINMUX(HPMICRO_PIN(HPMICRO_PORTB, 12), IOC_TYPE_IOC, 0, 5)>;
		};
	};

	/omit-if-no-ref/ pb12_pwm1_fault_0: pb12_pwm1_fault_0 {
		group0 {
			pinmux = <HPMICRO_PINMUX(HPMICRO_PIN(HPMICRO_PORTB, 12), IOC_TYPE_IOC, 0, 16)>;
		};
	};

	/omit-if-no-ref/ pb12_pwm1_p_0: pb12_pwm1_p_0 {
		group0 {
			pinmux = <HPMICRO_PINMUX(HPMICRO_PIN(HPMICRO_PORTB, 12), IOC_TYPE_IOC, 0, 17)>;
		};
	};

	/omit-if-no-ref/ pb12_trgm0_p_00: pb12_trgm0_p_00 {
		group0 {
			pinmux = <HPMICRO_PINMUX(HPMICRO_PIN(HPMICRO_PORTB, 12), IOC_TYPE_IOC, 0, 18)>;
		};
	};

	/omit-if-no-ref/ pb12_qei0_a: pb12_qei0_a {
		group0 {
			pinmux = <HPMICRO_PINMUX(HPMICRO_PIN(HPMICRO_PORTB, 12), IOC_TYPE_IOC, 0, 20)>;
		};
	};

	/omit-if-no-ref/ pb12_qeo1_a: pb12_qeo1_a {
		group0 {
			pinmux = <HPMICRO_PINMUX(HPMICRO_PIN(HPMICRO_PORTB, 12), IOC_TYPE_IOC, 0, 21)>;
		};
	};

	/omit-if-no-ref/ pb12_sei0_de: pb12_sei0_de {
		group0 {
			pinmux = <HPMICRO_PINMUX(HPMICRO_PIN(HPMICRO_PORTB, 12), IOC_TYPE_IOC, 0, 22)>;
		};
	};

	/omit-if-no-ref/ pb13_gpio_b_13: pb13_gpio_b_13 {
		group0 {
			pinmux = <HPMICRO_PINMUX(HPMICRO_PIN(HPMICRO_PORTB, 13), IOC_TYPE_IOC, 0, 0)>;
		};
	};

	/omit-if-no-ref/ pb13_gptmr1_comp_3: pb13_gptmr1_comp_3 {
		group0 {
			pinmux = <HPMICRO_PINMUX(HPMICRO_PIN(HPMICRO_PORTB, 13), IOC_TYPE_IOC, 0, 1)>;
		};
	};

	/omit-if-no-ref/ pb13_uart3_de: pb13_uart3_de {
		group0 {
			pinmux = <HPMICRO_PINMUX(HPMICRO_PIN(HPMICRO_PORTB, 13), IOC_TYPE_IOC, 0, 2)>;
		};
	};

	/omit-if-no-ref/ pb13_uart3_rts: pb13_uart3_rts {
		group0 {
			pinmux = <HPMICRO_PINMUX(HPMICRO_PIN(HPMICRO_PORTB, 13), IOC_TYPE_IOC, 0, 3)>;
		};
	};

	/omit-if-no-ref/ pb13_i2c3_scl: pb13_i2c3_scl {
		group0 {
			pinmux = <HPMICRO_PINMUX(HPMICRO_PIN(HPMICRO_PORTB, 13), IOC_TYPE_IOC, 0, 4)>;
		};
	};

	/omit-if-no-ref/ pb13_spi2_mosi: pb13_spi2_mosi {
		group0 {
			pinmux = <HPMICRO_PINMUX(HPMICRO_PIN(HPMICRO_PORTB, 13), IOC_TYPE_IOC, 0, 5)>;
		};
	};

	/omit-if-no-ref/ pb13_mcan3_stby: pb13_mcan3_stby {
		group0 {
			pinmux = <HPMICRO_PINMUX(HPMICRO_PIN(HPMICRO_PORTB, 13), IOC_TYPE_IOC, 0, 7)>;
		};
	};

	/omit-if-no-ref/ pb13_pwm1_fault_1: pb13_pwm1_fault_1 {
		group0 {
			pinmux = <HPMICRO_PINMUX(HPMICRO_PIN(HPMICRO_PORTB, 13), IOC_TYPE_IOC, 0, 16)>;
		};
	};

	/omit-if-no-ref/ pb13_pwm1_p_1: pb13_pwm1_p_1 {
		group0 {
			pinmux = <HPMICRO_PINMUX(HPMICRO_PIN(HPMICRO_PORTB, 13), IOC_TYPE_IOC, 0, 17)>;
		};
	};

	/omit-if-no-ref/ pb13_trgm0_p_01: pb13_trgm0_p_01 {
		group0 {
			pinmux = <HPMICRO_PINMUX(HPMICRO_PIN(HPMICRO_PORTB, 13), IOC_TYPE_IOC, 0, 18)>;
		};
	};

	/omit-if-no-ref/ pb13_qei0_b: pb13_qei0_b {
		group0 {
			pinmux = <HPMICRO_PINMUX(HPMICRO_PIN(HPMICRO_PORTB, 13), IOC_TYPE_IOC, 0, 20)>;
		};
	};

	/omit-if-no-ref/ pb13_qeo1_b: pb13_qeo1_b {
		group0 {
			pinmux = <HPMICRO_PINMUX(HPMICRO_PIN(HPMICRO_PORTB, 13), IOC_TYPE_IOC, 0, 21)>;
		};
	};

	/omit-if-no-ref/ pb13_sei0_ck: pb13_sei0_ck {
		group0 {
			pinmux = <HPMICRO_PINMUX(HPMICRO_PIN(HPMICRO_PORTB, 13), IOC_TYPE_IOC, 0, 22)>;
		};
	};

	/omit-if-no-ref/ pb14_gpio_b_14: pb14_gpio_b_14 {
		group0 {
			pinmux = <HPMICRO_PINMUX(HPMICRO_PIN(HPMICRO_PORTB, 14), IOC_TYPE_IOC, 0, 0)>;
		};
	};

	/omit-if-no-ref/ pb14_uart3_rxd: pb14_uart3_rxd {
		group0 {
			pinmux = <HPMICRO_PINMUX(HPMICRO_PIN(HPMICRO_PORTB, 14), IOC_TYPE_IOC, 0, 2)>;
		};
	};

	/omit-if-no-ref/ pb14_spi2_dat2: pb14_spi2_dat2 {
		group0 {
			pinmux = <HPMICRO_PINMUX(HPMICRO_PIN(HPMICRO_PORTB, 14), IOC_TYPE_IOC, 0, 5)>;
		};
	};

	/omit-if-no-ref/ pb14_mcan3_rxd: pb14_mcan3_rxd {
		group0 {
			pinmux = <HPMICRO_PINMUX(HPMICRO_PIN(HPMICRO_PORTB, 14), IOC_TYPE_IOC, 0, 7)>;
		};
	};

	/omit-if-no-ref/ pb14_pwm0_fault_0: pb14_pwm0_fault_0 {
		group0 {
			pinmux = <HPMICRO_PINMUX(HPMICRO_PIN(HPMICRO_PORTB, 14), IOC_TYPE_IOC, 0, 16)>;
		};
	};

	/omit-if-no-ref/ pb14_pwm1_p_2: pb14_pwm1_p_2 {
		group0 {
			pinmux = <HPMICRO_PINMUX(HPMICRO_PIN(HPMICRO_PORTB, 14), IOC_TYPE_IOC, 0, 17)>;
		};
	};

	/omit-if-no-ref/ pb14_trgm0_p_02: pb14_trgm0_p_02 {
		group0 {
			pinmux = <HPMICRO_PINMUX(HPMICRO_PIN(HPMICRO_PORTB, 14), IOC_TYPE_IOC, 0, 18)>;
		};
	};

	/omit-if-no-ref/ pb14_rdc0_exc_p: pb14_rdc0_exc_p {
		group0 {
			pinmux = <HPMICRO_PINMUX(HPMICRO_PIN(HPMICRO_PORTB, 14), IOC_TYPE_IOC, 0, 19)>;
		};
	};

	/omit-if-no-ref/ pb14_qei0_z: pb14_qei0_z {
		group0 {
			pinmux = <HPMICRO_PINMUX(HPMICRO_PIN(HPMICRO_PORTB, 14), IOC_TYPE_IOC, 0, 20)>;
		};
	};

	/omit-if-no-ref/ pb14_qeo1_z: pb14_qeo1_z {
		group0 {
			pinmux = <HPMICRO_PINMUX(HPMICRO_PIN(HPMICRO_PORTB, 14), IOC_TYPE_IOC, 0, 21)>;
		};
	};

	/omit-if-no-ref/ pb14_sei0_tx: pb14_sei0_tx {
		group0 {
			pinmux = <HPMICRO_PINMUX(HPMICRO_PIN(HPMICRO_PORTB, 14), IOC_TYPE_IOC, 0, 22)>;
		};
	};

	/omit-if-no-ref/ pb15_gpio_b_15: pb15_gpio_b_15 {
		group0 {
			pinmux = <HPMICRO_PINMUX(HPMICRO_PIN(HPMICRO_PORTB, 15), IOC_TYPE_IOC, 0, 0)>;
		};
	};

	/omit-if-no-ref/ pb15_gptmr0_comp_3: pb15_gptmr0_comp_3 {
		group0 {
			pinmux = <HPMICRO_PINMUX(HPMICRO_PIN(HPMICRO_PORTB, 15), IOC_TYPE_IOC, 0, 1)>;
		};
	};

	/omit-if-no-ref/ pb15_uart3_txd: pb15_uart3_txd {
		group0 {
			pinmux = <HPMICRO_PINMUX(HPMICRO_PIN(HPMICRO_PORTB, 15), IOC_TYPE_IOC, 0, 2)>;
		};
	};

	/omit-if-no-ref/ pb15_spi2_dat3: pb15_spi2_dat3 {
		group0 {
			pinmux = <HPMICRO_PINMUX(HPMICRO_PIN(HPMICRO_PORTB, 15), IOC_TYPE_IOC, 0, 5)>;
		};
	};

	/omit-if-no-ref/ pb15_mcan3_txd: pb15_mcan3_txd {
		group0 {
			pinmux = <HPMICRO_PINMUX(HPMICRO_PIN(HPMICRO_PORTB, 15), IOC_TYPE_IOC, 0, 7)>;
		};
	};

	/omit-if-no-ref/ pb15_pwm0_fault_1: pb15_pwm0_fault_1 {
		group0 {
			pinmux = <HPMICRO_PINMUX(HPMICRO_PIN(HPMICRO_PORTB, 15), IOC_TYPE_IOC, 0, 16)>;
		};
	};

	/omit-if-no-ref/ pb15_pwm1_p_3: pb15_pwm1_p_3 {
		group0 {
			pinmux = <HPMICRO_PINMUX(HPMICRO_PIN(HPMICRO_PORTB, 15), IOC_TYPE_IOC, 0, 17)>;
		};
	};

	/omit-if-no-ref/ pb15_trgm0_p_03: pb15_trgm0_p_03 {
		group0 {
			pinmux = <HPMICRO_PINMUX(HPMICRO_PIN(HPMICRO_PORTB, 15), IOC_TYPE_IOC, 0, 18)>;
		};
	};

	/omit-if-no-ref/ pb15_rdc0_exc_n: pb15_rdc0_exc_n {
		group0 {
			pinmux = <HPMICRO_PINMUX(HPMICRO_PIN(HPMICRO_PORTB, 15), IOC_TYPE_IOC, 0, 19)>;
		};
	};

	/omit-if-no-ref/ pb15_qei0_h0: pb15_qei0_h0 {
		group0 {
			pinmux = <HPMICRO_PINMUX(HPMICRO_PIN(HPMICRO_PORTB, 15), IOC_TYPE_IOC, 0, 20)>;
		};
	};

	/omit-if-no-ref/ pb15_sei0_rx: pb15_sei0_rx {
		group0 {
			pinmux = <HPMICRO_PINMUX(HPMICRO_PIN(HPMICRO_PORTB, 15), IOC_TYPE_IOC, 0, 22)>;
		};
	};

	/* Port Y */
	/omit-if-no-ref/ py00_gpio_y_00: py00_gpio_y_00 {
		group0 {
			pinmux = <HPMICRO_PINMUX(HPMICRO_PIN(HPMICRO_PORTY, 0), IOC_TYPE_IOC, 0, 0)>;
		};
	};

	/omit-if-no-ref/ py00_gptmr3_comp_0: py00_gptmr3_comp_0 {
		group0 {
			pinmux = <HPMICRO_PINMUX(HPMICRO_PIN(HPMICRO_PORTY, 0), IOC_TYPE_IOC, 0, 1)>;
		};
	};

	/omit-if-no-ref/ py00_uart0_txd: py00_uart0_txd {
		group0 {
			pinmux = <HPMICRO_PINMUX(HPMICRO_PIN(HPMICRO_PORTY, 0), IOC_TYPE_IOC, 0, 2)>;
		};
	};

	/omit-if-no-ref/ py00_mcan2_txd: py00_mcan2_txd {
		group0 {
			pinmux = <HPMICRO_PINMUX(HPMICRO_PIN(HPMICRO_PORTY, 0), IOC_TYPE_IOC, 0, 7)>;
		};
	};

	/omit-if-no-ref/ py00_pwm0_p_0: py00_pwm0_p_0 {
		group0 {
			pinmux = <HPMICRO_PINMUX(HPMICRO_PIN(HPMICRO_PORTY, 0), IOC_TYPE_IOC, 0, 16)>;
		};
	};

	/omit-if-no-ref/ py00_pwm1_p_4: py00_pwm1_p_4 {
		group0 {
			pinmux = <HPMICRO_PINMUX(HPMICRO_PIN(HPMICRO_PORTY, 0), IOC_TYPE_IOC, 0, 17)>;
		};
	};

	/omit-if-no-ref/ py00_pwm0_fault_0: py00_pwm0_fault_0 {
		group0 {
			pinmux = <HPMICRO_PINMUX(HPMICRO_PIN(HPMICRO_PORTY, 0), IOC_TYPE_IOC, 0, 18)>;
		};
	};

	/omit-if-no-ref/ py00_usb0_id: py00_usb0_id {
		group0 {
			pinmux = <HPMICRO_PINMUX(HPMICRO_PIN(HPMICRO_PORTY, 0), IOC_TYPE_IOC, 0, 25)>;
		};
	};

	/omit-if-no-ref/ py01_gpio_y_01: py01_gpio_y_01 {
		group0 {
			pinmux = <HPMICRO_PINMUX(HPMICRO_PIN(HPMICRO_PORTY, 1), IOC_TYPE_IOC, 0, 0)>;
		};
	};

	/omit-if-no-ref/ py01_gptmr3_capt_0: py01_gptmr3_capt_0 {
		group0 {
			pinmux = <HPMICRO_PINMUX(HPMICRO_PIN(HPMICRO_PORTY, 1), IOC_TYPE_IOC, 0, 1)>;
		};
	};

	/omit-if-no-ref/ py01_uart0_rxd: py01_uart0_rxd {
		group0 {
			pinmux = <HPMICRO_PINMUX(HPMICRO_PIN(HPMICRO_PORTY, 1), IOC_TYPE_IOC, 0, 2)>;
		};
	};

	/omit-if-no-ref/ py01_mcan2_rxd: py01_mcan2_rxd {
		group0 {
			pinmux = <HPMICRO_PINMUX(HPMICRO_PIN(HPMICRO_PORTY, 1), IOC_TYPE_IOC, 0, 7)>;
		};
	};

	/omit-if-no-ref/ py01_pwm0_p_1: py01_pwm0_p_1 {
		group0 {
			pinmux = <HPMICRO_PINMUX(HPMICRO_PIN(HPMICRO_PORTY, 1), IOC_TYPE_IOC, 0, 16)>;
		};
	};

	/omit-if-no-ref/ py01_pwm1_p_5: py01_pwm1_p_5 {
		group0 {
			pinmux = <HPMICRO_PINMUX(HPMICRO_PIN(HPMICRO_PORTY, 1), IOC_TYPE_IOC, 0, 17)>;
		};
	};

	/omit-if-no-ref/ py01_pwm0_fault_1: py01_pwm0_fault_1 {
		group0 {
			pinmux = <HPMICRO_PINMUX(HPMICRO_PIN(HPMICRO_PORTY, 1), IOC_TYPE_IOC, 0, 18)>;
		};
	};

	/omit-if-no-ref/ py01_ewdg0_rst: py01_ewdg0_rst {
		group0 {
			pinmux = <HPMICRO_PINMUX(HPMICRO_PIN(HPMICRO_PORTY, 1), IOC_TYPE_IOC, 0, 24)>;
		};
	};

	/omit-if-no-ref/ py01_usb0_oc: py01_usb0_oc {
		group0 {
			pinmux = <HPMICRO_PINMUX(HPMICRO_PIN(HPMICRO_PORTY, 1), IOC_TYPE_IOC, 0, 25)>;
		};
	};

	/omit-if-no-ref/ py02_gpio_y_02: py02_gpio_y_02 {
		group0 {
			pinmux = <HPMICRO_PINMUX(HPMICRO_PIN(HPMICRO_PORTY, 2), IOC_TYPE_IOC, 0, 0)>;
		};
	};

	/omit-if-no-ref/ py02_gptmr3_comp_1: py02_gptmr3_comp_1 {
		group0 {
			pinmux = <HPMICRO_PINMUX(HPMICRO_PIN(HPMICRO_PORTY, 2), IOC_TYPE_IOC, 0, 1)>;
		};
	};

	/omit-if-no-ref/ py02_uart0_de: py02_uart0_de {
		group0 {
			pinmux = <HPMICRO_PINMUX(HPMICRO_PIN(HPMICRO_PORTY, 2), IOC_TYPE_IOC, 0, 2)>;
		};
	};

	/omit-if-no-ref/ py02_uart0_rts: py02_uart0_rts {
		group0 {
			pinmux = <HPMICRO_PINMUX(HPMICRO_PIN(HPMICRO_PORTY, 2), IOC_TYPE_IOC, 0, 3)>;
		};
	};

	/omit-if-no-ref/ py02_i2c2_scl: py02_i2c2_scl {
		group0 {
			pinmux = <HPMICRO_PINMUX(HPMICRO_PIN(HPMICRO_PORTY, 2), IOC_TYPE_IOC, 0, 4)>;
		};
	};

	/omit-if-no-ref/ py02_mcan2_stby: py02_mcan2_stby {
		group0 {
			pinmux = <HPMICRO_PINMUX(HPMICRO_PIN(HPMICRO_PORTY, 2), IOC_TYPE_IOC, 0, 7)>;
		};
	};

	/omit-if-no-ref/ py02_pwm0_p_2: py02_pwm0_p_2 {
		group0 {
			pinmux = <HPMICRO_PINMUX(HPMICRO_PIN(HPMICRO_PORTY, 2), IOC_TYPE_IOC, 0, 16)>;
		};
	};

	/omit-if-no-ref/ py02_pwm1_p_6: py02_pwm1_p_6 {
		group0 {
			pinmux = <HPMICRO_PINMUX(HPMICRO_PIN(HPMICRO_PORTY, 2), IOC_TYPE_IOC, 0, 17)>;
		};
	};

	/omit-if-no-ref/ py02_acmp_comp_0: py02_acmp_comp_0 {
		group0 {
			pinmux = <HPMICRO_PINMUX(HPMICRO_PIN(HPMICRO_PORTY, 2), IOC_TYPE_IOC, 0, 18)>;
		};
	};

	/omit-if-no-ref/ py02_pwm1_fault_0: py02_pwm1_fault_0 {
		group0 {
			pinmux = <HPMICRO_PINMUX(HPMICRO_PIN(HPMICRO_PORTY, 2), IOC_TYPE_IOC, 0, 19)>;
		};
	};

	/omit-if-no-ref/ py02_ewdg1_rst: py02_ewdg1_rst {
		group0 {
			pinmux = <HPMICRO_PINMUX(HPMICRO_PIN(HPMICRO_PORTY, 2), IOC_TYPE_IOC, 0, 24)>;
		};
	};

	/omit-if-no-ref/ py02_usb0_pwr: py02_usb0_pwr {
		group0 {
			pinmux = <HPMICRO_PINMUX(HPMICRO_PIN(HPMICRO_PORTY, 2), IOC_TYPE_IOC, 0, 25)>;
		};
	};

	/omit-if-no-ref/ py03_gpio_y_03: py03_gpio_y_03 {
		group0 {
			pinmux = <HPMICRO_PINMUX(HPMICRO_PIN(HPMICRO_PORTY, 3), IOC_TYPE_IOC, 0, 0)>;
		};
	};

	/omit-if-no-ref/ py03_gptmr3_capt_1: py03_gptmr3_capt_1 {
		group0 {
			pinmux = <HPMICRO_PINMUX(HPMICRO_PIN(HPMICRO_PORTY, 3), IOC_TYPE_IOC, 0, 1)>;
		};
	};

	/omit-if-no-ref/ py03_uart0_cts: py03_uart0_cts {
		group0 {
			pinmux = <HPMICRO_PINMUX(HPMICRO_PIN(HPMICRO_PORTY, 3), IOC_TYPE_IOC, 0, 3)>;
		};
	};

	/omit-if-no-ref/ py03_i2c2_sda: py03_i2c2_sda {
		group0 {
			pinmux = <HPMICRO_PINMUX(HPMICRO_PIN(HPMICRO_PORTY, 3), IOC_TYPE_IOC, 0, 4)>;
		};
	};

	/omit-if-no-ref/ py03_mcan3_stby: py03_mcan3_stby {
		group0 {
			pinmux = <HPMICRO_PINMUX(HPMICRO_PIN(HPMICRO_PORTY, 3), IOC_TYPE_IOC, 0, 7)>;
		};
	};

	/omit-if-no-ref/ py03_pwm0_p_3: py03_pwm0_p_3 {
		group0 {
			pinmux = <HPMICRO_PINMUX(HPMICRO_PIN(HPMICRO_PORTY, 3), IOC_TYPE_IOC, 0, 16)>;
		};
	};

	/omit-if-no-ref/ py03_pwm1_p_7: py03_pwm1_p_7 {
		group0 {
			pinmux = <HPMICRO_PINMUX(HPMICRO_PIN(HPMICRO_PORTY, 3), IOC_TYPE_IOC, 0, 17)>;
		};
	};

	/omit-if-no-ref/ py03_acmp_comp_1: py03_acmp_comp_1 {
		group0 {
			pinmux = <HPMICRO_PINMUX(HPMICRO_PIN(HPMICRO_PORTY, 3), IOC_TYPE_IOC, 0, 18)>;
		};
	};

	/omit-if-no-ref/ py03_pwm1_fault_1: py03_pwm1_fault_1 {
		group0 {
			pinmux = <HPMICRO_PINMUX(HPMICRO_PIN(HPMICRO_PORTY, 3), IOC_TYPE_IOC, 0, 19)>;
		};
	};

	/omit-if-no-ref/ py04_gpio_y_04: py04_gpio_y_04 {
		group0 {
			pinmux = <HPMICRO_PINMUX(HPMICRO_PIN(HPMICRO_PORTY, 4), IOC_TYPE_IOC, 0, 0)>;
		};
	};

	/omit-if-no-ref/ py04_uart1_cts: py04_uart1_cts {
		group0 {
			pinmux = <HPMICRO_PINMUX(HPMICRO_PIN(HPMICRO_PORTY, 4), IOC_TYPE_IOC, 0, 3)>;
		};
	};

	/omit-if-no-ref/ py04_spi2_cs_0: py04_spi2_cs_0 {
		group0 {
			pinmux = <HPMICRO_PINMUX(HPMICRO_PIN(HPMICRO_PORTY, 4), IOC_TYPE_IOC, 0, 5)>;
		};
	};

	/omit-if-no-ref/ py04_mcan3_rxd: py04_mcan3_rxd {
		group0 {
			pinmux = <HPMICRO_PINMUX(HPMICRO_PIN(HPMICRO_PORTY, 4), IOC_TYPE_IOC, 0, 7)>;
		};
	};

	/omit-if-no-ref/ py04_pwm0_p_4: py04_pwm0_p_4 {
		group0 {
			pinmux = <HPMICRO_PINMUX(HPMICRO_PIN(HPMICRO_PORTY, 4), IOC_TYPE_IOC, 0, 16)>;
		};
	};

	/omit-if-no-ref/ py04_trgm0_p_04: py04_trgm0_p_04 {
		group0 {
			pinmux = <HPMICRO_PINMUX(HPMICRO_PIN(HPMICRO_PORTY, 4), IOC_TYPE_IOC, 0, 18)>;
		};
	};

	/omit-if-no-ref/ py05_gpio_y_05: py05_gpio_y_05 {
		group0 {
			pinmux = <HPMICRO_PINMUX(HPMICRO_PIN(HPMICRO_PORTY, 5), IOC_TYPE_IOC, 0, 0)>;
		};
	};

	/omit-if-no-ref/ py05_gptmr3_comp_2: py05_gptmr3_comp_2 {
		group0 {
			pinmux = <HPMICRO_PINMUX(HPMICRO_PIN(HPMICRO_PORTY, 5), IOC_TYPE_IOC, 0, 1)>;
		};
	};

	/omit-if-no-ref/ py05_uart1_de: py05_uart1_de {
		group0 {
			pinmux = <HPMICRO_PINMUX(HPMICRO_PIN(HPMICRO_PORTY, 5), IOC_TYPE_IOC, 0, 2)>;
		};
	};

	/omit-if-no-ref/ py05_uart1_rts: py05_uart1_rts {
		group0 {
			pinmux = <HPMICRO_PINMUX(HPMICRO_PIN(HPMICRO_PORTY, 5), IOC_TYPE_IOC, 0, 3)>;
		};
	};

	/omit-if-no-ref/ py05_spi2_sclk: py05_spi2_sclk {
		group0 {
			pinmux = <HPMICRO_PINMUX(HPMICRO_PIN(HPMICRO_PORTY, 5), IOC_TYPE_IOC, 0, 5)>;
		};
	};

	/omit-if-no-ref/ py05_mcan3_txd: py05_mcan3_txd {
		group0 {
			pinmux = <HPMICRO_PINMUX(HPMICRO_PIN(HPMICRO_PORTY, 5), IOC_TYPE_IOC, 0, 7)>;
		};
	};

	/omit-if-no-ref/ py05_pwm0_p_5: py05_pwm0_p_5 {
		group0 {
			pinmux = <HPMICRO_PINMUX(HPMICRO_PIN(HPMICRO_PORTY, 5), IOC_TYPE_IOC, 0, 16)>;
		};
	};

	/omit-if-no-ref/ py05_trgm0_p_05: py05_trgm0_p_05 {
		group0 {
			pinmux = <HPMICRO_PINMUX(HPMICRO_PIN(HPMICRO_PORTY, 5), IOC_TYPE_IOC, 0, 18)>;
		};
	};

	/omit-if-no-ref/ py05_ewdg0_rst: py05_ewdg0_rst {
		group0 {
			pinmux = <HPMICRO_PINMUX(HPMICRO_PIN(HPMICRO_PORTY, 5), IOC_TYPE_IOC, 0, 24)>;
		};
	};

	/omit-if-no-ref/ py06_gpio_y_06: py06_gpio_y_06 {
		group0 {
			pinmux = <HPMICRO_PINMUX(HPMICRO_PIN(HPMICRO_PORTY, 6), IOC_TYPE_IOC, 0, 0)>;
		};
	};

	/omit-if-no-ref/ py06_gptmr2_capt_0: py06_gptmr2_capt_0 {
		group0 {
			pinmux = <HPMICRO_PINMUX(HPMICRO_PIN(HPMICRO_PORTY, 6), IOC_TYPE_IOC, 0, 1)>;
		};
	};

	/omit-if-no-ref/ py06_uart1_rxd: py06_uart1_rxd {
		group0 {
			pinmux = <HPMICRO_PINMUX(HPMICRO_PIN(HPMICRO_PORTY, 6), IOC_TYPE_IOC, 0, 2)>;
		};
	};

	/omit-if-no-ref/ py06_i2c3_sda: py06_i2c3_sda {
		group0 {
			pinmux = <HPMICRO_PINMUX(HPMICRO_PIN(HPMICRO_PORTY, 6), IOC_TYPE_IOC, 0, 4)>;
		};
	};

	/omit-if-no-ref/ py06_spi2_miso: py06_spi2_miso {
		group0 {
			pinmux = <HPMICRO_PINMUX(HPMICRO_PIN(HPMICRO_PORTY, 6), IOC_TYPE_IOC, 0, 5)>;
		};
	};

	/omit-if-no-ref/ py06_pwm0_p_6: py06_pwm0_p_6 {
		group0 {
			pinmux = <HPMICRO_PINMUX(HPMICRO_PIN(HPMICRO_PORTY, 6), IOC_TYPE_IOC, 0, 16)>;
		};
	};

	/omit-if-no-ref/ py06_trgm0_p_06: py06_trgm0_p_06 {
		group0 {
			pinmux = <HPMICRO_PINMUX(HPMICRO_PIN(HPMICRO_PORTY, 6), IOC_TYPE_IOC, 0, 18)>;
		};
	};

	/omit-if-no-ref/ py06_ewdg1_rst: py06_ewdg1_rst {
		group0 {
			pinmux = <HPMICRO_PINMUX(HPMICRO_PIN(HPMICRO_PORTY, 6), IOC_TYPE_IOC, 0, 24)>;
		};
	};

	/omit-if-no-ref/ py07_gpio_y_07: py07_gpio_y_07 {
		group0 {
			pinmux = <HPMICRO_PINMUX(HPMICRO_PIN(HPMICRO_PORTY, 7), IOC_TYPE_IOC, 0, 0)>;
		};
	};

	/omit-if-no-ref/ py07_gptmr2_comp_0: py07_gptmr2_comp_0 {
		group0 {
			pinmux = <HPMICRO_PINMUX(HPMICRO_PIN(HPMICRO_PORTY, 7), IOC_TYPE_IOC, 0, 1)>;
		};
	};

	/omit-if-no-ref/ py07_uart1_txd: py07_uart1_txd {
		group0 {
			pinmux = <HPMICRO_PINMUX(HPMICRO_PIN(HPMICRO_PORTY, 7), IOC_TYPE_IOC, 0, 2)>;
		};
	};

	/omit-if-no-ref/ py07_i2c3_scl: py07_i2c3_scl {
		group0 {
			pinmux = <HPMICRO_PINMUX(HPMICRO_PIN(HPMICRO_PORTY, 7), IOC_TYPE_IOC, 0, 4)>;
		};
	};

	/omit-if-no-ref/ py07_spi2_mosi: py07_spi2_mosi {
		group0 {
			pinmux = <HPMICRO_PINMUX(HPMICRO_PIN(HPMICRO_PORTY, 7), IOC_TYPE_IOC, 0, 5)>;
		};
	};

	/omit-if-no-ref/ py07_pwm0_p_7: py07_pwm0_p_7 {
		group0 {
			pinmux = <HPMICRO_PINMUX(HPMICRO_PIN(HPMICRO_PORTY, 7), IOC_TYPE_IOC, 0, 16)>;
		};
	};

	/omit-if-no-ref/ py07_trgm0_p_07: py07_trgm0_p_07 {
		group0 {
			pinmux = <HPMICRO_PINMUX(HPMICRO_PIN(HPMICRO_PORTY, 7), IOC_TYPE_IOC, 0, 18)>;
		};
	};
};

&pinctrl {
	/* Analog pads */
	/omit-if-no-ref/ pb00_analog: pb00_analog {
		group0 {
			pinmux = <HPMICRO_PINMUX(HPMICRO_PIN(HPMICRO_PORTB, 0), IOC_TYPE_IOC, 1, 0)>;
		};
	};

	/omit-if-no-ref/ pb01_analog: pb01_analog {
		group0 {
			pinmux = <HPMICRO_PINMUX(HPMICRO_PIN(HPMICRO_PORTB, 1), IOC_TYPE_IOC, 1, 0)>;
		};
	};

	/omit-if-no-ref/ pb02_analog: pb02_analog {
		group0 {
			pinmux = <HPMICRO_PINMUX(HPMICRO_PIN(HPMICRO_PORTB, 2), IOC_TYPE_IOC, 1, 0)>;
		};
	};

	/omit-if-no-ref/ pb03_analog: pb03_analog {
		group0 {
			pinmux = <HPMICRO_PINMUX(HPMICRO_PIN(HPMICRO_PORTB, 3), IOC_TYPE_IOC, 1, 0)>;
		};
	};

	/omit-if-no-ref/ pb04_analog: pb04_analog {
		group0 {
			pinmux = <HPMICRO_PINMUX(HPMICRO_PIN(HPMICRO_PORTB, 4), IOC_TYPE_IOC, 1, 0)>;
		};
	};

	/omit-if-no-ref/ pb05_analog: pb05_analog {
		group0 {
			pinmux = <HPMICRO_PINMUX(HPMICRO_PIN(HPMICRO_PORTB, 5), IOC_TYPE_IOC, 1, 0)>;
		};
	};

	/omit-if-no-ref/ pb06_analog: pb06_analog {
		group0 {
			pinmux = <HPMICRO_PINMUX(HPMICRO_PIN(HPMICRO_PORTB, 6), IOC_TYPE_IOC, 1, 0)>;
		};
	};

	/omit-if-no-ref/ pb07_analog: pb07_analog {
		group0 {
			pinmux = <HPMICRO_PINMUX(HPMICRO_PIN(HPMICRO_PORTB, 7), IOC_TYPE_IOC, 1, 0)>;
		};
	};

	/omit-if-no-ref/ pb08_analog: pb08_analog {
		group0 {
			pinmux = <HPMICRO_PINMUX(HPMICRO_PIN(HPMICRO_PORTB, 8), IOC_TYPE_IOC, 1, 0)>;
		};
	};

	/omit-if-no-ref/ pb09_analog: pb09_analog {
		group0 {
			pinmux = <HPMICRO_PINMUX(HPMICRO_PIN(HPMICRO_PORTB, 9), IOC_TYPE_IOC, 1, 0)>;
		};
	};

	/omit-if-no-ref/ pb10_analog: pb10_analog {
		group0 {
			pinmux = <HPMICRO_PINMUX(HPMICRO_PIN(HPMICRO_PORTB, 10), IOC_TYPE_IOC, 1, 0)>;
		};
	};

	/omit-if-no-ref/ pb11_analog: pb11_analog {
		group0 {
			pinmux = <HPMICRO_PINMUX(HPMICRO_PIN(HPMICRO_PORTB, 11), IOC_TYPE_IOC, 1, 0)>;
		};
	};

	/omit-if-no-ref/ pb12_analog: pb12_analog {
		group0 {
			pinmux = <HPMICRO_PINMUX(HPMICRO_PIN(HPMICRO_PORTB, 12), IOC_TYPE_IOC, 1, 0)>;
		};
	};

	/omit-if-no-ref/ pb13_analog: pb13_analog {
		group0 {
			pinmux = <HPMICRO_PINMUX(HPMICRO_PIN(HPMICRO_PORTB, 13), IOC_TYPE_IOC, 1, 0)>;
		};
	};

	/omit-if-no-ref/ pb14_analog: pb14_analog {
		group0 {
			pinmux = <HPMICRO_PINMUX(HPMICRO_PIN(HPMICRO_PORTB, 14), IOC_TYPE_IOC, 1, 0)>;
		};
	};

	/omit-if-no-ref/ pb15_analog: pb15_analog {
		group0 {
			pinmux = <HPMICRO_PINMUX(HPMICRO_PIN(HPMICRO_PORTB, 15), IOC_TYPE_IOC, 1, 0)>;
		};
	};
};

&pinctrl_pioc {
	/* Port Y (PIOC) */
	/omit-if-no-ref/ py00_pgpio_y_00: py00_pgpio_y_00 {
		group0 {
			pinmux = <HPMICRO_PINMUX(HPMICRO_PIN(HPMICRO_PORTY, 0), IOC_TYPE_PIOC, 0, 0)>;
		};
	};

	/omit-if-no-ref/ py00_puart_txd: py00_puart_txd {
		group0 {
			pinmux = <HPMICRO_PINMUX(HPMICRO_PIN(HPMICRO_PORTY, 0), IOC_TYPE_PIOC, 0, 1)>;
		};
	};

	/omit-if-no-ref/ py00_ptmr_comp_0: py00_ptmr_comp_0 {
		group0 {
			pinmux = <HPMICRO_PINMUX(HPMICRO_PIN(HPMICRO_PORTY, 0), IOC_TYPE_PIOC, 0, 2)>;
		};
	};

	/omit-if-no-ref/ py00_soc_gpio_y_00: py00_soc_gpio_y_00 {
		group0 {
			pinmux = <HPMICRO_PINMUX(HPMICRO_PIN(HPMICRO_PORTY, 0), IOC_TYPE_PIOC, 0, 3)>;
		};
	};

	/omit-if-no-ref/ py01_pgpio_y_01: py01_pgpio_y_01 {
		group0 {
			pinmux = <HPMICRO_PINMUX(HPMICRO_PIN(HPMICRO_PORTY, 1), IOC_TYPE_PIOC, 0, 0)>;
		};
	};

	/omit-if-no-ref/ py01_puart_rxd: py01_puart_rxd {
		group0 {
			pinmux = <HPMICRO_PINMUX(HPMICRO_PIN(HPMICRO_PORTY, 1), IOC_TYPE_PIOC, 0, 1)>;
		};
	};

	/omit-if-no-ref/ py01_ptmr_comp_1: py01_ptmr_comp_1 {
		group0 {
			pinmux = <HPMICRO_PINMUX(HPMICRO_PIN(HPMICRO_PORTY, 1), IOC_TYPE_PIOC, 0, 2)>;
		};
	};

	/omit-if-no-ref/ py01_soc_gpio_y_01: py01_soc_gpio_y_01 {
		group0 {
			pinmux = <HPMICRO_PINMUX(HPMICRO_PIN(HPMICRO_PORTY, 1), IOC_TYPE_PIOC, 0, 3)>;
		};
	};

	/omit-if-no-ref/ py02_pgpio_y_02: py02_pgpio_y_02 {
		group0 {
			pinmux = <HPMICRO_PINMUX(HPMICRO_PIN(HPMICRO_PORTY, 2), IOC_TYPE_PIOC, 0, 0)>;
		};
	};

	/omit-if-no-ref/ py02_puart_rts: py02_puart_rts {
		group0 {
			pinmux = <HPMICRO_PINMUX(HPMICRO_PIN(HPMICRO_PORTY, 2), IOC_TYPE_PIOC, 0, 1)>;
		};
	};

	/omit-if-no-ref/ py02_ptmr_comp_2: py02_ptmr_comp_2 {
		group0 {
			pinmux = <HPMICRO_PINMUX(HPMICRO_PIN(HPMICRO_PORTY, 2), IOC_TYPE_PIOC, 0, 2)>;
		};
	};

	/omit-if-no-ref/ py02_soc_gpio_y_02: py02_soc_gpio_y_02 {
		group0 {
			pinmux = <HPMICRO_PINMUX(HPMICRO_PIN(HPMICRO_PORTY, 2), IOC_TYPE_PIOC, 0, 3)>;
		};
	};

	/omit-if-no-ref/ py03_pgpio_y_03: py03_pgpio_y_03 {
		group0 {
			pinmux = <HPMICRO_PINMUX(HPMICRO_PIN(HPMICRO_PORTY, 3), IOC_TYPE_PIOC, 0, 0)>;
		};
	};

	/omit-if-no-ref/ py03_puart_cts: py03_puart_cts {
		group0 {
			pinmux = <HPMICRO_PINMUX(HPMICRO_PIN(HPMICRO_PORTY, 3), IOC_TYPE_PIOC, 0, 1)>;
		};
	};

	/omit-if-no-ref/ py03_ptmr_comp_3: py03_ptmr_comp_3 {
		group0 {
			pinmux = <HPMICRO_PINMUX(HPMICRO_PIN(HPMICRO_PORTY, 3), IOC_TYPE_PIOC, 0, 2)>;
		};
	};

	/omit-if-no-ref/ py03_soc_gpio_y_03: py03_soc_gpio_y_03 {
		group0 {
			pinmux = <HPMICRO_PINMUX(HPMICRO_PIN(HPMICRO_PORTY, 3), IOC_TYPE_PIOC, 0, 3)>;
		};
	};

	/omit-if-no-ref/ py04_pgpio_y_04: py04_pgpio_y_04 {
		group0 {
			pinmux = <HPMICRO_PINMUX(HPMICRO_PIN(HPMICRO_PORTY, 4), IOC_TYPE_PIOC, 0, 0)>;
		};
	};

	/omit-if-no-ref/ py04_ptmr_comp_0: py04_ptmr_comp_0 {
		group0 {
			pinmux = <HPMICRO_PINMUX(HPMICRO_PIN(HPMICRO_PORTY, 4), IOC_TYPE_PIOC, 0, 2)>;
		};
	};

	/omit-if-no-ref/ py04_soc_gpio_y_04: py04_soc_gpio_y_04 {
		group0 {
			pinmux = <HPMICRO_PINMUX(HPMICRO_PIN(HPMICRO_PORTY, 4), IOC_TYPE_PIOC, 0, 3)>;
		};
	};

	/omit-if-no-ref/ py05_pgpio_y_05: py05_pgpio_y_05 {
		group0 {
			pinmux = <HPMICRO_PINMUX(HPMICRO_PIN(HPMICRO_PORTY, 5), IOC_TYPE_PIOC, 0, 0)>;
		};
	};

	/omit-if-no-ref/ py05_pewdg_rst: py05_pewdg_rst {
		group0 {
			pinmux = <HPMICRO_PINMUX(HPMICRO_PIN(HPMICRO_PORTY, 5), IOC_TYPE_PIOC, 0, 1)>;
		};
	};

	/omit-if-no-ref/ py05_ptmr_capt_0: py05_ptmr_capt_0 {
		group0 {
			pinmux = <HPMICRO_PINMUX(HPMICRO_PIN(HPMICRO_PORTY, 5), IOC_TYPE_PIOC, 0, 2)>;
		};
	};

	/omit-if-no-ref/ py05_soc_gpio_y_05: py05_soc_gpio_y_05 {
		group0 {
			pinmux = <HPMICRO_PINMUX(HPMICRO_PIN(HPMICRO_PORTY, 5), IOC_TYPE_PIOC, 0, 3)>;
		};
	};

	/omit-if-no-ref/ py06_pgpio_y_06: py06_pgpio_y_06 {
		group0 {
			pinmux = <HPMICRO_PINMUX(HPMICRO_PIN(HPMICRO_PORTY, 6), IOC_TYPE_PIOC, 0, 0)>;
		};
	};

	/omit-if-no-ref/ py06_ptmr_comp_1: py06_ptmr_comp_1 {
		group0 {
			pinmux = <HPMICRO_PINMUX(HPMICRO_PIN(HPMICRO_PORTY, 6), IOC_TYPE_PIOC, 0, 2)>;
		};
	};

	/omit-if-no-ref/ py06_soc_gpio_y_06: py06_soc_gpio_y_06 {
		group0 {
			pinmux = <HPMICRO_PINMUX(HPMICRO_PIN(HPMICRO_PORTY, 6), IOC_TYPE_PIOC, 0, 3)>;
		};
	};

	/omit-if-no-ref/ py07_pgpio_y_07: py07_pgpio_y_07 {
		group0 {
			pinmux = <HPMICRO_PINMUX(HPMICRO_PIN(HPMICRO_PORTY, 7), IOC_TYPE_PIOC, 0, 0)>;
		};
	};

	/omit-if-no-ref/ py07_ptmr_capt_1: py07_ptmr_capt_1 {
		group0 {
			pinmux = <HPMICRO_PINMUX(HPMICRO_PIN(HPMICRO_PORTY, 7), IOC_TYPE_PIOC, 0, 2)>;
		};
	};

	/omit-if-no-ref/ py07_soc_gpio_y_07: py07_soc_gpio_y_07 {
		group0 {
			pinmux = <HPMICRO_PINMUX(HPMICRO_PIN(HPMICRO_PORTY, 7), IOC_TYPE_PIOC, 0, 3)>;
		};
	};
};
