/*
 * Copyright (c) 2026 The HPM Zephyr Module Contributors
 * SPDX-License-Identifier: Apache-2.0
 *
 * Auto-generated by scripts/generate_hpm5361_pinctrl.py.
 * Source: HPM5361 QFN48, 6x6 mm QFN48, 0.4 mm pitch.
 */

#include <dt-bindings/pinctrl/hpmicro-pinctrl-common.h>

/ {
	hpm5361_package: hpm5361-package {
		compatible = "hpmicro,hpm5361-package";
		hpmicro,package = "qfn48";
		hpmicro,model = "HPM5361IEG1";
		hpmicro,gpio-count = <29>;
		hpmicro,analog-pin-count = <8>;
		hpmicro,available-pads = "PA00", "PA01", "PA02", "PA03", "PA04", "PA05", "PA06",
					 "PA07", "PA08", "PA09", "PA10", "PA24", "PA25", "PA26",
					 "PA27", "PA28", "PA29", "PA30", "PA31", "PB08", "PB09",
					 "PB10", "PB11", "PB12", "PB13", "PB14", "PB15", "PY00",
					 "PY01";
	};
};

&pinctrl {
	/* Port A */
	/omit-if-no-ref/ pa00_gpio_a_00: pa00_gpio_a_00 {
		group0 {
			pinmux = <HPMICRO_PINMUX(HPMICRO_PIN(HPMICRO_PORTA, 0), IOC_TYPE_IOC, 0, 0)>;
		};
	};

	/omit-if-no-ref/ pa00_gptmr1_comp_0: pa00_gptmr1_comp_0 {
		group0 {
			pinmux = <HPMICRO_PINMUX(HPMICRO_PIN(HPMICRO_PORTA, 0), IOC_TYPE_IOC, 0, 1)>;
		};
	};

	/omit-if-no-ref/ pa00_uart0_txd: pa00_uart0_txd {
		group0 {
			pinmux = <HPMICRO_PINMUX(HPMICRO_PIN(HPMICRO_PORTA, 0), IOC_TYPE_IOC, 0, 2)>;
		};
	};

	/omit-if-no-ref/ pa00_mcan0_txd: pa00_mcan0_txd {
		group0 {
			pinmux = <HPMICRO_PINMUX(HPMICRO_PIN(HPMICRO_PORTA, 0), IOC_TYPE_IOC, 0, 7)>;
		};
	};

	/omit-if-no-ref/ pa00_pwm0_fault_0: pa00_pwm0_fault_0 {
		group0 {
			pinmux = <HPMICRO_PINMUX(HPMICRO_PIN(HPMICRO_PORTA, 0), IOC_TYPE_IOC, 0, 16)>;
		};
	};

	/omit-if-no-ref/ pa00_pwm1_p_0: pa00_pwm1_p_0 {
		group0 {
			pinmux = <HPMICRO_PINMUX(HPMICRO_PIN(HPMICRO_PORTA, 0), IOC_TYPE_IOC, 0, 17)>;
		};
	};

	/omit-if-no-ref/ pa00_trgm0_p_00: pa00_trgm0_p_00 {
		group0 {
			pinmux = <HPMICRO_PINMUX(HPMICRO_PIN(HPMICRO_PORTA, 0), IOC_TYPE_IOC, 0, 18)>;
		};
	};

	/omit-if-no-ref/ pa00_pwm1_fault_0: pa00_pwm1_fault_0 {
		group0 {
			pinmux = <HPMICRO_PINMUX(HPMICRO_PIN(HPMICRO_PORTA, 0), IOC_TYPE_IOC, 0, 19)>;
		};
	};

	/omit-if-no-ref/ pa00_sysctl_clk_obs_0: pa00_sysctl_clk_obs_0 {
		group0 {
			pinmux = <HPMICRO_PINMUX(HPMICRO_PIN(HPMICRO_PORTA, 0), IOC_TYPE_IOC, 0, 24)>;
		};
	};

	/omit-if-no-ref/ pa01_gpio_a_01: pa01_gpio_a_01 {
		group0 {
			pinmux = <HPMICRO_PINMUX(HPMICRO_PIN(HPMICRO_PORTA, 1), IOC_TYPE_IOC, 0, 0)>;
		};
	};

	/omit-if-no-ref/ pa01_gptmr1_capt_0: pa01_gptmr1_capt_0 {
		group0 {
			pinmux = <HPMICRO_PINMUX(HPMICRO_PIN(HPMICRO_PORTA, 1), IOC_TYPE_IOC, 0, 1)>;
		};
	};

	/omit-if-no-ref/ pa01_uart0_rxd: pa01_uart0_rxd {
		group0 {
			pinmux = <HPMICRO_PINMUX(HPMICRO_PIN(HPMICRO_PORTA, 1), IOC_TYPE_IOC, 0, 2)>;
		};
	};

	/omit-if-no-ref/ pa01_mcan0_rxd: pa01_mcan0_rxd {
		group0 {
			pinmux = <HPMICRO_PINMUX(HPMICRO_PIN(HPMICRO_PORTA, 1), IOC_TYPE_IOC, 0, 7)>;
		};
	};

	/omit-if-no-ref/ pa01_pwm0_fault_1: pa01_pwm0_fault_1 {
		group0 {
			pinmux = <HPMICRO_PINMUX(HPMICRO_PIN(HPMICRO_PORTA, 1), IOC_TYPE_IOC, 0, 16)>;
		};
	};

	/omit-if-no-ref/ pa01_pwm1_p_1: pa01_pwm1_p_1 {
		group0 {
			pinmux = <HPMICRO_PINMUX(HPMICRO_PIN(HPMICRO_PORTA, 1), IOC_TYPE_IOC, 0, 17)>;
		};
	};

	/omit-if-no-ref/ pa01_trgm0_p_01: pa01_trgm0_p_01 {
		group0 {
			pinmux = <HPMICRO_PINMUX(HPMICRO_PIN(HPMICRO_PORTA, 1), IOC_TYPE_IOC, 0, 18)>;
		};
	};

	/omit-if-no-ref/ pa01_acmp_comp_0: pa01_acmp_comp_0 {
		group0 {
			pinmux = <HPMICRO_PINMUX(HPMICRO_PIN(HPMICRO_PORTA, 1), IOC_TYPE_IOC, 0, 19)>;
		};
	};

	/omit-if-no-ref/ pa01_sysctl_clk_obs_1: pa01_sysctl_clk_obs_1 {
		group0 {
			pinmux = <HPMICRO_PINMUX(HPMICRO_PIN(HPMICRO_PORTA, 1), IOC_TYPE_IOC, 0, 24)>;
		};
	};

	/omit-if-no-ref/ pa02_gpio_a_02: pa02_gpio_a_02 {
		group0 {
			pinmux = <HPMICRO_PINMUX(HPMICRO_PIN(HPMICRO_PORTA, 2), IOC_TYPE_IOC, 0, 0)>;
		};
	};

	/omit-if-no-ref/ pa02_gptmr1_comp_1: pa02_gptmr1_comp_1 {
		group0 {
			pinmux = <HPMICRO_PINMUX(HPMICRO_PIN(HPMICRO_PORTA, 2), IOC_TYPE_IOC, 0, 1)>;
		};
	};

	/omit-if-no-ref/ pa02_uart0_de: pa02_uart0_de {
		group0 {
			pinmux = <HPMICRO_PINMUX(HPMICRO_PIN(HPMICRO_PORTA, 2), IOC_TYPE_IOC, 0, 2)>;
		};
	};

	/omit-if-no-ref/ pa02_uart0_rts: pa02_uart0_rts {
		group0 {
			pinmux = <HPMICRO_PINMUX(HPMICRO_PIN(HPMICRO_PORTA, 2), IOC_TYPE_IOC, 0, 3)>;
		};
	};

	/omit-if-no-ref/ pa02_i2c0_scl: pa02_i2c0_scl {
		group0 {
			pinmux = <HPMICRO_PINMUX(HPMICRO_PIN(HPMICRO_PORTA, 2), IOC_TYPE_IOC, 0, 4)>;
		};
	};

	/omit-if-no-ref/ pa02_mcan0_stby: pa02_mcan0_stby {
		group0 {
			pinmux = <HPMICRO_PINMUX(HPMICRO_PIN(HPMICRO_PORTA, 2), IOC_TYPE_IOC, 0, 7)>;
		};
	};

	/omit-if-no-ref/ pa02_acmp_comp_0: pa02_acmp_comp_0 {
		group0 {
			pinmux = <HPMICRO_PINMUX(HPMICRO_PIN(HPMICRO_PORTA, 2), IOC_TYPE_IOC, 0, 16)>;
		};
	};

	/omit-if-no-ref/ pa02_pwm1_p_2: pa02_pwm1_p_2 {
		group0 {
			pinmux = <HPMICRO_PINMUX(HPMICRO_PIN(HPMICRO_PORTA, 2), IOC_TYPE_IOC, 0, 17)>;
		};
	};

	/omit-if-no-ref/ pa02_trgm0_p_02: pa02_trgm0_p_02 {
		group0 {
			pinmux = <HPMICRO_PINMUX(HPMICRO_PIN(HPMICRO_PORTA, 2), IOC_TYPE_IOC, 0, 18)>;
		};
	};

	/omit-if-no-ref/ pa02_acmp_comp_1: pa02_acmp_comp_1 {
		group0 {
			pinmux = <HPMICRO_PINMUX(HPMICRO_PIN(HPMICRO_PORTA, 2), IOC_TYPE_IOC, 0, 19)>;
		};
	};

	/omit-if-no-ref/ pa02_qei1_f: pa02_qei1_f {
		group0 {
			pinmux = <HPMICRO_PINMUX(HPMICRO_PIN(HPMICRO_PORTA, 2), IOC_TYPE_IOC, 0, 20)>;
		};
	};

	/omit-if-no-ref/ pa02_sysctl_clk_obs_2: pa02_sysctl_clk_obs_2 {
		group0 {
			pinmux = <HPMICRO_PINMUX(HPMICRO_PIN(HPMICRO_PORTA, 2), IOC_TYPE_IOC, 0, 24)>;
		};
	};

	/omit-if-no-ref/ pa03_gpio_a_03: pa03_gpio_a_03 {
		group0 {
			pinmux = <HPMICRO_PINMUX(HPMICRO_PIN(HPMICRO_PORTA, 3), IOC_TYPE_IOC, 0, 0)>;
		};
	};

	/omit-if-no-ref/ pa03_gptmr1_capt_1: pa03_gptmr1_capt_1 {
		group0 {
			pinmux = <HPMICRO_PINMUX(HPMICRO_PIN(HPMICRO_PORTA, 3), IOC_TYPE_IOC, 0, 1)>;
		};
	};

	/omit-if-no-ref/ pa03_uart0_cts: pa03_uart0_cts {
		group0 {
			pinmux = <HPMICRO_PINMUX(HPMICRO_PIN(HPMICRO_PORTA, 3), IOC_TYPE_IOC, 0, 3)>;
		};
	};

	/omit-if-no-ref/ pa03_i2c0_sda: pa03_i2c0_sda {
		group0 {
			pinmux = <HPMICRO_PINMUX(HPMICRO_PIN(HPMICRO_PORTA, 3), IOC_TYPE_IOC, 0, 4)>;
		};
	};

	/omit-if-no-ref/ pa03_spi3_cs_3: pa03_spi3_cs_3 {
		group0 {
			pinmux = <HPMICRO_PINMUX(HPMICRO_PIN(HPMICRO_PORTA, 3), IOC_TYPE_IOC, 0, 5)>;
		};
	};

	/omit-if-no-ref/ pa03_mcan1_stby: pa03_mcan1_stby {
		group0 {
			pinmux = <HPMICRO_PINMUX(HPMICRO_PIN(HPMICRO_PORTA, 3), IOC_TYPE_IOC, 0, 7)>;
		};
	};

	/omit-if-no-ref/ pa03_acmp_comp_1: pa03_acmp_comp_1 {
		group0 {
			pinmux = <HPMICRO_PINMUX(HPMICRO_PIN(HPMICRO_PORTA, 3), IOC_TYPE_IOC, 0, 16)>;
		};
	};

	/omit-if-no-ref/ pa03_pwm1_p_3: pa03_pwm1_p_3 {
		group0 {
			pinmux = <HPMICRO_PINMUX(HPMICRO_PIN(HPMICRO_PORTA, 3), IOC_TYPE_IOC, 0, 17)>;
		};
	};

	/omit-if-no-ref/ pa03_trgm0_p_03: pa03_trgm0_p_03 {
		group0 {
			pinmux = <HPMICRO_PINMUX(HPMICRO_PIN(HPMICRO_PORTA, 3), IOC_TYPE_IOC, 0, 18)>;
		};
	};

	/omit-if-no-ref/ pa03_pwm1_fault_1: pa03_pwm1_fault_1 {
		group0 {
			pinmux = <HPMICRO_PINMUX(HPMICRO_PIN(HPMICRO_PORTA, 3), IOC_TYPE_IOC, 0, 19)>;
		};
	};

	/omit-if-no-ref/ pa03_qei1_h1: pa03_qei1_h1 {
		group0 {
			pinmux = <HPMICRO_PINMUX(HPMICRO_PIN(HPMICRO_PORTA, 3), IOC_TYPE_IOC, 0, 20)>;
		};
	};

	/omit-if-no-ref/ pa03_sysctl_clk_obs_3: pa03_sysctl_clk_obs_3 {
		group0 {
			pinmux = <HPMICRO_PINMUX(HPMICRO_PIN(HPMICRO_PORTA, 3), IOC_TYPE_IOC, 0, 24)>;
		};
	};

	/omit-if-no-ref/ pa04_gpio_a_04: pa04_gpio_a_04 {
		group0 {
			pinmux = <HPMICRO_PINMUX(HPMICRO_PIN(HPMICRO_PORTA, 4), IOC_TYPE_IOC, 0, 0)>;
		};
	};

	/omit-if-no-ref/ pa04_uart1_cts: pa04_uart1_cts {
		group0 {
			pinmux = <HPMICRO_PINMUX(HPMICRO_PIN(HPMICRO_PORTA, 4), IOC_TYPE_IOC, 0, 3)>;
		};
	};

	/omit-if-no-ref/ pa04_spi0_cs_0: pa04_spi0_cs_0 {
		group0 {
			pinmux = <HPMICRO_PINMUX(HPMICRO_PIN(HPMICRO_PORTA, 4), IOC_TYPE_IOC, 0, 5)>;
		};
	};

	/omit-if-no-ref/ pa04_mcan1_rxd: pa04_mcan1_rxd {
		group0 {
			pinmux = <HPMICRO_PINMUX(HPMICRO_PIN(HPMICRO_PORTA, 4), IOC_TYPE_IOC, 0, 7)>;
		};
	};

	/omit-if-no-ref/ pa04_pwm0_p_0: pa04_pwm0_p_0 {
		group0 {
			pinmux = <HPMICRO_PINMUX(HPMICRO_PIN(HPMICRO_PORTA, 4), IOC_TYPE_IOC, 0, 16)>;
		};
	};

	/omit-if-no-ref/ pa04_pwm1_p_4: pa04_pwm1_p_4 {
		group0 {
			pinmux = <HPMICRO_PINMUX(HPMICRO_PIN(HPMICRO_PORTA, 4), IOC_TYPE_IOC, 0, 17)>;
		};
	};

	/omit-if-no-ref/ pa04_trgm0_p_04: pa04_trgm0_p_04 {
		group0 {
			pinmux = <HPMICRO_PINMUX(HPMICRO_PIN(HPMICRO_PORTA, 4), IOC_TYPE_IOC, 0, 18)>;
		};
	};

	/omit-if-no-ref/ pa04_rdc0_exc_p: pa04_rdc0_exc_p {
		group0 {
			pinmux = <HPMICRO_PINMUX(HPMICRO_PIN(HPMICRO_PORTA, 4), IOC_TYPE_IOC, 0, 19)>;
		};
	};

	/omit-if-no-ref/ pa04_qei1_a: pa04_qei1_a {
		group0 {
			pinmux = <HPMICRO_PINMUX(HPMICRO_PIN(HPMICRO_PORTA, 4), IOC_TYPE_IOC, 0, 20)>;
		};
	};

	/omit-if-no-ref/ pa04_qeo1_a: pa04_qeo1_a {
		group0 {
			pinmux = <HPMICRO_PINMUX(HPMICRO_PIN(HPMICRO_PORTA, 4), IOC_TYPE_IOC, 0, 21)>;
		};
	};

	/omit-if-no-ref/ pa04_sei1_de: pa04_sei1_de {
		group0 {
			pinmux = <HPMICRO_PINMUX(HPMICRO_PIN(HPMICRO_PORTA, 4), IOC_TYPE_IOC, 0, 22)>;
		};
	};

	/omit-if-no-ref/ pa04_jtag_tdo: pa04_jtag_tdo {
		group0 {
			pinmux = <HPMICRO_PINMUX(HPMICRO_PIN(HPMICRO_PORTA, 4), IOC_TYPE_IOC, 0, 24)>;
		};
	};

	/omit-if-no-ref/ pa05_gpio_a_05: pa05_gpio_a_05 {
		group0 {
			pinmux = <HPMICRO_PINMUX(HPMICRO_PIN(HPMICRO_PORTA, 5), IOC_TYPE_IOC, 0, 0)>;
		};
	};

	/omit-if-no-ref/ pa05_gptmr1_comp_2: pa05_gptmr1_comp_2 {
		group0 {
			pinmux = <HPMICRO_PINMUX(HPMICRO_PIN(HPMICRO_PORTA, 5), IOC_TYPE_IOC, 0, 1)>;
		};
	};

	/omit-if-no-ref/ pa05_uart1_de: pa05_uart1_de {
		group0 {
			pinmux = <HPMICRO_PINMUX(HPMICRO_PIN(HPMICRO_PORTA, 5), IOC_TYPE_IOC, 0, 2)>;
		};
	};

	/omit-if-no-ref/ pa05_uart1_rts: pa05_uart1_rts {
		group0 {
			pinmux = <HPMICRO_PINMUX(HPMICRO_PIN(HPMICRO_PORTA, 5), IOC_TYPE_IOC, 0, 3)>;
		};
	};

	/omit-if-no-ref/ pa05_spi0_sclk: pa05_spi0_sclk {
		group0 {
			pinmux = <HPMICRO_PINMUX(HPMICRO_PIN(HPMICRO_PORTA, 5), IOC_TYPE_IOC, 0, 5)>;
		};
	};

	/omit-if-no-ref/ pa05_mcan1_txd: pa05_mcan1_txd {
		group0 {
			pinmux = <HPMICRO_PINMUX(HPMICRO_PIN(HPMICRO_PORTA, 5), IOC_TYPE_IOC, 0, 7)>;
		};
	};

	/omit-if-no-ref/ pa05_pwm0_p_1: pa05_pwm0_p_1 {
		group0 {
			pinmux = <HPMICRO_PINMUX(HPMICRO_PIN(HPMICRO_PORTA, 5), IOC_TYPE_IOC, 0, 16)>;
		};
	};

	/omit-if-no-ref/ pa05_pwm1_p_5: pa05_pwm1_p_5 {
		group0 {
			pinmux = <HPMICRO_PINMUX(HPMICRO_PIN(HPMICRO_PORTA, 5), IOC_TYPE_IOC, 0, 17)>;
		};
	};

	/omit-if-no-ref/ pa05_trgm0_p_05: pa05_trgm0_p_05 {
		group0 {
			pinmux = <HPMICRO_PINMUX(HPMICRO_PIN(HPMICRO_PORTA, 5), IOC_TYPE_IOC, 0, 18)>;
		};
	};

	/omit-if-no-ref/ pa05_rdc0_exc_n: pa05_rdc0_exc_n {
		group0 {
			pinmux = <HPMICRO_PINMUX(HPMICRO_PIN(HPMICRO_PORTA, 5), IOC_TYPE_IOC, 0, 19)>;
		};
	};

	/omit-if-no-ref/ pa05_qei1_b: pa05_qei1_b {
		group0 {
			pinmux = <HPMICRO_PINMUX(HPMICRO_PIN(HPMICRO_PORTA, 5), IOC_TYPE_IOC, 0, 20)>;
		};
	};

	/omit-if-no-ref/ pa05_qeo1_b: pa05_qeo1_b {
		group0 {
			pinmux = <HPMICRO_PINMUX(HPMICRO_PIN(HPMICRO_PORTA, 5), IOC_TYPE_IOC, 0, 21)>;
		};
	};

	/omit-if-no-ref/ pa05_sei1_ck: pa05_sei1_ck {
		group0 {
			pinmux = <HPMICRO_PINMUX(HPMICRO_PIN(HPMICRO_PORTA, 5), IOC_TYPE_IOC, 0, 22)>;
		};
	};

	/omit-if-no-ref/ pa05_jtag_tdi: pa05_jtag_tdi {
		group0 {
			pinmux = <HPMICRO_PINMUX(HPMICRO_PIN(HPMICRO_PORTA, 5), IOC_TYPE_IOC, 0, 24)>;
		};
	};

	/omit-if-no-ref/ pa06_gpio_a_06: pa06_gpio_a_06 {
		group0 {
			pinmux = <HPMICRO_PINMUX(HPMICRO_PIN(HPMICRO_PORTA, 6), IOC_TYPE_IOC, 0, 0)>;
		};
	};

	/omit-if-no-ref/ pa06_gptmr0_capt_0: pa06_gptmr0_capt_0 {
		group0 {
			pinmux = <HPMICRO_PINMUX(HPMICRO_PIN(HPMICRO_PORTA, 6), IOC_TYPE_IOC, 0, 1)>;
		};
	};

	/omit-if-no-ref/ pa06_uart1_rxd: pa06_uart1_rxd {
		group0 {
			pinmux = <HPMICRO_PINMUX(HPMICRO_PIN(HPMICRO_PORTA, 6), IOC_TYPE_IOC, 0, 2)>;
		};
	};

	/omit-if-no-ref/ pa06_i2c1_sda: pa06_i2c1_sda {
		group0 {
			pinmux = <HPMICRO_PINMUX(HPMICRO_PIN(HPMICRO_PORTA, 6), IOC_TYPE_IOC, 0, 4)>;
		};
	};

	/omit-if-no-ref/ pa06_spi0_miso: pa06_spi0_miso {
		group0 {
			pinmux = <HPMICRO_PINMUX(HPMICRO_PIN(HPMICRO_PORTA, 6), IOC_TYPE_IOC, 0, 5)>;
		};
	};

	/omit-if-no-ref/ pa06_pwm0_p_2: pa06_pwm0_p_2 {
		group0 {
			pinmux = <HPMICRO_PINMUX(HPMICRO_PIN(HPMICRO_PORTA, 6), IOC_TYPE_IOC, 0, 16)>;
		};
	};

	/omit-if-no-ref/ pa06_pwm1_p_6: pa06_pwm1_p_6 {
		group0 {
			pinmux = <HPMICRO_PINMUX(HPMICRO_PIN(HPMICRO_PORTA, 6), IOC_TYPE_IOC, 0, 17)>;
		};
	};

	/omit-if-no-ref/ pa06_trgm0_p_06: pa06_trgm0_p_06 {
		group0 {
			pinmux = <HPMICRO_PINMUX(HPMICRO_PIN(HPMICRO_PORTA, 6), IOC_TYPE_IOC, 0, 18)>;
		};
	};

	/omit-if-no-ref/ pa06_qei1_z: pa06_qei1_z {
		group0 {
			pinmux = <HPMICRO_PINMUX(HPMICRO_PIN(HPMICRO_PORTA, 6), IOC_TYPE_IOC, 0, 20)>;
		};
	};

	/omit-if-no-ref/ pa06_qeo1_z: pa06_qeo1_z {
		group0 {
			pinmux = <HPMICRO_PINMUX(HPMICRO_PIN(HPMICRO_PORTA, 6), IOC_TYPE_IOC, 0, 21)>;
		};
	};

	/omit-if-no-ref/ pa06_sei1_tx: pa06_sei1_tx {
		group0 {
			pinmux = <HPMICRO_PINMUX(HPMICRO_PIN(HPMICRO_PORTA, 6), IOC_TYPE_IOC, 0, 22)>;
		};
	};

	/omit-if-no-ref/ pa06_jtag_tck: pa06_jtag_tck {
		group0 {
			pinmux = <HPMICRO_PINMUX(HPMICRO_PIN(HPMICRO_PORTA, 6), IOC_TYPE_IOC, 0, 24)>;
		};
	};

	/omit-if-no-ref/ pa07_gpio_a_07: pa07_gpio_a_07 {
		group0 {
			pinmux = <HPMICRO_PINMUX(HPMICRO_PIN(HPMICRO_PORTA, 7), IOC_TYPE_IOC, 0, 0)>;
		};
	};

	/omit-if-no-ref/ pa07_gptmr0_comp_0: pa07_gptmr0_comp_0 {
		group0 {
			pinmux = <HPMICRO_PINMUX(HPMICRO_PIN(HPMICRO_PORTA, 7), IOC_TYPE_IOC, 0, 1)>;
		};
	};

	/omit-if-no-ref/ pa07_uart1_txd: pa07_uart1_txd {
		group0 {
			pinmux = <HPMICRO_PINMUX(HPMICRO_PIN(HPMICRO_PORTA, 7), IOC_TYPE_IOC, 0, 2)>;
		};
	};

	/omit-if-no-ref/ pa07_i2c1_scl: pa07_i2c1_scl {
		group0 {
			pinmux = <HPMICRO_PINMUX(HPMICRO_PIN(HPMICRO_PORTA, 7), IOC_TYPE_IOC, 0, 4)>;
		};
	};

	/omit-if-no-ref/ pa07_spi0_mosi: pa07_spi0_mosi {
		group0 {
			pinmux = <HPMICRO_PINMUX(HPMICRO_PIN(HPMICRO_PORTA, 7), IOC_TYPE_IOC, 0, 5)>;
		};
	};

	/omit-if-no-ref/ pa07_pwm0_p_3: pa07_pwm0_p_3 {
		group0 {
			pinmux = <HPMICRO_PINMUX(HPMICRO_PIN(HPMICRO_PORTA, 7), IOC_TYPE_IOC, 0, 16)>;
		};
	};

	/omit-if-no-ref/ pa07_pwm1_p_7: pa07_pwm1_p_7 {
		group0 {
			pinmux = <HPMICRO_PINMUX(HPMICRO_PIN(HPMICRO_PORTA, 7), IOC_TYPE_IOC, 0, 17)>;
		};
	};

	/omit-if-no-ref/ pa07_trgm0_p_07: pa07_trgm0_p_07 {
		group0 {
			pinmux = <HPMICRO_PINMUX(HPMICRO_PIN(HPMICRO_PORTA, 7), IOC_TYPE_IOC, 0, 18)>;
		};
	};

	/omit-if-no-ref/ pa07_qei1_h0: pa07_qei1_h0 {
		group0 {
			pinmux = <HPMICRO_PINMUX(HPMICRO_PIN(HPMICRO_PORTA, 7), IOC_TYPE_IOC, 0, 20)>;
		};
	};

	/omit-if-no-ref/ pa07_sei1_rx: pa07_sei1_rx {
		group0 {
			pinmux = <HPMICRO_PINMUX(HPMICRO_PIN(HPMICRO_PORTA, 7), IOC_TYPE_IOC, 0, 22)>;
		};
	};

	/omit-if-no-ref/ pa07_jtag_tms: pa07_jtag_tms {
		group0 {
			pinmux = <HPMICRO_PINMUX(HPMICRO_PIN(HPMICRO_PORTA, 7), IOC_TYPE_IOC, 0, 24)>;
		};
	};

	/omit-if-no-ref/ pa08_gpio_a_08: pa08_gpio_a_08 {
		group0 {
			pinmux = <HPMICRO_PINMUX(HPMICRO_PIN(HPMICRO_PORTA, 8), IOC_TYPE_IOC, 0, 0)>;
		};
	};

	/omit-if-no-ref/ pa08_gptmr0_comp_1: pa08_gptmr0_comp_1 {
		group0 {
			pinmux = <HPMICRO_PINMUX(HPMICRO_PIN(HPMICRO_PORTA, 8), IOC_TYPE_IOC, 0, 1)>;
		};
	};

	/omit-if-no-ref/ pa08_uart2_txd: pa08_uart2_txd {
		group0 {
			pinmux = <HPMICRO_PINMUX(HPMICRO_PIN(HPMICRO_PORTA, 8), IOC_TYPE_IOC, 0, 2)>;
		};
	};

	/omit-if-no-ref/ pa08_i2c2_scl: pa08_i2c2_scl {
		group0 {
			pinmux = <HPMICRO_PINMUX(HPMICRO_PIN(HPMICRO_PORTA, 8), IOC_TYPE_IOC, 0, 4)>;
		};
	};

	/omit-if-no-ref/ pa08_spi3_cs_2: pa08_spi3_cs_2 {
		group0 {
			pinmux = <HPMICRO_PINMUX(HPMICRO_PIN(HPMICRO_PORTA, 8), IOC_TYPE_IOC, 0, 5)>;
		};
	};

	/omit-if-no-ref/ pa08_mcan2_txd: pa08_mcan2_txd {
		group0 {
			pinmux = <HPMICRO_PINMUX(HPMICRO_PIN(HPMICRO_PORTA, 8), IOC_TYPE_IOC, 0, 7)>;
		};
	};

	/omit-if-no-ref/ pa08_pwm0_p_4: pa08_pwm0_p_4 {
		group0 {
			pinmux = <HPMICRO_PINMUX(HPMICRO_PIN(HPMICRO_PORTA, 8), IOC_TYPE_IOC, 0, 16)>;
		};
	};

	/omit-if-no-ref/ pa08_pwm0_fault_0: pa08_pwm0_fault_0 {
		group0 {
			pinmux = <HPMICRO_PINMUX(HPMICRO_PIN(HPMICRO_PORTA, 8), IOC_TYPE_IOC, 0, 18)>;
		};
	};

	/omit-if-no-ref/ pa08_jtag_trst: pa08_jtag_trst {
		group0 {
			pinmux = <HPMICRO_PINMUX(HPMICRO_PIN(HPMICRO_PORTA, 8), IOC_TYPE_IOC, 0, 24)>;
		};
	};

	/omit-if-no-ref/ pa09_gpio_a_09: pa09_gpio_a_09 {
		group0 {
			pinmux = <HPMICRO_PINMUX(HPMICRO_PIN(HPMICRO_PORTA, 9), IOC_TYPE_IOC, 0, 0)>;
		};
	};

	/omit-if-no-ref/ pa09_gptmr0_capt_1: pa09_gptmr0_capt_1 {
		group0 {
			pinmux = <HPMICRO_PINMUX(HPMICRO_PIN(HPMICRO_PORTA, 9), IOC_TYPE_IOC, 0, 1)>;
		};
	};

	/omit-if-no-ref/ pa09_uart2_rxd: pa09_uart2_rxd {
		group0 {
			pinmux = <HPMICRO_PINMUX(HPMICRO_PIN(HPMICRO_PORTA, 9), IOC_TYPE_IOC, 0, 2)>;
		};
	};

	/omit-if-no-ref/ pa09_i2c2_sda: pa09_i2c2_sda {
		group0 {
			pinmux = <HPMICRO_PINMUX(HPMICRO_PIN(HPMICRO_PORTA, 9), IOC_TYPE_IOC, 0, 4)>;
		};
	};

	/omit-if-no-ref/ pa09_spi3_cs_1: pa09_spi3_cs_1 {
		group0 {
			pinmux = <HPMICRO_PINMUX(HPMICRO_PIN(HPMICRO_PORTA, 9), IOC_TYPE_IOC, 0, 5)>;
		};
	};

	/omit-if-no-ref/ pa09_mcan2_rxd: pa09_mcan2_rxd {
		group0 {
			pinmux = <HPMICRO_PINMUX(HPMICRO_PIN(HPMICRO_PORTA, 9), IOC_TYPE_IOC, 0, 7)>;
		};
	};

	/omit-if-no-ref/ pa09_pwm0_p_5: pa09_pwm0_p_5 {
		group0 {
			pinmux = <HPMICRO_PINMUX(HPMICRO_PIN(HPMICRO_PORTA, 9), IOC_TYPE_IOC, 0, 16)>;
		};
	};

	/omit-if-no-ref/ pa09_pwm0_fault_1: pa09_pwm0_fault_1 {
		group0 {
			pinmux = <HPMICRO_PINMUX(HPMICRO_PIN(HPMICRO_PORTA, 9), IOC_TYPE_IOC, 0, 18)>;
		};
	};

	/omit-if-no-ref/ pa09_soc_ref0: pa09_soc_ref0 {
		group0 {
			pinmux = <HPMICRO_PINMUX(HPMICRO_PIN(HPMICRO_PORTA, 9), IOC_TYPE_IOC, 0, 24)>;
		};
	};

	/omit-if-no-ref/ pa10_gpio_a_10: pa10_gpio_a_10 {
		group0 {
			pinmux = <HPMICRO_PINMUX(HPMICRO_PIN(HPMICRO_PORTA, 10), IOC_TYPE_IOC, 0, 0)>;
		};
	};

	/omit-if-no-ref/ pa10_gptmr0_comp_2: pa10_gptmr0_comp_2 {
		group0 {
			pinmux = <HPMICRO_PINMUX(HPMICRO_PIN(HPMICRO_PORTA, 10), IOC_TYPE_IOC, 0, 1)>;
		};
	};

	/omit-if-no-ref/ pa10_uart2_de: pa10_uart2_de {
		group0 {
			pinmux = <HPMICRO_PINMUX(HPMICRO_PIN(HPMICRO_PORTA, 10), IOC_TYPE_IOC, 0, 2)>;
		};
	};

	/omit-if-no-ref/ pa10_uart2_rts: pa10_uart2_rts {
		group0 {
			pinmux = <HPMICRO_PINMUX(HPMICRO_PIN(HPMICRO_PORTA, 10), IOC_TYPE_IOC, 0, 3)>;
		};
	};

	/omit-if-no-ref/ pa10_spi3_cs_0: pa10_spi3_cs_0 {
		group0 {
			pinmux = <HPMICRO_PINMUX(HPMICRO_PIN(HPMICRO_PORTA, 10), IOC_TYPE_IOC, 0, 5)>;
		};
	};

	/omit-if-no-ref/ pa10_mcan2_stby: pa10_mcan2_stby {
		group0 {
			pinmux = <HPMICRO_PINMUX(HPMICRO_PIN(HPMICRO_PORTA, 10), IOC_TYPE_IOC, 0, 7)>;
		};
	};

	/omit-if-no-ref/ pa10_pwm0_p_6: pa10_pwm0_p_6 {
		group0 {
			pinmux = <HPMICRO_PINMUX(HPMICRO_PIN(HPMICRO_PORTA, 10), IOC_TYPE_IOC, 0, 16)>;
		};
	};

	/omit-if-no-ref/ pa10_pwm1_fault_0: pa10_pwm1_fault_0 {
		group0 {
			pinmux = <HPMICRO_PINMUX(HPMICRO_PIN(HPMICRO_PORTA, 10), IOC_TYPE_IOC, 0, 17)>;
		};
	};

	/omit-if-no-ref/ pa10_acmp_comp_0: pa10_acmp_comp_0 {
		group0 {
			pinmux = <HPMICRO_PINMUX(HPMICRO_PIN(HPMICRO_PORTA, 10), IOC_TYPE_IOC, 0, 18)>;
		};
	};

	/omit-if-no-ref/ pa10_qei1_a: pa10_qei1_a {
		group0 {
			pinmux = <HPMICRO_PINMUX(HPMICRO_PIN(HPMICRO_PORTA, 10), IOC_TYPE_IOC, 0, 20)>;
		};
	};

	/omit-if-no-ref/ pa10_qeo0_a: pa10_qeo0_a {
		group0 {
			pinmux = <HPMICRO_PINMUX(HPMICRO_PIN(HPMICRO_PORTA, 10), IOC_TYPE_IOC, 0, 21)>;
		};
	};

	/omit-if-no-ref/ pa10_sei1_de: pa10_sei1_de {
		group0 {
			pinmux = <HPMICRO_PINMUX(HPMICRO_PIN(HPMICRO_PORTA, 10), IOC_TYPE_IOC, 0, 22)>;
		};
	};

	/omit-if-no-ref/ pa24_gpio_a_24: pa24_gpio_a_24 {
		group0 {
			pinmux = <HPMICRO_PINMUX(HPMICRO_PIN(HPMICRO_PORTA, 24), IOC_TYPE_IOC, 0, 0)>;
		};
	};

	/omit-if-no-ref/ pa24_gptmr2_comp_1: pa24_gptmr2_comp_1 {
		group0 {
			pinmux = <HPMICRO_PINMUX(HPMICRO_PIN(HPMICRO_PORTA, 24), IOC_TYPE_IOC, 0, 1)>;
		};
	};

	/omit-if-no-ref/ pa24_uart6_txd: pa24_uart6_txd {
		group0 {
			pinmux = <HPMICRO_PINMUX(HPMICRO_PIN(HPMICRO_PORTA, 24), IOC_TYPE_IOC, 0, 2)>;
		};
	};

	/omit-if-no-ref/ pa24_i2c2_scl: pa24_i2c2_scl {
		group0 {
			pinmux = <HPMICRO_PINMUX(HPMICRO_PIN(HPMICRO_PORTA, 24), IOC_TYPE_IOC, 0, 4)>;
		};
	};

	/omit-if-no-ref/ pa24_spi1_cs_2: pa24_spi1_cs_2 {
		group0 {
			pinmux = <HPMICRO_PINMUX(HPMICRO_PIN(HPMICRO_PORTA, 24), IOC_TYPE_IOC, 0, 5)>;
		};
	};

	/omit-if-no-ref/ pa24_mcan2_txd: pa24_mcan2_txd {
		group0 {
			pinmux = <HPMICRO_PINMUX(HPMICRO_PIN(HPMICRO_PORTA, 24), IOC_TYPE_IOC, 0, 7)>;
		};
	};

	/omit-if-no-ref/ pa24_xpi0_ca_cs1: pa24_xpi0_ca_cs1 {
		group0 {
			pinmux = <HPMICRO_PINMUX(HPMICRO_PIN(HPMICRO_PORTA, 24), IOC_TYPE_IOC, 0, 14)>;
		};
	};

	/omit-if-no-ref/ pa24_pwm0_p_0: pa24_pwm0_p_0 {
		group0 {
			pinmux = <HPMICRO_PINMUX(HPMICRO_PIN(HPMICRO_PORTA, 24), IOC_TYPE_IOC, 0, 16)>;
		};
	};

	/omit-if-no-ref/ pa24_pwm1_p_0: pa24_pwm1_p_0 {
		group0 {
			pinmux = <HPMICRO_PINMUX(HPMICRO_PIN(HPMICRO_PORTA, 24), IOC_TYPE_IOC, 0, 17)>;
		};
	};

	/omit-if-no-ref/ pa24_trgm0_p_00: pa24_trgm0_p_00 {
		group0 {
			pinmux = <HPMICRO_PINMUX(HPMICRO_PIN(HPMICRO_PORTA, 24), IOC_TYPE_IOC, 0, 18)>;
		};
	};

	/omit-if-no-ref/ pa24_qei0_h1: pa24_qei0_h1 {
		group0 {
			pinmux = <HPMICRO_PINMUX(HPMICRO_PIN(HPMICRO_PORTA, 24), IOC_TYPE_IOC, 0, 20)>;
		};
	};

	/omit-if-no-ref/ pa25_gpio_a_25: pa25_gpio_a_25 {
		group0 {
			pinmux = <HPMICRO_PINMUX(HPMICRO_PIN(HPMICRO_PORTA, 25), IOC_TYPE_IOC, 0, 0)>;
		};
	};

	/omit-if-no-ref/ pa25_gptmr2_capt_1: pa25_gptmr2_capt_1 {
		group0 {
			pinmux = <HPMICRO_PINMUX(HPMICRO_PIN(HPMICRO_PORTA, 25), IOC_TYPE_IOC, 0, 1)>;
		};
	};

	/omit-if-no-ref/ pa25_uart6_rxd: pa25_uart6_rxd {
		group0 {
			pinmux = <HPMICRO_PINMUX(HPMICRO_PIN(HPMICRO_PORTA, 25), IOC_TYPE_IOC, 0, 2)>;
		};
	};

	/omit-if-no-ref/ pa25_i2c2_sda: pa25_i2c2_sda {
		group0 {
			pinmux = <HPMICRO_PINMUX(HPMICRO_PIN(HPMICRO_PORTA, 25), IOC_TYPE_IOC, 0, 4)>;
		};
	};

	/omit-if-no-ref/ pa25_spi1_cs_1: pa25_spi1_cs_1 {
		group0 {
			pinmux = <HPMICRO_PINMUX(HPMICRO_PIN(HPMICRO_PORTA, 25), IOC_TYPE_IOC, 0, 5)>;
		};
	};

	/omit-if-no-ref/ pa25_mcan2_rxd: pa25_mcan2_rxd {
		group0 {
			pinmux = <HPMICRO_PINMUX(HPMICRO_PIN(HPMICRO_PORTA, 25), IOC_TYPE_IOC, 0, 7)>;
		};
	};

	/omit-if-no-ref/ pa25_xpi0_ca_dqs: pa25_xpi0_ca_dqs {
		group0 {
			pinmux = <HPMICRO_PINMUX(HPMICRO_PIN(HPMICRO_PORTA, 25), IOC_TYPE_IOC, 0, 14)>;
		};
	};

	/omit-if-no-ref/ pa25_pwm0_p_1: pa25_pwm0_p_1 {
		group0 {
			pinmux = <HPMICRO_PINMUX(HPMICRO_PIN(HPMICRO_PORTA, 25), IOC_TYPE_IOC, 0, 16)>;
		};
	};

	/omit-if-no-ref/ pa25_pwm1_p_1: pa25_pwm1_p_1 {
		group0 {
			pinmux = <HPMICRO_PINMUX(HPMICRO_PIN(HPMICRO_PORTA, 25), IOC_TYPE_IOC, 0, 17)>;
		};
	};

	/omit-if-no-ref/ pa25_trgm0_p_01: pa25_trgm0_p_01 {
		group0 {
			pinmux = <HPMICRO_PINMUX(HPMICRO_PIN(HPMICRO_PORTA, 25), IOC_TYPE_IOC, 0, 18)>;
		};
	};

	/omit-if-no-ref/ pa25_qei0_f: pa25_qei0_f {
		group0 {
			pinmux = <HPMICRO_PINMUX(HPMICRO_PIN(HPMICRO_PORTA, 25), IOC_TYPE_IOC, 0, 20)>;
		};
	};

	/omit-if-no-ref/ pa26_gpio_a_26: pa26_gpio_a_26 {
		group0 {
			pinmux = <HPMICRO_PINMUX(HPMICRO_PIN(HPMICRO_PORTA, 26), IOC_TYPE_IOC, 0, 0)>;
		};
	};

	/omit-if-no-ref/ pa26_gptmr2_comp_2: pa26_gptmr2_comp_2 {
		group0 {
			pinmux = <HPMICRO_PINMUX(HPMICRO_PIN(HPMICRO_PORTA, 26), IOC_TYPE_IOC, 0, 1)>;
		};
	};

	/omit-if-no-ref/ pa26_uart6_de: pa26_uart6_de {
		group0 {
			pinmux = <HPMICRO_PINMUX(HPMICRO_PIN(HPMICRO_PORTA, 26), IOC_TYPE_IOC, 0, 2)>;
		};
	};

	/omit-if-no-ref/ pa26_uart6_rts: pa26_uart6_rts {
		group0 {
			pinmux = <HPMICRO_PINMUX(HPMICRO_PIN(HPMICRO_PORTA, 26), IOC_TYPE_IOC, 0, 3)>;
		};
	};

	/omit-if-no-ref/ pa26_spi1_cs_0: pa26_spi1_cs_0 {
		group0 {
			pinmux = <HPMICRO_PINMUX(HPMICRO_PIN(HPMICRO_PORTA, 26), IOC_TYPE_IOC, 0, 5)>;
		};
	};

	/omit-if-no-ref/ pa26_mcan2_stby: pa26_mcan2_stby {
		group0 {
			pinmux = <HPMICRO_PINMUX(HPMICRO_PIN(HPMICRO_PORTA, 26), IOC_TYPE_IOC, 0, 7)>;
		};
	};

	/omit-if-no-ref/ pa26_xpi0_ca_d_3: pa26_xpi0_ca_d_3 {
		group0 {
			pinmux = <HPMICRO_PINMUX(HPMICRO_PIN(HPMICRO_PORTA, 26), IOC_TYPE_IOC, 0, 14)>;
		};
	};

	/omit-if-no-ref/ pa26_pwm0_p_2: pa26_pwm0_p_2 {
		group0 {
			pinmux = <HPMICRO_PINMUX(HPMICRO_PIN(HPMICRO_PORTA, 26), IOC_TYPE_IOC, 0, 16)>;
		};
	};

	/omit-if-no-ref/ pa26_pwm1_p_2: pa26_pwm1_p_2 {
		group0 {
			pinmux = <HPMICRO_PINMUX(HPMICRO_PIN(HPMICRO_PORTA, 26), IOC_TYPE_IOC, 0, 17)>;
		};
	};

	/omit-if-no-ref/ pa26_trgm0_p_02: pa26_trgm0_p_02 {
		group0 {
			pinmux = <HPMICRO_PINMUX(HPMICRO_PIN(HPMICRO_PORTA, 26), IOC_TYPE_IOC, 0, 18)>;
		};
	};

	/omit-if-no-ref/ pa26_qei0_a: pa26_qei0_a {
		group0 {
			pinmux = <HPMICRO_PINMUX(HPMICRO_PIN(HPMICRO_PORTA, 26), IOC_TYPE_IOC, 0, 20)>;
		};
	};

	/omit-if-no-ref/ pa26_qeo0_a: pa26_qeo0_a {
		group0 {
			pinmux = <HPMICRO_PINMUX(HPMICRO_PIN(HPMICRO_PORTA, 26), IOC_TYPE_IOC, 0, 21)>;
		};
	};

	/omit-if-no-ref/ pa26_sei0_de: pa26_sei0_de {
		group0 {
			pinmux = <HPMICRO_PINMUX(HPMICRO_PIN(HPMICRO_PORTA, 26), IOC_TYPE_IOC, 0, 22)>;
		};
	};

	/omit-if-no-ref/ pa26_sysctl_clk_obs_0: pa26_sysctl_clk_obs_0 {
		group0 {
			pinmux = <HPMICRO_PINMUX(HPMICRO_PIN(HPMICRO_PORTA, 26), IOC_TYPE_IOC, 0, 24)>;
		};
	};

	/omit-if-no-ref/ pa27_gpio_a_27: pa27_gpio_a_27 {
		group0 {
			pinmux = <HPMICRO_PINMUX(HPMICRO_PIN(HPMICRO_PORTA, 27), IOC_TYPE_IOC, 0, 0)>;
		};
	};

	/omit-if-no-ref/ pa27_uart6_cts: pa27_uart6_cts {
		group0 {
			pinmux = <HPMICRO_PINMUX(HPMICRO_PIN(HPMICRO_PORTA, 27), IOC_TYPE_IOC, 0, 3)>;
		};
	};

	/omit-if-no-ref/ pa27_spi1_sclk: pa27_spi1_sclk {
		group0 {
			pinmux = <HPMICRO_PINMUX(HPMICRO_PIN(HPMICRO_PORTA, 27), IOC_TYPE_IOC, 0, 5)>;
		};
	};

	/omit-if-no-ref/ pa27_xpi0_ca_sclk: pa27_xpi0_ca_sclk {
		group0 {
			pinmux = <HPMICRO_PINMUX(HPMICRO_PIN(HPMICRO_PORTA, 27), IOC_TYPE_IOC, 0, 14)>;
		};
	};

	/omit-if-no-ref/ pa27_pwm0_p_3: pa27_pwm0_p_3 {
		group0 {
			pinmux = <HPMICRO_PINMUX(HPMICRO_PIN(HPMICRO_PORTA, 27), IOC_TYPE_IOC, 0, 16)>;
		};
	};

	/omit-if-no-ref/ pa27_pwm1_p_3: pa27_pwm1_p_3 {
		group0 {
			pinmux = <HPMICRO_PINMUX(HPMICRO_PIN(HPMICRO_PORTA, 27), IOC_TYPE_IOC, 0, 17)>;
		};
	};

	/omit-if-no-ref/ pa27_trgm0_p_03: pa27_trgm0_p_03 {
		group0 {
			pinmux = <HPMICRO_PINMUX(HPMICRO_PIN(HPMICRO_PORTA, 27), IOC_TYPE_IOC, 0, 18)>;
		};
	};

	/omit-if-no-ref/ pa27_qei0_b: pa27_qei0_b {
		group0 {
			pinmux = <HPMICRO_PINMUX(HPMICRO_PIN(HPMICRO_PORTA, 27), IOC_TYPE_IOC, 0, 20)>;
		};
	};

	/omit-if-no-ref/ pa27_qeo0_b: pa27_qeo0_b {
		group0 {
			pinmux = <HPMICRO_PINMUX(HPMICRO_PIN(HPMICRO_PORTA, 27), IOC_TYPE_IOC, 0, 21)>;
		};
	};

	/omit-if-no-ref/ pa27_sei0_ck: pa27_sei0_ck {
		group0 {
			pinmux = <HPMICRO_PINMUX(HPMICRO_PIN(HPMICRO_PORTA, 27), IOC_TYPE_IOC, 0, 22)>;
		};
	};

	/omit-if-no-ref/ pa27_sysctl_clk_obs_1: pa27_sysctl_clk_obs_1 {
		group0 {
			pinmux = <HPMICRO_PINMUX(HPMICRO_PIN(HPMICRO_PORTA, 27), IOC_TYPE_IOC, 0, 24)>;
		};
	};

	/omit-if-no-ref/ pa28_gpio_a_28: pa28_gpio_a_28 {
		group0 {
			pinmux = <HPMICRO_PINMUX(HPMICRO_PIN(HPMICRO_PORTA, 28), IOC_TYPE_IOC, 0, 0)>;
		};
	};

	/omit-if-no-ref/ pa28_uart7_cts: pa28_uart7_cts {
		group0 {
			pinmux = <HPMICRO_PINMUX(HPMICRO_PIN(HPMICRO_PORTA, 28), IOC_TYPE_IOC, 0, 3)>;
		};
	};

	/omit-if-no-ref/ pa28_i2c3_sda: pa28_i2c3_sda {
		group0 {
			pinmux = <HPMICRO_PINMUX(HPMICRO_PIN(HPMICRO_PORTA, 28), IOC_TYPE_IOC, 0, 4)>;
		};
	};

	/omit-if-no-ref/ pa28_spi1_miso: pa28_spi1_miso {
		group0 {
			pinmux = <HPMICRO_PINMUX(HPMICRO_PIN(HPMICRO_PORTA, 28), IOC_TYPE_IOC, 0, 5)>;
		};
	};

	/omit-if-no-ref/ pa28_xpi0_ca_d_0: pa28_xpi0_ca_d_0 {
		group0 {
			pinmux = <HPMICRO_PINMUX(HPMICRO_PIN(HPMICRO_PORTA, 28), IOC_TYPE_IOC, 0, 14)>;
		};
	};

	/omit-if-no-ref/ pa28_pwm0_p_4: pa28_pwm0_p_4 {
		group0 {
			pinmux = <HPMICRO_PINMUX(HPMICRO_PIN(HPMICRO_PORTA, 28), IOC_TYPE_IOC, 0, 16)>;
		};
	};

	/omit-if-no-ref/ pa28_pwm1_p_4: pa28_pwm1_p_4 {
		group0 {
			pinmux = <HPMICRO_PINMUX(HPMICRO_PIN(HPMICRO_PORTA, 28), IOC_TYPE_IOC, 0, 17)>;
		};
	};

	/omit-if-no-ref/ pa28_trgm0_p_04: pa28_trgm0_p_04 {
		group0 {
			pinmux = <HPMICRO_PINMUX(HPMICRO_PIN(HPMICRO_PORTA, 28), IOC_TYPE_IOC, 0, 18)>;
		};
	};

	/omit-if-no-ref/ pa28_rdc0_exc_p: pa28_rdc0_exc_p {
		group0 {
			pinmux = <HPMICRO_PINMUX(HPMICRO_PIN(HPMICRO_PORTA, 28), IOC_TYPE_IOC, 0, 19)>;
		};
	};

	/omit-if-no-ref/ pa28_qei0_z: pa28_qei0_z {
		group0 {
			pinmux = <HPMICRO_PINMUX(HPMICRO_PIN(HPMICRO_PORTA, 28), IOC_TYPE_IOC, 0, 20)>;
		};
	};

	/omit-if-no-ref/ pa28_qeo0_z: pa28_qeo0_z {
		group0 {
			pinmux = <HPMICRO_PINMUX(HPMICRO_PIN(HPMICRO_PORTA, 28), IOC_TYPE_IOC, 0, 21)>;
		};
	};

	/omit-if-no-ref/ pa28_sei0_tx: pa28_sei0_tx {
		group0 {
			pinmux = <HPMICRO_PINMUX(HPMICRO_PIN(HPMICRO_PORTA, 28), IOC_TYPE_IOC, 0, 22)>;
		};
	};

	/omit-if-no-ref/ pa28_sysctl_clk_obs_2: pa28_sysctl_clk_obs_2 {
		group0 {
			pinmux = <HPMICRO_PINMUX(HPMICRO_PIN(HPMICRO_PORTA, 28), IOC_TYPE_IOC, 0, 24)>;
		};
	};

	/omit-if-no-ref/ pa29_gpio_a_29: pa29_gpio_a_29 {
		group0 {
			pinmux = <HPMICRO_PINMUX(HPMICRO_PIN(HPMICRO_PORTA, 29), IOC_TYPE_IOC, 0, 0)>;
		};
	};

	/omit-if-no-ref/ pa29_gptmr3_comp_3: pa29_gptmr3_comp_3 {
		group0 {
			pinmux = <HPMICRO_PINMUX(HPMICRO_PIN(HPMICRO_PORTA, 29), IOC_TYPE_IOC, 0, 1)>;
		};
	};

	/omit-if-no-ref/ pa29_uart7_de: pa29_uart7_de {
		group0 {
			pinmux = <HPMICRO_PINMUX(HPMICRO_PIN(HPMICRO_PORTA, 29), IOC_TYPE_IOC, 0, 2)>;
		};
	};

	/omit-if-no-ref/ pa29_uart7_rts: pa29_uart7_rts {
		group0 {
			pinmux = <HPMICRO_PINMUX(HPMICRO_PIN(HPMICRO_PORTA, 29), IOC_TYPE_IOC, 0, 3)>;
		};
	};

	/omit-if-no-ref/ pa29_i2c3_scl: pa29_i2c3_scl {
		group0 {
			pinmux = <HPMICRO_PINMUX(HPMICRO_PIN(HPMICRO_PORTA, 29), IOC_TYPE_IOC, 0, 4)>;
		};
	};

	/omit-if-no-ref/ pa29_spi1_mosi: pa29_spi1_mosi {
		group0 {
			pinmux = <HPMICRO_PINMUX(HPMICRO_PIN(HPMICRO_PORTA, 29), IOC_TYPE_IOC, 0, 5)>;
		};
	};

	/omit-if-no-ref/ pa29_mcan3_stby: pa29_mcan3_stby {
		group0 {
			pinmux = <HPMICRO_PINMUX(HPMICRO_PIN(HPMICRO_PORTA, 29), IOC_TYPE_IOC, 0, 7)>;
		};
	};

	/omit-if-no-ref/ pa29_xpi0_ca_d_2: pa29_xpi0_ca_d_2 {
		group0 {
			pinmux = <HPMICRO_PINMUX(HPMICRO_PIN(HPMICRO_PORTA, 29), IOC_TYPE_IOC, 0, 14)>;
		};
	};

	/omit-if-no-ref/ pa29_pwm0_p_5: pa29_pwm0_p_5 {
		group0 {
			pinmux = <HPMICRO_PINMUX(HPMICRO_PIN(HPMICRO_PORTA, 29), IOC_TYPE_IOC, 0, 16)>;
		};
	};

	/omit-if-no-ref/ pa29_pwm1_p_5: pa29_pwm1_p_5 {
		group0 {
			pinmux = <HPMICRO_PINMUX(HPMICRO_PIN(HPMICRO_PORTA, 29), IOC_TYPE_IOC, 0, 17)>;
		};
	};

	/omit-if-no-ref/ pa29_trgm0_p_05: pa29_trgm0_p_05 {
		group0 {
			pinmux = <HPMICRO_PINMUX(HPMICRO_PIN(HPMICRO_PORTA, 29), IOC_TYPE_IOC, 0, 18)>;
		};
	};

	/omit-if-no-ref/ pa29_rdc0_exc_n: pa29_rdc0_exc_n {
		group0 {
			pinmux = <HPMICRO_PINMUX(HPMICRO_PIN(HPMICRO_PORTA, 29), IOC_TYPE_IOC, 0, 19)>;
		};
	};

	/omit-if-no-ref/ pa29_qei0_h0: pa29_qei0_h0 {
		group0 {
			pinmux = <HPMICRO_PINMUX(HPMICRO_PIN(HPMICRO_PORTA, 29), IOC_TYPE_IOC, 0, 20)>;
		};
	};

	/omit-if-no-ref/ pa29_sei0_rx: pa29_sei0_rx {
		group0 {
			pinmux = <HPMICRO_PINMUX(HPMICRO_PIN(HPMICRO_PORTA, 29), IOC_TYPE_IOC, 0, 22)>;
		};
	};

	/omit-if-no-ref/ pa29_sysctl_clk_obs_3: pa29_sysctl_clk_obs_3 {
		group0 {
			pinmux = <HPMICRO_PINMUX(HPMICRO_PIN(HPMICRO_PORTA, 29), IOC_TYPE_IOC, 0, 24)>;
		};
	};

	/omit-if-no-ref/ pa29_usb0_oc: pa29_usb0_oc {
		group0 {
			pinmux = <HPMICRO_PINMUX(HPMICRO_PIN(HPMICRO_PORTA, 29), IOC_TYPE_IOC, 0, 25)>;
		};
	};

	/omit-if-no-ref/ pa30_gpio_a_30: pa30_gpio_a_30 {
		group0 {
			pinmux = <HPMICRO_PINMUX(HPMICRO_PIN(HPMICRO_PORTA, 30), IOC_TYPE_IOC, 0, 0)>;
		};
	};

	/omit-if-no-ref/ pa30_uart7_rxd: pa30_uart7_rxd {
		group0 {
			pinmux = <HPMICRO_PINMUX(HPMICRO_PIN(HPMICRO_PORTA, 30), IOC_TYPE_IOC, 0, 2)>;
		};
	};

	/omit-if-no-ref/ pa30_spi1_dat2: pa30_spi1_dat2 {
		group0 {
			pinmux = <HPMICRO_PINMUX(HPMICRO_PIN(HPMICRO_PORTA, 30), IOC_TYPE_IOC, 0, 5)>;
		};
	};

	/omit-if-no-ref/ pa30_mcan3_rxd: pa30_mcan3_rxd {
		group0 {
			pinmux = <HPMICRO_PINMUX(HPMICRO_PIN(HPMICRO_PORTA, 30), IOC_TYPE_IOC, 0, 7)>;
		};
	};

	/omit-if-no-ref/ pa30_xpi0_ca_d_1: pa30_xpi0_ca_d_1 {
		group0 {
			pinmux = <HPMICRO_PINMUX(HPMICRO_PIN(HPMICRO_PORTA, 30), IOC_TYPE_IOC, 0, 14)>;
		};
	};

	/omit-if-no-ref/ pa30_pwm0_p_6: pa30_pwm0_p_6 {
		group0 {
			pinmux = <HPMICRO_PINMUX(HPMICRO_PIN(HPMICRO_PORTA, 30), IOC_TYPE_IOC, 0, 16)>;
		};
	};

	/omit-if-no-ref/ pa30_pwm1_p_6: pa30_pwm1_p_6 {
		group0 {
			pinmux = <HPMICRO_PINMUX(HPMICRO_PIN(HPMICRO_PORTA, 30), IOC_TYPE_IOC, 0, 17)>;
		};
	};

	/omit-if-no-ref/ pa30_trgm0_p_06: pa30_trgm0_p_06 {
		group0 {
			pinmux = <HPMICRO_PINMUX(HPMICRO_PIN(HPMICRO_PORTA, 30), IOC_TYPE_IOC, 0, 18)>;
		};
	};

	/omit-if-no-ref/ pa30_qei0_h1: pa30_qei0_h1 {
		group0 {
			pinmux = <HPMICRO_PINMUX(HPMICRO_PIN(HPMICRO_PORTA, 30), IOC_TYPE_IOC, 0, 20)>;
		};
	};

	/omit-if-no-ref/ pa30_soc_ref0: pa30_soc_ref0 {
		group0 {
			pinmux = <HPMICRO_PINMUX(HPMICRO_PIN(HPMICRO_PORTA, 30), IOC_TYPE_IOC, 0, 24)>;
		};
	};

	/omit-if-no-ref/ pa30_usb0_pwr: pa30_usb0_pwr {
		group0 {
			pinmux = <HPMICRO_PINMUX(HPMICRO_PIN(HPMICRO_PORTA, 30), IOC_TYPE_IOC, 0, 25)>;
		};
	};

	/omit-if-no-ref/ pa31_gpio_a_31: pa31_gpio_a_31 {
		group0 {
			pinmux = <HPMICRO_PINMUX(HPMICRO_PIN(HPMICRO_PORTA, 31), IOC_TYPE_IOC, 0, 0)>;
		};
	};

	/omit-if-no-ref/ pa31_gptmr2_comp_3: pa31_gptmr2_comp_3 {
		group0 {
			pinmux = <HPMICRO_PINMUX(HPMICRO_PIN(HPMICRO_PORTA, 31), IOC_TYPE_IOC, 0, 1)>;
		};
	};

	/omit-if-no-ref/ pa31_uart7_txd: pa31_uart7_txd {
		group0 {
			pinmux = <HPMICRO_PINMUX(HPMICRO_PIN(HPMICRO_PORTA, 31), IOC_TYPE_IOC, 0, 2)>;
		};
	};

	/omit-if-no-ref/ pa31_spi1_dat3: pa31_spi1_dat3 {
		group0 {
			pinmux = <HPMICRO_PINMUX(HPMICRO_PIN(HPMICRO_PORTA, 31), IOC_TYPE_IOC, 0, 5)>;
		};
	};

	/omit-if-no-ref/ pa31_mcan3_txd: pa31_mcan3_txd {
		group0 {
			pinmux = <HPMICRO_PINMUX(HPMICRO_PIN(HPMICRO_PORTA, 31), IOC_TYPE_IOC, 0, 7)>;
		};
	};

	/omit-if-no-ref/ pa31_xpi0_ca_cs0: pa31_xpi0_ca_cs0 {
		group0 {
			pinmux = <HPMICRO_PINMUX(HPMICRO_PIN(HPMICRO_PORTA, 31), IOC_TYPE_IOC, 0, 14)>;
		};
	};

	/omit-if-no-ref/ pa31_pwm0_p_7: pa31_pwm0_p_7 {
		group0 {
			pinmux = <HPMICRO_PINMUX(HPMICRO_PIN(HPMICRO_PORTA, 31), IOC_TYPE_IOC, 0, 16)>;
		};
	};

	/omit-if-no-ref/ pa31_pwm1_p_7: pa31_pwm1_p_7 {
		group0 {
			pinmux = <HPMICRO_PINMUX(HPMICRO_PIN(HPMICRO_PORTA, 31), IOC_TYPE_IOC, 0, 17)>;
		};
	};

	/omit-if-no-ref/ pa31_trgm0_p_07: pa31_trgm0_p_07 {
		group0 {
			pinmux = <HPMICRO_PINMUX(HPMICRO_PIN(HPMICRO_PORTA, 31), IOC_TYPE_IOC, 0, 18)>;
		};
	};

	/omit-if-no-ref/ pa31_qei0_f: pa31_qei0_f {
		group0 {
			pinmux = <HPMICRO_PINMUX(HPMICRO_PIN(HPMICRO_PORTA, 31), IOC_TYPE_IOC, 0, 20)>;
		};
	};

	/omit-if-no-ref/ pa31_usb0_id: pa31_usb0_id {
		group0 {
			pinmux = <HPMICRO_PINMUX(HPMICRO_PIN(HPMICRO_PORTA, 31), IOC_TYPE_IOC, 0, 25)>;
		};
	};

	/* Port B */
	/omit-if-no-ref/ pb08_gpio_b_08: pb08_gpio_b_08 {
		group0 {
			pinmux = <HPMICRO_PINMUX(HPMICRO_PIN(HPMICRO_PORTB, 8), IOC_TYPE_IOC, 0, 0)>;
		};
	};

	/omit-if-no-ref/ pb08_gptmr0_comp_1: pb08_gptmr0_comp_1 {
		group0 {
			pinmux = <HPMICRO_PINMUX(HPMICRO_PIN(HPMICRO_PORTB, 8), IOC_TYPE_IOC, 0, 1)>;
		};
	};

	/omit-if-no-ref/ pb08_uart2_txd: pb08_uart2_txd {
		group0 {
			pinmux = <HPMICRO_PINMUX(HPMICRO_PIN(HPMICRO_PORTB, 8), IOC_TYPE_IOC, 0, 2)>;
		};
	};

	/omit-if-no-ref/ pb08_i2c2_scl: pb08_i2c2_scl {
		group0 {
			pinmux = <HPMICRO_PINMUX(HPMICRO_PIN(HPMICRO_PORTB, 8), IOC_TYPE_IOC, 0, 4)>;
		};
	};

	/omit-if-no-ref/ pb08_spi2_cs_2: pb08_spi2_cs_2 {
		group0 {
			pinmux = <HPMICRO_PINMUX(HPMICRO_PIN(HPMICRO_PORTB, 8), IOC_TYPE_IOC, 0, 5)>;
		};
	};

	/omit-if-no-ref/ pb08_mcan2_txd: pb08_mcan2_txd {
		group0 {
			pinmux = <HPMICRO_PINMUX(HPMICRO_PIN(HPMICRO_PORTB, 8), IOC_TYPE_IOC, 0, 7)>;
		};
	};

	/omit-if-no-ref/ pb08_acmp_comp_0: pb08_acmp_comp_0 {
		group0 {
			pinmux = <HPMICRO_PINMUX(HPMICRO_PIN(HPMICRO_PORTB, 8), IOC_TYPE_IOC, 0, 16)>;
		};
	};

	/omit-if-no-ref/ pb08_pwm1_p_4: pb08_pwm1_p_4 {
		group0 {
			pinmux = <HPMICRO_PINMUX(HPMICRO_PIN(HPMICRO_PORTB, 8), IOC_TYPE_IOC, 0, 17)>;
		};
	};

	/omit-if-no-ref/ pb08_qei1_h1: pb08_qei1_h1 {
		group0 {
			pinmux = <HPMICRO_PINMUX(HPMICRO_PIN(HPMICRO_PORTB, 8), IOC_TYPE_IOC, 0, 20)>;
		};
	};

	/omit-if-no-ref/ pb08_qeo1_a: pb08_qeo1_a {
		group0 {
			pinmux = <HPMICRO_PINMUX(HPMICRO_PIN(HPMICRO_PORTB, 8), IOC_TYPE_IOC, 0, 21)>;
		};
	};

	/omit-if-no-ref/ pb08_sei1_de: pb08_sei1_de {
		group0 {
			pinmux = <HPMICRO_PINMUX(HPMICRO_PIN(HPMICRO_PORTB, 8), IOC_TYPE_IOC, 0, 22)>;
		};
	};

	/omit-if-no-ref/ pb08_usb0_id: pb08_usb0_id {
		group0 {
			pinmux = <HPMICRO_PINMUX(HPMICRO_PIN(HPMICRO_PORTB, 8), IOC_TYPE_IOC, 0, 25)>;
		};
	};

	/omit-if-no-ref/ pb09_gpio_b_09: pb09_gpio_b_09 {
		group0 {
			pinmux = <HPMICRO_PINMUX(HPMICRO_PIN(HPMICRO_PORTB, 9), IOC_TYPE_IOC, 0, 0)>;
		};
	};

	/omit-if-no-ref/ pb09_gptmr0_capt_1: pb09_gptmr0_capt_1 {
		group0 {
			pinmux = <HPMICRO_PINMUX(HPMICRO_PIN(HPMICRO_PORTB, 9), IOC_TYPE_IOC, 0, 1)>;
		};
	};

	/omit-if-no-ref/ pb09_uart2_rxd: pb09_uart2_rxd {
		group0 {
			pinmux = <HPMICRO_PINMUX(HPMICRO_PIN(HPMICRO_PORTB, 9), IOC_TYPE_IOC, 0, 2)>;
		};
	};

	/omit-if-no-ref/ pb09_i2c2_sda: pb09_i2c2_sda {
		group0 {
			pinmux = <HPMICRO_PINMUX(HPMICRO_PIN(HPMICRO_PORTB, 9), IOC_TYPE_IOC, 0, 4)>;
		};
	};

	/omit-if-no-ref/ pb09_spi2_cs_1: pb09_spi2_cs_1 {
		group0 {
			pinmux = <HPMICRO_PINMUX(HPMICRO_PIN(HPMICRO_PORTB, 9), IOC_TYPE_IOC, 0, 5)>;
		};
	};

	/omit-if-no-ref/ pb09_mcan2_rxd: pb09_mcan2_rxd {
		group0 {
			pinmux = <HPMICRO_PINMUX(HPMICRO_PIN(HPMICRO_PORTB, 9), IOC_TYPE_IOC, 0, 7)>;
		};
	};

	/omit-if-no-ref/ pb09_acmp_comp_1: pb09_acmp_comp_1 {
		group0 {
			pinmux = <HPMICRO_PINMUX(HPMICRO_PIN(HPMICRO_PORTB, 9), IOC_TYPE_IOC, 0, 16)>;
		};
	};

	/omit-if-no-ref/ pb09_pwm1_p_5: pb09_pwm1_p_5 {
		group0 {
			pinmux = <HPMICRO_PINMUX(HPMICRO_PIN(HPMICRO_PORTB, 9), IOC_TYPE_IOC, 0, 17)>;
		};
	};

	/omit-if-no-ref/ pb09_qei1_f: pb09_qei1_f {
		group0 {
			pinmux = <HPMICRO_PINMUX(HPMICRO_PIN(HPMICRO_PORTB, 9), IOC_TYPE_IOC, 0, 20)>;
		};
	};

	/omit-if-no-ref/ pb09_qeo1_b: pb09_qeo1_b {
		group0 {
			pinmux = <HPMICRO_PINMUX(HPMICRO_PIN(HPMICRO_PORTB, 9), IOC_TYPE_IOC, 0, 21)>;
		};
	};

	/omit-if-no-ref/ pb09_sei1_ck: pb09_sei1_ck {
		group0 {
			pinmux = <HPMICRO_PINMUX(HPMICRO_PIN(HPMICRO_PORTB, 9), IOC_TYPE_IOC, 0, 22)>;
		};
	};

	/omit-if-no-ref/ pb09_usb0_oc: pb09_usb0_oc {
		group0 {
			pinmux = <HPMICRO_PINMUX(HPMICRO_PIN(HPMICRO_PORTB, 9), IOC_TYPE_IOC, 0, 25)>;
		};
	};

	/omit-if-no-ref/ pb10_gpio_b_10: pb10_gpio_b_10 {
		group0 {
			pinmux = <HPMICRO_PINMUX(HPMICRO_PIN(HPMICRO_PORTB, 10), IOC_TYPE_IOC, 0, 0)>;
		};
	};

	/omit-if-no-ref/ pb10_gptmr0_comp_2: pb10_gptmr0_comp_2 {
		group0 {
			pinmux = <HPMICRO_PINMUX(HPMICRO_PIN(HPMICRO_PORTB, 10), IOC_TYPE_IOC, 0, 1)>;
		};
	};

	/omit-if-no-ref/ pb10_uart2_de: pb10_uart2_de {
		group0 {
			pinmux = <HPMICRO_PINMUX(HPMICRO_PIN(HPMICRO_PORTB, 10), IOC_TYPE_IOC, 0, 2)>;
		};
	};

	/omit-if-no-ref/ pb10_uart2_rts: pb10_uart2_rts {
		group0 {
			pinmux = <HPMICRO_PINMUX(HPMICRO_PIN(HPMICRO_PORTB, 10), IOC_TYPE_IOC, 0, 3)>;
		};
	};

	/omit-if-no-ref/ pb10_spi2_cs_0: pb10_spi2_cs_0 {
		group0 {
			pinmux = <HPMICRO_PINMUX(HPMICRO_PIN(HPMICRO_PORTB, 10), IOC_TYPE_IOC, 0, 5)>;
		};
	};

	/omit-if-no-ref/ pb10_mcan2_stby: pb10_mcan2_stby {
		group0 {
			pinmux = <HPMICRO_PINMUX(HPMICRO_PIN(HPMICRO_PORTB, 10), IOC_TYPE_IOC, 0, 7)>;
		};
	};

	/omit-if-no-ref/ pb10_acmp_comp_0: pb10_acmp_comp_0 {
		group0 {
			pinmux = <HPMICRO_PINMUX(HPMICRO_PIN(HPMICRO_PORTB, 10), IOC_TYPE_IOC, 0, 16)>;
		};
	};

	/omit-if-no-ref/ pb10_pwm1_p_6: pb10_pwm1_p_6 {
		group0 {
			pinmux = <HPMICRO_PINMUX(HPMICRO_PIN(HPMICRO_PORTB, 10), IOC_TYPE_IOC, 0, 17)>;
		};
	};

	/omit-if-no-ref/ pb10_qei0_h1: pb10_qei0_h1 {
		group0 {
			pinmux = <HPMICRO_PINMUX(HPMICRO_PIN(HPMICRO_PORTB, 10), IOC_TYPE_IOC, 0, 20)>;
		};
	};

	/omit-if-no-ref/ pb10_qeo1_z: pb10_qeo1_z {
		group0 {
			pinmux = <HPMICRO_PINMUX(HPMICRO_PIN(HPMICRO_PORTB, 10), IOC_TYPE_IOC, 0, 21)>;
		};
	};

	/omit-if-no-ref/ pb10_sei1_tx: pb10_sei1_tx {
		group0 {
			pinmux = <HPMICRO_PINMUX(HPMICRO_PIN(HPMICRO_PORTB, 10), IOC_TYPE_IOC, 0, 22)>;
		};
	};

	/omit-if-no-ref/ pb10_usb0_pwr: pb10_usb0_pwr {
		group0 {
			pinmux = <HPMICRO_PINMUX(HPMICRO_PIN(HPMICRO_PORTB, 10), IOC_TYPE_IOC, 0, 25)>;
		};
	};

	/omit-if-no-ref/ pb11_gpio_b_11: pb11_gpio_b_11 {
		group0 {
			pinmux = <HPMICRO_PINMUX(HPMICRO_PIN(HPMICRO_PORTB, 11), IOC_TYPE_IOC, 0, 0)>;
		};
	};

	/omit-if-no-ref/ pb11_uart2_cts: pb11_uart2_cts {
		group0 {
			pinmux = <HPMICRO_PINMUX(HPMICRO_PIN(HPMICRO_PORTB, 11), IOC_TYPE_IOC, 0, 3)>;
		};
	};

	/omit-if-no-ref/ pb11_spi2_sclk: pb11_spi2_sclk {
		group0 {
			pinmux = <HPMICRO_PINMUX(HPMICRO_PIN(HPMICRO_PORTB, 11), IOC_TYPE_IOC, 0, 5)>;
		};
	};

	/omit-if-no-ref/ pb11_acmp_comp_1: pb11_acmp_comp_1 {
		group0 {
			pinmux = <HPMICRO_PINMUX(HPMICRO_PIN(HPMICRO_PORTB, 11), IOC_TYPE_IOC, 0, 16)>;
		};
	};

	/omit-if-no-ref/ pb11_pwm1_p_7: pb11_pwm1_p_7 {
		group0 {
			pinmux = <HPMICRO_PINMUX(HPMICRO_PIN(HPMICRO_PORTB, 11), IOC_TYPE_IOC, 0, 17)>;
		};
	};

	/omit-if-no-ref/ pb11_qei0_f: pb11_qei0_f {
		group0 {
			pinmux = <HPMICRO_PINMUX(HPMICRO_PIN(HPMICRO_PORTB, 11), IOC_TYPE_IOC, 0, 20)>;
		};
	};

	/omit-if-no-ref/ pb11_sei1_rx: pb11_sei1_rx {
		group0 {
			pinmux = <HPMICRO_PINMUX(HPMICRO_PIN(HPMICRO_PORTB, 11), IOC_TYPE_IOC, 0, 22)>;
		};
	};

	/omit-if-no-ref/ pb12_gpio_b_12: pb12_gpio_b_12 {
		group0 {
			pinmux = <HPMICRO_PINMUX(HPMICRO_PIN(HPMICRO_PORTB, 12), IOC_TYPE_IOC, 0, 0)>;
		};
	};

	/omit-if-no-ref/ pb12_uart3_cts: pb12_uart3_cts {
		group0 {
			pinmux = <HPMICRO_PINMUX(HPMICRO_PIN(HPMICRO_PORTB, 12), IOC_TYPE_IOC, 0, 3)>;
		};
	};

	/omit-if-no-ref/ pb12_i2c3_sda: pb12_i2c3_sda {
		group0 {
			pinmux = <HPMICRO_PINMUX(HPMICRO_PIN(HPMICRO_PORTB, 12), IOC_TYPE_IOC, 0, 4)>;
		};
	};

	/omit-if-no-ref/ pb12_spi2_miso: pb12_spi2_miso {
		group0 {
			pinmux = <HPMICRO_PINMUX(HPMICRO_PIN(HPMICRO_PORTB, 12), IOC_TYPE_IOC, 0, 5)>;
		};
	};

	/omit-if-no-ref/ pb12_pwm1_fault_0: pb12_pwm1_fault_0 {
		group0 {
			pinmux = <HPMICRO_PINMUX(HPMICRO_PIN(HPMICRO_PORTB, 12), IOC_TYPE_IOC, 0, 16)>;
		};
	};

	/omit-if-no-ref/ pb12_pwm1_p_0: pb12_pwm1_p_0 {
		group0 {
			pinmux = <HPMICRO_PINMUX(HPMICRO_PIN(HPMICRO_PORTB, 12), IOC_TYPE_IOC, 0, 17)>;
		};
	};

	/omit-if-no-ref/ pb12_trgm0_p_00: pb12_trgm0_p_00 {
		group0 {
			pinmux = <HPMICRO_PINMUX(HPMICRO_PIN(HPMICRO_PORTB, 12), IOC_TYPE_IOC, 0, 18)>;
		};
	};

	/omit-if-no-ref/ pb12_qei0_a: pb12_qei0_a {
		group0 {
			pinmux = <HPMICRO_PINMUX(HPMICRO_PIN(HPMICRO_PORTB, 12), IOC_TYPE_IOC, 0, 20)>;
		};
	};

	/omit-if-no-ref/ pb12_qeo1_a: pb12_qeo1_a {
		group0 {
			pinmux = <HPMICRO_PINMUX(HPMICRO_PIN(HPMICRO_PORTB, 12), IOC_TYPE_IOC, 0, 21)>;
		};
	};

	/omit-if-no-ref/ pb12_sei0_de: pb12_sei0_de {
		group0 {
			pinmux = <HPMICRO_PINMUX(HPMICRO_PIN(HPMICRO_PORTB, 12), IOC_TYPE_IOC, 0, 22)>;
		};
	};

	/omit-if-no-ref/ pb13_gpio_b_13: pb13_gpio_b_13 {
		group0 {
			pinmux = <HPMICRO_PINMUX(HPMICRO_PIN(HPMICRO_PORTB, 13), IOC_TYPE_IOC, 0, 0)>;
		};
	};

	/omit-if-no-ref/ pb13_gptmr1_comp_3: pb13_gptmr1_comp_3 {
		group0 {
			pinmux = <HPMICRO_PINMUX(HPMICRO_PIN(HPMICRO_PORTB, 13), IOC_TYPE_IOC, 0, 1)>;
		};
	};

	/omit-if-no-ref/ pb13_uart3_de: pb13_uart3_de {
		group0 {
			pinmux = <HPMICRO_PINMUX(HPMICRO_PIN(HPMICRO_PORTB, 13), IOC_TYPE_IOC, 0, 2)>;
		};
	};

	/omit-if-no-ref/ pb13_uart3_rts: pb13_uart3_rts {
		group0 {
			pinmux = <HPMICRO_PINMUX(HPMICRO_PIN(HPMICRO_PORTB, 13), IOC_TYPE_IOC, 0, 3)>;
		};
	};

	/omit-if-no-ref/ pb13_i2c3_scl: pb13_i2c3_scl {
		group0 {
			pinmux = <HPMICRO_PINMUX(HPMICRO_PIN(HPMICRO_PORTB, 13), IOC_TYPE_IOC, 0, 4)>;
		};
	};

	/omit-if-no-ref/ pb13_spi2_mosi: pb13_spi2_mosi {
		group0 {
			pinmux = <HPMICRO_PINMUX(HPMICRO_PIN(HPMICRO_PORTB, 13), IOC_TYPE_IOC, 0, 5)>;
		};
	};

	/omit-if-no-ref/ pb13_mcan3_stby: pb13_mcan3_stby {
		group0 {
			pinmux = <HPMICRO_PINMUX(HPMICRO_PIN(HPMICRO_PORTB, 13), IOC_TYPE_IOC, 0, 7)>;
		};
	};

	/omit-if-no-ref/ pb13_pwm1_fault_1: pb13_pwm1_fault_1 {
		group0 {
			pinmux = <HPMICRO_PINMUX(HPMICRO_PIN(HPMICRO_PORTB, 13), IOC_TYPE_IOC, 0, 16)>;
		};
	};

	/omit-if-no-ref/ pb13_pwm1_p_1: pb13_pwm1_p_1 {
		group0 {
			pinmux = <HPMICRO_PINMUX(HPMICRO_PIN(HPMICRO_PORTB, 13), IOC_TYPE_IOC, 0, 17)>;
		};
	};

	/omit-if-no-ref/ pb13_trgm0_p_01: pb13_trgm0_p_01 {
		group0 {
			pinmux = <HPMICRO_PINMUX(HPMICRO_PIN(HPMICRO_PORTB, 13), IOC_TYPE_IOC, 0, 18)>;
		};
	};

	/omit-if-no-ref/ pb13_qei0_b: pb13_qei0_b {
		group0 {
			pinmux = <HPMICRO_PINMUX(HPMICRO_PIN(HPMICRO_PORTB, 13), IOC_TYPE_IOC, 0, 20)>;
		};
	};

	/omit-if-no-ref/ pb13_qeo1_b: pb13_qeo1_b {
		group0 {
			pinmux = <HPMICRO_PINMUX(HPMICRO_PIN(HPMICRO_PORTB, 13), IOC_TYPE_IOC, 0, 21)>;
		};
	};

	/omit-if-no-ref/ pb13_sei0_ck: pb13_sei0_ck {
		group0 {
			pinmux = <HPMICRO_PINMUX(HPMICRO_PIN(HPMICRO_PORTB, 13), IOC_TYPE_IOC, 0, 22)>;
		};
	};

	/omit-if-no-ref/ pb14_gpio_b_14: pb14_gpio_b_14 {
		group0 {
			pinmux = <HPMICRO_PINMUX(HPMICRO_PIN(HPMICRO_PORTB, 14), IOC_TYPE_IOC, 0, 0)>;
		};
	};

	/omit-if-no-ref/ pb14_uart3_rxd: pb14_uart3_rxd {
		group0 {
			pinmux = <HPMICRO_PINMUX(HPMICRO_PIN(HPMICRO_PORTB, 14), IOC_TYPE_IOC, 0, 2)>;
		};
	};

	/omit-if-no-ref/ pb14_spi2_dat2: pb14_spi2_dat2 {
		group0 {
			pinmux = <HPMICRO_PINMUX(HPMICRO_PIN(HPMICRO_PORTB, 14), IOC_TYPE_IOC, 0, 5)>;
		};
	};

	/omit-if-no-ref/ pb14_mcan3_rxd: pb14_mcan3_rxd {
		group0 {
			pinmux = <HPMICRO_PINMUX(HPMICRO_PIN(HPMICRO_PORTB, 14), IOC_TYPE_IOC, 0, 7)>;
		};
	};

	/omit-if-no-ref/ pb14_pwm0_fault_0: pb14_pwm0_fault_0 {
		group0 {
			pinmux = <HPMICRO_PINMUX(HPMICRO_PIN(HPMICRO_PORTB, 14), IOC_TYPE_IOC, 0, 16)>;
		};
	};

	/omit-if-no-ref/ pb14_pwm1_p_2: pb14_pwm1_p_2 {
		group0 {
			pinmux = <HPMICRO_PINMUX(HPMICRO_PIN(HPMICRO_PORTB, 14), IOC_TYPE_IOC, 0, 17)>;
		};
	};

	/omit-if-no-ref/ pb14_trgm0_p_02: pb14_trgm0_p_02 {
		group0 {
			pinmux = <HPMICRO_PINMUX(HPMICRO_PIN(HPMICRO_PORTB, 14), IOC_TYPE_IOC, 0, 18)>;
		};
	};

	/omit-if-no-ref/ pb14_rdc0_exc_p: pb14_rdc0_exc_p {
		group0 {
			pinmux = <HPMICRO_PINMUX(HPMICRO_PIN(HPMICRO_PORTB, 14), IOC_TYPE_IOC, 0, 19)>;
		};
	};

	/omit-if-no-ref/ pb14_qei0_z: pb14_qei0_z {
		group0 {
			pinmux = <HPMICRO_PINMUX(HPMICRO_PIN(HPMICRO_PORTB, 14), IOC_TYPE_IOC, 0, 20)>;
		};
	};

	/omit-if-no-ref/ pb14_qeo1_z: pb14_qeo1_z {
		group0 {
			pinmux = <HPMICRO_PINMUX(HPMICRO_PIN(HPMICRO_PORTB, 14), IOC_TYPE_IOC, 0, 21)>;
		};
	};

	/omit-if-no-ref/ pb14_sei0_tx: pb14_sei0_tx {
		group0 {
			pinmux = <HPMICRO_PINMUX(HPMICRO_PIN(HPMICRO_PORTB, 14), IOC_TYPE_IOC, 0, 22)>;
		};
	};

	/omit-if-no-ref/ pb15_gpio_b_15: pb15_gpio_b_15 {
		group0 {
			pinmux = <HPMICRO_PINMUX(HPMICRO_PIN(HPMICRO_PORTB, 15), IOC_TYPE_IOC, 0, 0)>;
		};
	};

	/omit-if-no-ref/ pb15_gptmr0_comp_3: pb15_gptmr0_comp_3 {
		group0 {
			pinmux = <HPMICRO_PINMUX(HPMICRO_PIN(HPMICRO_PORTB, 15), IOC_TYPE_IOC, 0, 1)>;
		};
	};

	/omit-if-no-ref/ pb15_uart3_txd: pb15_uart3_txd {
		group0 {
			pinmux = <HPMICRO_PINMUX(HPMICRO_PIN(HPMICRO_PORTB, 15), IOC_TYPE_IOC, 0, 2)>;
		};
	};

	/omit-if-no-ref/ pb15_spi2_dat3: pb15_spi2_dat3 {
		group0 {
			pinmux = <HPMICRO_PINMUX(HPMICRO_PIN(HPMICRO_PORTB, 15), IOC_TYPE_IOC, 0, 5)>;
		};
	};

	/omit-if-no-ref/ pb15_mcan3_txd: pb15_mcan3_txd {
		group0 {
			pinmux = <HPMICRO_PINMUX(HPMICRO_PIN(HPMICRO_PORTB, 15), IOC_TYPE_IOC, 0, 7)>;
		};
	};

	/omit-if-no-ref/ pb15_pwm0_fault_1: pb15_pwm0_fault_1 {
		group0 {
			pinmux = <HPMICRO_PINMUX(HPMICRO_PIN(HPMICRO_PORTB, 15), IOC_TYPE_IOC, 0, 16)>;
		};
	};

	/omit-if-no-ref/ pb15_pwm1_p_3: pb15_pwm1_p_3 {
		group0 {
			pinmux = <HPMICRO_PINMUX(HPMICRO_PIN(HPMICRO_PORTB, 15), IOC_TYPE_IOC, 0, 17)>;
		};
	};

	/omit-if-no-ref/ pb15_trgm0_p_03: pb15_trgm0_p_03 {
		group0 {
			pinmux = <HPMICRO_PINMUX(HPMICRO_PIN(HPMICRO_PORTB, 15), IOC_TYPE_IOC, 0, 18)>;
		};
	};

	/omit-if-no-ref/ pb15_rdc0_exc_n: pb15_rdc0_exc_n {
		group0 {
			pinmux = <HPMICRO_PINMUX(HPMICRO_PIN(HPMICRO_PORTB, 15), IOC_TYPE_IOC, 0, 19)>;
		};
	};

	/omit-if-no-ref/ pb15_qei0_h0: pb15_qei0_h0 {
		group0 {
			pinmux = <HPMICRO_PINMUX(HPMICRO_PIN(HPMICRO_PORTB, 15), IOC_TYPE_IOC, 0, 20)>;
		};
	};

	/omit-if-no-ref/ pb15_sei0_rx: pb15_sei0_rx {
		group0 {
			pinmux = <HPMICRO_PINMUX(HPMICRO_PIN(HPMICRO_PORTB, 15), IOC_TYPE_IOC, 0, 22)>;
		};
	};

	/* Port Y */
	/omit-if-no-ref/ py00_gpio_y_00: py00_gpio_y_00 {
		group0 {
			pinmux = <HPMICRO_PINMUX(HPMICRO_PIN(HPMICRO_PORTY, 0), IOC_TYPE_IOC, 0, 0)>;
		};
	};

	/omit-if-no-ref/ py00_gptmr3_comp_0: py00_gptmr3_comp_0 {
		group0 {
			pinmux = <HPMICRO_PINMUX(HPMICRO_PIN(HPMICRO_PORTY, 0), IOC_TYPE_IOC, 0, 1)>;
		};
	};

	/omit-if-no-ref/ py00_uart0_txd: py00_uart0_txd {
		group0 {
			pinmux = <HPMICRO_PINMUX(HPMICRO_PIN(HPMICRO_PORTY, 0), IOC_TYPE_IOC, 0, 2)>;
		};
	};

	/omit-if-no-ref/ py00_mcan2_txd: py00_mcan2_txd {
		group0 {
			pinmux = <HPMICRO_PINMUX(HPMICRO_PIN(HPMICRO_PORTY, 0), IOC_TYPE_IOC, 0, 7)>;
		};
	};

	/omit-if-no-ref/ py00_pwm0_p_0: py00_pwm0_p_0 {
		group0 {
			pinmux = <HPMICRO_PINMUX(HPMICRO_PIN(HPMICRO_PORTY, 0), IOC_TYPE_IOC, 0, 16)>;
		};
	};

	/omit-if-no-ref/ py00_pwm1_p_4: py00_pwm1_p_4 {
		group0 {
			pinmux = <HPMICRO_PINMUX(HPMICRO_PIN(HPMICRO_PORTY, 0), IOC_TYPE_IOC, 0, 17)>;
		};
	};

	/omit-if-no-ref/ py00_pwm0_fault_0: py00_pwm0_fault_0 {
		group0 {
			pinmux = <HPMICRO_PINMUX(HPMICRO_PIN(HPMICRO_PORTY, 0), IOC_TYPE_IOC, 0, 18)>;
		};
	};

	/omit-if-no-ref/ py00_usb0_id: py00_usb0_id {
		group0 {
			pinmux = <HPMICRO_PINMUX(HPMICRO_PIN(HPMICRO_PORTY, 0), IOC_TYPE_IOC, 0, 25)>;
		};
	};

	/omit-if-no-ref/ py01_gpio_y_01: py01_gpio_y_01 {
		group0 {
			pinmux = <HPMICRO_PINMUX(HPMICRO_PIN(HPMICRO_PORTY, 1), IOC_TYPE_IOC, 0, 0)>;
		};
	};

	/omit-if-no-ref/ py01_gptmr3_capt_0: py01_gptmr3_capt_0 {
		group0 {
			pinmux = <HPMICRO_PINMUX(HPMICRO_PIN(HPMICRO_PORTY, 1), IOC_TYPE_IOC, 0, 1)>;
		};
	};

	/omit-if-no-ref/ py01_uart0_rxd: py01_uart0_rxd {
		group0 {
			pinmux = <HPMICRO_PINMUX(HPMICRO_PIN(HPMICRO_PORTY, 1), IOC_TYPE_IOC, 0, 2)>;
		};
	};

	/omit-if-no-ref/ py01_mcan2_rxd: py01_mcan2_rxd {
		group0 {
			pinmux = <HPMICRO_PINMUX(HPMICRO_PIN(HPMICRO_PORTY, 1), IOC_TYPE_IOC, 0, 7)>;
		};
	};

	/omit-if-no-ref/ py01_pwm0_p_1: py01_pwm0_p_1 {
		group0 {
			pinmux = <HPMICRO_PINMUX(HPMICRO_PIN(HPMICRO_PORTY, 1), IOC_TYPE_IOC, 0, 16)>;
		};
	};

	/omit-if-no-ref/ py01_pwm1_p_5: py01_pwm1_p_5 {
		group0 {
			pinmux = <HPMICRO_PINMUX(HPMICRO_PIN(HPMICRO_PORTY, 1), IOC_TYPE_IOC, 0, 17)>;
		};
	};

	/omit-if-no-ref/ py01_pwm0_fault_1: py01_pwm0_fault_1 {
		group0 {
			pinmux = <HPMICRO_PINMUX(HPMICRO_PIN(HPMICRO_PORTY, 1), IOC_TYPE_IOC, 0, 18)>;
		};
	};

	/omit-if-no-ref/ py01_ewdg0_rst: py01_ewdg0_rst {
		group0 {
			pinmux = <HPMICRO_PINMUX(HPMICRO_PIN(HPMICRO_PORTY, 1), IOC_TYPE_IOC, 0, 24)>;
		};
	};

	/omit-if-no-ref/ py01_usb0_oc: py01_usb0_oc {
		group0 {
			pinmux = <HPMICRO_PINMUX(HPMICRO_PIN(HPMICRO_PORTY, 1), IOC_TYPE_IOC, 0, 25)>;
		};
	};
};

&pinctrl {
	/* Analog pads */
	/omit-if-no-ref/ pb08_analog: pb08_analog {
		group0 {
			pinmux = <HPMICRO_PINMUX(HPMICRO_PIN(HPMICRO_PORTB, 8), IOC_TYPE_IOC, 1, 0)>;
		};
	};

	/omit-if-no-ref/ pb09_analog: pb09_analog {
		group0 {
			pinmux = <HPMICRO_PINMUX(HPMICRO_PIN(HPMICRO_PORTB, 9), IOC_TYPE_IOC, 1, 0)>;
		};
	};

	/omit-if-no-ref/ pb10_analog: pb10_analog {
		group0 {
			pinmux = <HPMICRO_PINMUX(HPMICRO_PIN(HPMICRO_PORTB, 10), IOC_TYPE_IOC, 1, 0)>;
		};
	};

	/omit-if-no-ref/ pb11_analog: pb11_analog {
		group0 {
			pinmux = <HPMICRO_PINMUX(HPMICRO_PIN(HPMICRO_PORTB, 11), IOC_TYPE_IOC, 1, 0)>;
		};
	};

	/omit-if-no-ref/ pb12_analog: pb12_analog {
		group0 {
			pinmux = <HPMICRO_PINMUX(HPMICRO_PIN(HPMICRO_PORTB, 12), IOC_TYPE_IOC, 1, 0)>;
		};
	};

	/omit-if-no-ref/ pb13_analog: pb13_analog {
		group0 {
			pinmux = <HPMICRO_PINMUX(HPMICRO_PIN(HPMICRO_PORTB, 13), IOC_TYPE_IOC, 1, 0)>;
		};
	};

	/omit-if-no-ref/ pb14_analog: pb14_analog {
		group0 {
			pinmux = <HPMICRO_PINMUX(HPMICRO_PIN(HPMICRO_PORTB, 14), IOC_TYPE_IOC, 1, 0)>;
		};
	};

	/omit-if-no-ref/ pb15_analog: pb15_analog {
		group0 {
			pinmux = <HPMICRO_PINMUX(HPMICRO_PIN(HPMICRO_PORTB, 15), IOC_TYPE_IOC, 1, 0)>;
		};
	};
};

&pinctrl_pioc {
	/* Port Y (PIOC) */
	/omit-if-no-ref/ py00_pgpio_y_00: py00_pgpio_y_00 {
		group0 {
			pinmux = <HPMICRO_PINMUX(HPMICRO_PIN(HPMICRO_PORTY, 0), IOC_TYPE_PIOC, 0, 0)>;
		};
	};

	/omit-if-no-ref/ py00_puart_txd: py00_puart_txd {
		group0 {
			pinmux = <HPMICRO_PINMUX(HPMICRO_PIN(HPMICRO_PORTY, 0), IOC_TYPE_PIOC, 0, 1)>;
		};
	};

	/omit-if-no-ref/ py00_ptmr_comp_0: py00_ptmr_comp_0 {
		group0 {
			pinmux = <HPMICRO_PINMUX(HPMICRO_PIN(HPMICRO_PORTY, 0), IOC_TYPE_PIOC, 0, 2)>;
		};
	};

	/omit-if-no-ref/ py00_soc_gpio_y_00: py00_soc_gpio_y_00 {
		group0 {
			pinmux = <HPMICRO_PINMUX(HPMICRO_PIN(HPMICRO_PORTY, 0), IOC_TYPE_PIOC, 0, 3)>;
		};
	};

	/omit-if-no-ref/ py01_pgpio_y_01: py01_pgpio_y_01 {
		group0 {
			pinmux = <HPMICRO_PINMUX(HPMICRO_PIN(HPMICRO_PORTY, 1), IOC_TYPE_PIOC, 0, 0)>;
		};
	};

	/omit-if-no-ref/ py01_puart_rxd: py01_puart_rxd {
		group0 {
			pinmux = <HPMICRO_PINMUX(HPMICRO_PIN(HPMICRO_PORTY, 1), IOC_TYPE_PIOC, 0, 1)>;
		};
	};

	/omit-if-no-ref/ py01_ptmr_comp_1: py01_ptmr_comp_1 {
		group0 {
			pinmux = <HPMICRO_PINMUX(HPMICRO_PIN(HPMICRO_PORTY, 1), IOC_TYPE_PIOC, 0, 2)>;
		};
	};

	/omit-if-no-ref/ py01_soc_gpio_y_01: py01_soc_gpio_y_01 {
		group0 {
			pinmux = <HPMICRO_PINMUX(HPMICRO_PIN(HPMICRO_PORTY, 1), IOC_TYPE_PIOC, 0, 3)>;
		};
	};
};
