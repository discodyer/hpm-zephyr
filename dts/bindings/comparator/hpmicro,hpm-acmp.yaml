## dts/bindings/comparator/hpmicro,hpm-acmp.yaml
```yaml
# Copyright (c) 2026 The HPM Zephyr Module Contributors
# SPDX-License-Identifier: Apache-2.0

description: |
  HPMicro analog comparator controller.

  The controller owns the shared register block and clock. Each comparator
  channel is represented by a child node compatible with
  "hpmicro,hpm-acmp-comp".

compatible: "hpmicro,hpm-acmp"

include: base.yaml

properties:
  reg:
    required: true

  clocks:
    required: true

  clock-names:
    required: true

  "#address-cells":
    const: 1

  "#size-cells":
    const: 0
```

## dts/bindings/counter/hpmicro,hpm-gptmr.yaml
```yaml
# Copyright (c) 2026 The HPM Zephyr Module Contributors
# SPDX-License-Identifier: Apache-2.0

description: HPMicro general-purpose timer

compatible: "hpmicro,hpm-gptmr"

include: [base.yaml, pinctrl-device.yaml]

properties:
  reg:
    required: true

  interrupts:
    required: true

  clocks:
    required: true

  clock-names:
    required: true
```

## dts/bindings/counter/hpmicro,hpm-ptpc.yaml
```yaml
# Copyright (c) 2026 The HPM Zephyr Module Contributors
# SPDX-License-Identifier: Apache-2.0

description: HPMicro PTPC timer

compatible: "hpmicro,hpm-ptpc"

include: base.yaml

properties:
  reg:
    required: true

  interrupts:
    required: true

  clocks:
    required: true

  clock-names:
    required: true
```

## dts/bindings/counter/hpmicro,hpm-synt.yaml
```yaml
# Copyright (c) 2026 The HPM Zephyr Module Contributors
# SPDX-License-Identifier: Apache-2.0

description: |
  HPMicro synchronization timer.

  SYNT provides a synchronization counter with four comparator outputs and a
  separate free-running timestamp used by the motion-control subsystem.

compatible: "hpmicro,hpm-synt"

include: base.yaml

properties:
  reg:
    required: true

  clocks:
    required: true

  clock-names:
    required: true
```

## dts/bindings/crc/hpmicro,hpm-crc.yaml
```yaml
# Copyright (c) 2026 The HPM Zephyr Module Contributors
# SPDX-License-Identifier: Apache-2.0

description: HPMicro CRC accelerator

compatible: "hpmicro,hpm-crc"

include: base.yaml

properties:
  reg:
    required: true

  clocks:
    required: true

  clock-names:
    required: true

  channel:
    type: int
    enum: [0, 1, 2, 3, 4, 5, 6, 7]
    default: 0
    description: Hardware CRC channel used by the Zephyr CRC device.
```

## dts/bindings/crypto/hpmicro,hpm-keym.yaml
```yaml
# Copyright (c) 2026 The HPM Zephyr Module Contributors
# SPDX-License-Identifier: Apache-2.0

description: HPMicro key manager

compatible: "hpmicro,hpm-keym"

include: base.yaml

properties:
  reg:
    required: true

  clocks:
    required: true

  clock-names:
    required: true
```

## dts/bindings/crypto/hpmicro,hpm-sdp.yaml
```yaml
# Copyright (c) 2026 The HPM Zephyr Module Contributors
# SPDX-License-Identifier: Apache-2.0

description: HPMicro secure data processor

compatible: "hpmicro,hpm-sdp"

include: base.yaml

properties:
  reg:
    required: true

  interrupts:
    required: true

  clocks:
    required: true

  clock-names:
    required: true
```

## dts/bindings/crypto/hpmicro,hpm-sec.yaml
```yaml
# Copyright (c) 2026 The HPM Zephyr Module Contributors
# SPDX-License-Identifier: Apache-2.0

description: HPMicro security subsystem

compatible: "hpmicro,hpm-sec"

include: base.yaml

properties:
  reg:
    required: true

  interrupts:
    required: true

  clocks:
    required: true

  clock-names:
    required: true
```

## dts/bindings/crypto/hpmicro,hpm-secmon.yaml
```yaml
# Copyright (c) 2026 The HPM Zephyr Module Contributors
# SPDX-License-Identifier: Apache-2.0

description: HPMicro security monitor

compatible: "hpmicro,hpm-secmon"

include: base.yaml

properties:
  reg:
    required: true

  interrupts:
    required: true

  clocks:
    required: true

  clock-names:
    required: true
```

## dts/bindings/dac/hpmicro,hpm-dac.yaml
```yaml
# Copyright (c) 2026 The HPM Zephyr Module Contributors
# SPDX-License-Identifier: Apache-2.0

description: HPMicro DAC controller

compatible: "hpmicro,hpm-dac"

include: [dac-controller.yaml, pinctrl-device.yaml]

properties:
  reg:
    required: true

  interrupts:
    required: true

  clocks:
    required: true

  clock-names:
    required: true

  clock-name:
    type: int
    required: true

  clock-src:
    type: int
    required: true

  ana-clock-name:
    type: int
    required: true

  ana-clock-src:
    type: int
    required: true

io-channel-cells:
  - output
```

## dts/bindings/dma/hpmicro,hpm-dma.yaml
```yaml
# Copyright (c) 2026 The HPM Zephyr Module Contributors
# SPDX-License-Identifier: Apache-2.0

description: |
  HPMicro DMAV2 controller with channel-coupled DMAMUX.

  Each DMA channel has a matching DMAMUX channel. Client DMA specifiers use
  two cells: the DMA channel and the DMAMUX request source. The request source
  is ignored for memory-to-memory transfers.

compatible: "hpmicro,hpm-dma"

include: dma-controller.yaml

properties:
  reg:
    required: true
    description: |
      DMAV2 register block followed by the DMAMUX register block.

  reg-names:
    required: true
    description: Must be "dma" followed by "dmamux".

  interrupts:
    required: true

  clocks:
    required: true

  clock-names:
    required: true

  clock-name:
    type: int
    required: true

  clock-src:
    type: int
    required: true

  dma-channels:
    required: true

  dma-requests:
    required: true
    description: Number of valid DMAMUX request source identifiers.

  "#dma-cells":
    const: 2

dma-cells:
  - channel
  - request
```

## dts/bindings/flash/hpmicro,hpm-xpi.yaml
```yaml
# Copyright (c) 2026 The HPM Zephyr Module Contributors
# SPDX-License-Identifier: Apache-2.0

description: HPMicro XPI NOR flash controller

compatible: "hpmicro,xpi"

include: [base.yaml]

properties:
  reg:
    required: true

  "#address-cells":
    const: 1

  "#size-cells":
    const: 1
```

## dts/bindings/flash/hpmicro,hpmicro-flash.yaml
```yaml
# Copyright (c) 2026 The HPM Zephyr Module Contributors
# SPDX-License-Identifier: Apache-2.0

description: HPMicro XPI NOR flash

compatible: "hpmicro,hpmicro-flash"

include: [soc-nv-flash.yaml]

on-bus: xpi

properties:
  nor-cfg-opt-hdr:
    type: int
    required: true

  nor-cfg-opt-opt0:
    type: int
    required: true

  nor-cfg-opt-opt1:
    type: int
    required: true
```

## dts/bindings/gpio/hpmicro,hpm-gpio.yaml
```yaml
# Copyright (c) 2022-2026 HPMicro
# SPDX-License-Identifier: Apache-2.0

description: HPMicro GPIO controller

compatible: "hpmicro,hpm-gpio"

include: [gpio-controller.yaml, base.yaml]

properties:
  reg:
    required: true

  hpmicro-gpio-port:
    type: int
    required: true
    description: HPM SDK GPIO port index.

  interrupts:
    description: |
      GPIO interrupt line. The fast GPIO (FGPIO) controller has no interrupt
      output, so instances representing FGPIO omit this property.

  "#gpio-cells":
    const: 2

gpio-cells:
  - pin
  - flags
```

## dts/bindings/hpmicro,hpm5300evk.yaml
```yaml
# Copyright (c) 2026 The HPM Zephyr Module Contributors
# SPDX-License-Identifier: Apache-2.0

description: HPMicro HPM5300EVK board

compatible: "hpmicro,hpm5300evk"

include: base.yaml

properties:
  model:
    type: string
```

## dts/bindings/hpmicro,hpm5361-package.yaml
```yaml
# Copyright (c) 2026 The HPM Zephyr Module Contributors
# SPDX-License-Identifier: Apache-2.0

description: HPM5361 package pin availability metadata

compatible: "hpmicro,hpm5361-package"

include: base.yaml

properties:
  hpmicro,package:
    type: string
    required: true
    enum:
      - "lqfp100"
      - "lqfp64"
      - "qfn48"
    description: Physical package type.

  hpmicro,model:
    type: string
    required: true
    enum:
      - "HPM5361ICB1"
      - "HPM5361ICF1"
      - "HPM5361IEG1"
    description: Full HPM5361 ordering code for this package.

  hpmicro,gpio-count:
    type: int
    required: true
    description: Number of GPIO pins bonded out by this package.

  hpmicro,analog-pin-count:
    type: int
    required: true
    description: Number of analog-capable pins bonded out by this package.

  hpmicro,available-pads:
    type: string-array
    required: true
    description: Bonded-out HPMICRO pad names, for example PA00 or PY03.
```

## dts/bindings/hpmicro,hpm5361icb.yaml
```yaml
# Copyright (c) 2026 The HPM Zephyr Module Contributors
# SPDX-License-Identifier: Apache-2.0

description: HPMicro HPM5361 ICB board

compatible: "hpmicro,hpm5361icb"

include: base.yaml

properties:
  model:
    type: string
```

## dts/bindings/hpmicro,hpm53xx.yaml
```yaml
# Copyright (c) 2026 The HPM Zephyr Module Contributors
# SPDX-License-Identifier: Apache-2.0

description: HPMicro HPM5300 family SoC

compatible: "hpmicro,hpm53xx"

include: base.yaml

properties:
  model:
    type: string
```

## dts/bindings/hwinfo/hpmicro,hpm-hwinfo.yaml
```yaml
# Copyright (c) 2026 The HPM Zephyr Module Contributors
# SPDX-License-Identifier: Apache-2.0

description: |
  HPMicro platform hardware information source.

  The PPOR block records the reset causes and the OTP controller provides the
  factory-programmed 128-bit UUID. This driver exposes both through the
  standard Zephyr hwinfo API and never changes OTP contents.

compatible: "hpmicro,hpm-hwinfo"

include: base.yaml

properties:
  reg:
    required: true

  hpmicro,otp:
    type: phandle
    required: true
    description: OTP controller that contains the factory UUID.
```

## dts/bindings/i2c/hpmicro,hpm-i2c.yaml
```yaml
# Copyright (c) 2026 The HPM Zephyr Module Contributors
# SPDX-License-Identifier: Apache-2.0

description: HPMicro I2C controller

compatible: "hpmicro,hpm-i2c"

include: [i2c-controller.yaml, pinctrl-device.yaml]

properties:
  reg:
    required: true

  interrupts:
    required: true

  clocks:
    required: true
    description: |
      Clock specifier with the HPM clock resource, source selector and
      divider, respectively.

  clock-names:
    required: true

  clock-name:
    type: int
    required: true
    description: HPM SDK clock resource identifier

  clock-src:
    type: int
    required: true
    description: I2C clock source selector

  clock-frequency:
    required: true
```

## dts/bindings/lin/hpmicro,hpm-uart-lin.yaml
```yaml
# Copyright (c) 2026 The HPM Zephyr Module Contributors
# SPDX-License-Identifier: Apache-2.0

description: HPMicro UART-based LIN controller

compatible: "hpmicro,hpm-uart-lin"

include: [lin-controller.yaml, pinctrl-device.yaml]

properties:
  reg:
    required: true

  uart:
    type: phandle
    required: true
    description: |
      HPM UART instance used for LIN frame data. The referenced UART node
      supplies its register block, interrupt and clock configuration.

  tx-gpios:
    type: phandle-array
    required: true
    description: |
      UART TX pin used as a GPIO while emitting a LIN break or wakeup pulse.
      The controller pin state named "tx_gpio" must switch this pin from its
      UART function to GPIO.

  rx-header-echo:
    type: boolean
    description: |
      Set when the transceiver feeds the commander's own break, sync and PID
      bytes back into UART RX. Direct UART-to-UART fixtures normally leave this
      unset.
```

## dts/bindings/mbox/hpmicro,hpm-mbx.yaml
```yaml
# Copyright (c) 2026 The HPM Zephyr Module Contributors
# SPDX-License-Identifier: Apache-2.0

description: |
  HPMicro inter-core message mailbox endpoint.

  MBX0A and MBX0B are the two register interfaces of one hardware mailbox.
  Data written to one endpoint is received by the other. Each endpoint has a
  single 32-bit word-message register plus a separate four-word FIFO. The
  Zephyr mailbox binding exposes the word-message path as one channel so that
  message boundaries and callback payload sizes remain well defined.

compatible: "hpmicro,hpm-mbx"

include: [base.yaml, mailbox-controller.yaml]

properties:
  reg:
    required: true

  interrupts:
    required: true

  clocks:
    required: true

  clock-names:
    required: true

mbox-cells:
  - channel
```

## dts/bindings/mfd/hpmicro,hpm-gpiom.yaml
```yaml
# Copyright (c) 2026 The HPM Zephyr Module Contributors
# SPDX-License-Identifier: Apache-2.0

description: HPMicro GPIO manager

compatible: "hpmicro,hpm-gpiom"

include: base.yaml

properties:
  reg:
    required: true
```

## dts/bindings/motor/hpmicro,hpm-mmc.yaml
```yaml
# Copyright (c) 2026 The HPM Zephyr Module Contributors
# SPDX-License-Identifier: Apache-2.0

description: |
  HPMicro motion processing unit.

  The controller combines position tracking and two predictors. Software
  supplies position, velocity, acceleration, coefficient and trigger
  parameters at runtime.

compatible: "hpmicro,hpm-mmc"

include: base.yaml

properties:
  reg:
    required: true

  interrupts:
    required: true

  clocks:
    required: true

  clock-names:
    required: true
```

## dts/bindings/motor/hpmicro,hpm-plb.yaml
```yaml
# Copyright (c) 2026 The HPM Zephyr Module Contributors
# SPDX-License-Identifier: Apache-2.0

description: |
  HPMicro programmable logic block.

  PLB contains four TYPE_A combinational/sequential channels and four TYPE_B
  counting/filtering channels, all connected through the trigger manager.

compatible: "hpmicro,hpm-plb"

include: base.yaml

properties:
  reg:
    required: true

  clocks:
    required: true

  clock-names:
    required: true

  trgm:
    type: phandle
    required: true
    description: TRGM controller used by the PLB filter and encoder components.
```
