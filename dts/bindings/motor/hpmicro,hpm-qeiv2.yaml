## dts/bindings/motor/hpmicro,hpm-qeiv2.yaml
```yaml
# Copyright (c) 2026 The HPM Zephyr Module Contributors
# SPDX-License-Identifier: Apache-2.0

description: |
  HPMicro QEIV2 quadrature encoder interface.

  The driver covers square-wave ABZ quadrature, pulse/direction, up/down,
  single-phase, UVW and ADC sine/cosine decoding. The phase counter wraps at
  counts-per-revolution. The generic sensor rotation channel uses phase count
  and counts-per-revolution in digital modes, and the controller's angle output
  in UVW and sine/cosine modes. ADC sampling and TRGM routing remain owned by
  the ADC and TRGM drivers.

compatible: "hpmicro,hpm-qeiv2"

include: [sensor-device.yaml, pinctrl-device.yaml]

properties:
  reg:
    required: true

  interrupts:
    required: true

  clocks:
    required: true

  clock-names:
    required: true

  clock-name:
    type: int
    required: true

  clock-src:
    type: int
    required: true

  mode:
    type: string
    default: "abz"
    enum:
      - "abz"
      - "pulse-direction"
      - "up-down"
      - "uvw"
      - "single"
      - "sine"
      - "sine-cosine"
    description: |
      Input decoding mode. UVW uses A/U, B/V and Z/W and installs the six
      default UVW position codes from the vendor driver. The sine modes require
      the corresponding sincos-* properties and external ADC/TRGM setup.

  counts-per-revolution:
    type: int
    min: 2
    required: true
    description: |
      Number of phase counts in one mechanical revolution. In ABZ mode each
      transition of A or B contributes one count, so one complete quadrature
      cycle contributes four counts. The standard encoder count channel wraps
      at this value in ABZ, pulse/direction, up/down and single-phase modes.

  z-calibration:
    type: boolean
    description: |
      Calibrate the phase counter from the Z/index input. When disabled, the
      Z input is neither required nor used for phase calibration.

  phase-index:
    type: int
    min: 0
    default: 0
    description: |
      Phase counter value loaded when z-calibration detects the Z input.

  filter-length:
    type: int
    default: 0
    min: 0
    max: 511
    description: |
      Digital delay-filter length applied to the A and B inputs. Zero disables
      the filter.

  sincos-xy-delay:
    type: int
    default: 0
    min: 0
    max: 16777215
    description: |
      ADC X/Y sampling delay in QEIV2 clock cycles. ADC sampling, the sample
      trigger and the TRGM ADC matrix are not configured by this driver.

  sincos-x-adc:
    type: int
    default: 0
    min: 0
    max: 1
    description: ADC instance feeding the X channel.

  sincos-x-channel:
    type: int
    default: 0
    min: 0
    max: 15
    description: ADC channel feeding the X channel.

  sincos-x-param0:
    type: int
    default: 16384
    description: Q14 correction coefficient for the X channel.

  sincos-x-param1:
    type: int
    default: 0
    description: Q14 cross-axis correction coefficient for the X channel.

  sincos-x-offset:
    type: int
    default: -2147483648
    description: ADC value subtracted from the X sample before decoding.

  sincos-y-adc:
    type: int
    default: 0
    min: 0
    max: 1
    description: ADC instance feeding the Y channel.

  sincos-y-channel:
    type: int
    default: 0
    min: 0
    max: 15
    description: ADC channel feeding the Y channel.

  sincos-y-param0:
    type: int
    default: 0
    description: Q14 cross-axis correction coefficient for the Y channel.

  sincos-y-param1:
    type: int
    default: 16384
    description: Q14 correction coefficient for the Y channel.

  sincos-y-offset:
    type: int
    default: -2147483648
    description: ADC value subtracted from the Y sample before decoding.

  watchdog-timeout:
    type: int
    default: 0
    min: 0
    max: 268435455
    description: Stall watchdog timeout in QEIV2 clock cycles; zero disables it.

  watchdog-clear-threshold:
    type: int
    default: 0
    min: 0
    max: 7
    description: |
      Minimum phase-counter change that clears the watchdog. Zero clears on
      every phase-counter change.

  home-rising-forward:
    type: boolean
    description: Set the HOME flag on H0 rising edges while rotating forward.

  home-rising-reverse:
    type: boolean
    description: Set the HOME flag on H0 rising edges while rotating reverse.

  home-falling-forward:
    type: boolean
    description: Set the HOME flag on H0 falling edges while rotating forward.

  home-falling-reverse:
    type: boolean
    description: Set the HOME flag on H0 falling edges while rotating reverse.

  home2-rising-forward:
    type: boolean
    description: Set the HOME2 flag on H1 rising edges while rotating forward.

  home2-rising-reverse:
    type: boolean
    description: Set the HOME2 flag on H1 rising edges while rotating reverse.

  home2-falling-forward:
    type: boolean
    description: Set the HOME2 flag on H1 falling edges while rotating forward.

  home2-falling-reverse:
    type: boolean
    description: Set the HOME2 flag on H1 falling edges while rotating reverse.

  fault-pause-position:
    type: boolean
    description: Suppress valid position output while the fault input is asserted.
```

## dts/bindings/motor/hpmicro,hpm-qeo.yaml
```yaml
# Copyright (c) 2026 The HPM Zephyr Module Contributors
# SPDX-License-Identifier: Apache-2.0

description: HPMicro QEO encoder output

compatible: "hpmicro,hpm-qeo"

include: base.yaml

properties:
  reg:
    required: true

  clocks:
    required: true

  clock-names:
    required: true

  lines:
    type: int
    min: 1
    required: true
    description: Number of output lines per mechanical revolution.

  max-frequency:
    type: int
    min: 1
    description: Maximum A pulse frequency in Hz.

  watchdog-frequency:
    type: int
    min: 1
    description: Optional ABZ watchdog frequency in Hz.

  output-type:
    type: string
    default: "abz"
    enum:
      - "abz"
      - "pulse-direction"
      - "up-down"
      - "three-phase"

  z-pulse-width:
    type: string
    default: "100-percent"
    enum:
      - "25-percent"
      - "75-percent"
      - "100-percent"

  invert-a:
    type: boolean
  invert-b:
    type: boolean
  invert-z:
    type: boolean
```

## dts/bindings/motor/hpmicro,hpm-rdc.yaml
```yaml
# Copyright (c) 2026 The HPM Zephyr Module Contributors
# SPDX-License-Identifier: Apache-2.0

description: |
  HPMicro resolver-to-digital converter.

  The controller generates a resolver excitation signal and accumulates
  rectified I/Q ADC samples for position processing.

compatible: "hpmicro,hpm-rdc"

include: [base.yaml, pinctrl-device.yaml]

properties:
  reg:
    required: true

  interrupts:
    required: true

  clocks:
    required: true

  clock-names:
    required: true
```

## dts/bindings/motor/hpmicro,hpm-sei.yaml
```yaml
# Copyright (c) 2026 The HPM Zephyr Module Contributors
# SPDX-License-Identifier: Apache-2.0

description: |
  HPMicro serial encoder interface.

  The controller exposes two protocol-neutral SEI channels. Software supplies
  the transceiver mode, instruction program and SAMPLE/UPDATE mapping for the
  selected encoder protocol.

compatible: "hpmicro,hpm-sei"

include: [base.yaml, pinctrl-device.yaml]

properties:
  reg:
    required: true

  interrupts:
    required: true

  interrupt-names:
    required: true
    min-len: 2
    max-len: 2
    enum:
      - "channel0"
      - "channel1"
    description: |
      SEI channel interrupt names. The two entries must be "channel0" and
      "channel1" in the same order as the interrupts property.

  clocks:
    required: true

  clock-names:
    required: true

  synt:
    type: phandle
    description: |
      Synchronization timer that provides the shared motor timestamp. SEI
      captures this timestamp in LATCH0/LATCH1 for SAMPLE/UPDATE.
```

## dts/bindings/mux/hpmicro,hpm-trgm.yaml
```yaml
# Copyright (c) 2026 The HPM Zephyr Module Contributors
# SPDX-License-Identifier: Apache-2.0

description: |
  HPMicro Trigger Manager (TRGM).

  Each TRGM output is addressed as a mux control line. The mux state is the
  TRGM input source number, using the HPM_TRGM0_INPUT_SRC_* constants from the
  pinned HPM SDK. The HPM-specific API extension configures input filters,
  output edge conversion and polarity, DMA requests, and the ADC/DAC/position
  routing matrices.

compatible: "hpmicro,hpm-trgm"

include: [base.yaml, mux-controller.yaml]

properties:
  reg:
    required: true

  interrupts:
    required: true

  clocks:
    required: true

  clock-names:
    required: true

  "#mux-control-cells":
    const: 1

  "#mux-state-cells":
    const: 2

mux-control-cells:
  - output

mux-state-cells:
  - output
  - source
```

## dts/bindings/opamp/hpmicro,hpm-opamp.yaml
```yaml
# Copyright (c) 2026 The HPM Zephyr Module Contributors
# SPDX-License-Identifier: Apache-2.0

description: |
  HPMicro operational amplifier.

  The HPM5300 OPAMP supports follower, inverting, non-inverting and
  externally-defined custom topologies. It does not provide a differential
  amplifier mode.

compatible: "hpmicro,hpm-opamp"

include: [opamp-controller.yaml]

properties:
  reg:
    required: true

  clocks:
    required: true

  clock-names:
    required: true

  positive-input:
    required: true
    type: string
    enum:
      - "INP0"
      - "INP1"
      - "INP2"
      - "INP3"
      - "VSUPPLY_25"
      - "VSUPPLY_50"
      - "VSUPPLY_75"
      - "FLOATING"
    description: |
      Selects the non-inverting input. INP0-INP3 are package inputs,
      VSUPPLY_* select internal supply-derived references and FLOATING
      disconnects the non-inverting input.

  negative-input:
    required: true
    type: string
    enum:
      - "INN0"
      - "INN1"
      - "INN2"
      - "INN3"
      - "FLOATING"
    description: |
      Selects the inverting input. INN0-INN3 are package inputs and
      FLOATING disconnects the inverting input. The fixed follower,
      internal-reference non-inverting and DAC-reference topologies
      override this selection as required by the hardware.

  reference-source:
    type: string
    enum:
      - "internal"
      - "external"
      - "dac"
    default: "internal"
    description: |
      Selects the amplification reference for inverting and non-inverting
      modes. Ignored in follower and standalone modes.

  gain:
    type: string
    enum:
      - "OPAMP_GAIN_2"
      - "OPAMP_GAIN_4"
      - "OPAMP_GAIN_8"
      - "OPAMP_GAIN_16"
      - "OPAMP_GAIN_32"
      - "OPAMP_GAIN_64"
    default: "OPAMP_GAIN_2"
    description: |
      Initial internal feedback gain. In inverting mode this represents the
      magnitude of the negative gain.

  external-filter-capacitor:
    type: boolean
    description: |
      Select the topology variant with an external filter capacitor for
      inverting or non-inverting amplification.

  miller-capacitor:
    type: string
    enum:
      - "x5"
      - "x6"
      - "x7"
      - "x8"
      - "x10"
      - "x13"
      - "x15"
      - "x18"
    default: "x7"
    description: Internal Miller compensation capacitor selection.

  phase-margin-capacitor:
    type: boolean
    description: Enable the internal phase-margin compensation capacitor.
```

## dts/bindings/otp/hpmicro,hpm-otp.yaml
```yaml
# Copyright (c) 2026 The HPM Zephyr Module Contributors
# SPDX-License-Identifier: Apache-2.0

description: |
  HPMicro one-time programmable fuse controller.

  The controller exposes 128 32-bit shadow words (512 bytes). Reads use the
  shadow array loaded at reset. The Zephyr driver is intentionally read-only;
  fuse programming and locking are not implemented.

compatible: "hpmicro,hpm-otp"

include: base.yaml

properties:
  reg:
    required: true

  interrupts:
    required: true
```

## dts/bindings/pinctrl/hpmicro,hpm-pinctrl.yaml
```yaml
# Copyright (c) 2022-2026 HPMicro
# SPDX-License-Identifier: Apache-2.0

description: HPMicro IOC pin controller

compatible: "hpmicro,hpm-pinctrl"

include:
  - name: pinctrl-device.yaml
  - name: base.yaml
  - name: pincfg-node-group.yaml
    child-binding:
      child-binding:
        property-allowlist:
          - bias-disable
          - bias-pull-down
          - bias-pull-up
          - drive-open-drain
          - input-enable
          - input-schmitt-enable
          - keeper-capability-disable
          - pull-resistance-strength
          - hpmicro-slew-pd
          - hpmicro-slew-rate

properties:
  reg:
    required: true

child-binding:
  description: HPMicro pin controller pin group
  child-binding:
    description: HPMicro pin controller pin configuration
    properties:
      pinmux:
        required: true
        type: array
        description: HPMicro pin mux encoded with HPMICRO_PINMUX()
      drive-strength:
        type: string
        default: "r000"
        enum: ["r000", "r001", "r010", "r011", "r100", "r101", "r110", "r111"]
        description: Pad drive strength.
      power-source:
        type: string
        default: "3v3"
        enum: ["3v3", "1v8"]
        description: Pad IO supply voltage.
      hpmicro-slew-pd:
        type: string
        default: "50M"
        enum: ["50M", "100M", "150M", "200M"]
        description: Pad slew rate setting.
      pull-resistance-strength:
        type: string
        default: "100KOhm"
        enum: ["100KOhm", "47KOhm", "22KOhm"]
        description: Pad pull resistance.
      hpmicro-slew-rate:
        type: string
        default: "slow"
        enum: ["slow", "fast"]
        description: Pad output slew rate.
      keeper-capability-disable:
        type: boolean
        description: Disable the pad keeper capability.
```

## dts/bindings/pinctrl/hpmicro,hpm-trgm.yaml
```yaml
# Copyright (c) 2026 The HPM Zephyr Module Contributors
# SPDX-License-Identifier: Apache-2.0

description: HPMicro trigger multiplexer

compatible: "hpmicro,hpm-trgm"

include: base.yaml

properties:
  reg:
    required: true

  interrupts:
    required: true
```
