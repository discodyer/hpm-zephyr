## dts/bindings/power-domain/hpmicro,hpm-power-domain.yaml
```yaml
# Copyright (c) 2026 The HPM Zephyr Module Contributors
# Copyright (c) 2026 Cody Gu <gujiaqi@iscas.ac.cn>
# SPDX-License-Identifier: Apache-2.0

description: |
  HPMicro SYSCTL resource power domain.

  Each instance controls one removable peripheral through the corresponding
  SYSCTL RESOURCE[x].MODE field. RESUME forces the resource on and waits for
  LOC_BUSY to clear. SUSPEND notifies children, forces the resource off and
  waits for the transition to complete.

  Devicetree nodes must list both compatible strings so that the Zephyr PM
  subsystem marks the device as a provider:
    compatible = "hpmicro,hpm-power-domain", "power-domain";

  Only recoverable peripheral module resources are accepted. CPU, reset,
  clock source/top, memory, ROM, AHB, watchdog, key manager and XPI resources
  are intentionally excluded. PDGO system shutdown is not a runtime power
  domain and is not represented by this binding.

compatible: "hpmicro,hpm-power-domain"

include: power-domain.yaml

properties:
  hpmicro,controller:
    type: phandle
    required: true
    description: HPMicro SYSCTL controller controlling the resource.

  hpmicro,resource-id:
    type: int
    required: true
    enum:
      - 260 # CAN0
      - 261 # CAN1
      - 262 # CAN2
      - 263 # CAN3
      - 264 # PTPC
      - 265 # LIN0
      - 266 # LIN1
      - 267 # LIN2
      - 268 # LIN3
      - 269 # GPTMR0
      - 270 # GPTMR1
      - 271 # GPTMR2
      - 272 # GPTMR3
      - 273 # I2C0
      - 274 # I2C1
      - 275 # I2C2
      - 276 # I2C3
      - 277 # SPI0
      - 278 # SPI1
      - 279 # SPI2
      - 280 # SPI3
      - 281 # UART0
      - 282 # UART1
      - 283 # UART2
      - 284 # UART3
      - 285 # UART4
      - 286 # UART5
      - 287 # UART6
      - 288 # UART7
      - 291 # MBX0
      - 292 # TSNS
      - 293 # CRC0
      - 294 # ADC0
      - 295 # ADC1
      - 296 # DAC0
      - 297 # DAC1
      - 298 # ACMP
      - 299 # OPAMP0
      - 300 # OPAMP1
      - 301 # MOT0
      - 302 # RNG0
      - 303 # SDP0
      - 305 # GPIO
      - 306 # HDMA
      - 308 # USB0
    description: |
      SYSCTL resource index. Use the HPMICRO_POWER_DOMAIN_* constants from
      dt-bindings/power/hpmicro-hpm5300-power.h.

  "#power-domain-cells":
    const: 0
```

## dts/bindings/ptp_clock/hpmicro,hpm-ptpc-controller.yaml
```yaml
# Copyright (c) 2026 The HPM Zephyr Module Contributors
# SPDX-License-Identifier: Apache-2.0

description: |
  HPMicro PTPC timestamp controller. The controller owns the shared register
  block and clock; each child is an independent timestamp counter.

compatible: "hpmicro,hpm-ptpc-controller"

include: base.yaml

properties:
  reg:
    required: true

  clocks:
    required: true

  clock-names:
    required: true

  "#address-cells":
    const: 1

  "#size-cells":
    const: 0
```

## dts/bindings/ptp_clock/hpmicro,hpm-ptpc.yaml
```yaml
# Copyright (c) 2026 The HPM Zephyr Module Contributors
# SPDX-License-Identifier: Apache-2.0

description: HPMicro PTPC timestamp counter

compatible: "hpmicro,hpm-ptpc"

include: base.yaml

properties:
  reg:
    required: true
    description: Timestamp counter index (0 or 1).

  interrupts:
    required: true
```

## dts/bindings/pwm/hpmicro,hpm-pwm.yaml
```yaml
# Copyright (c) 2026 The HPM Zephyr Module Contributors
# SPDX-License-Identifier: Apache-2.0

description: HPMicro PWM controller

compatible: "hpmicro,hpm-pwm"

include: [base.yaml, pwm-controller.yaml, pinctrl-device.yaml]

properties:
  reg:
    required: true

  interrupts:
    required: true

  clocks:
    required: true

  clock-names:
    required: true

  "#pwm-cells":
    const: 3

pwm-cells:
  - channel
  - period
  - flags
```

## dts/bindings/reset/hpmicro,hpm-sysctl.yaml
```yaml
# Copyright (c) 2026 The HPM Zephyr Module Contributors
# SPDX-License-Identifier: Apache-2.0

description: |
  HPMicro SYSCTL reset controller.

  SYSCTL exposes two reset domains, SoC and CPU0. Asserting either domain
  resets the running system. The reset IDs are defined in
  dt-bindings/reset/hpmicro-hpm5300-reset.h.

compatible: "hpmicro,hpm-sysctl"

include: [base.yaml, reset-controller.yaml]

properties:
  reg:
    required: true

  "#reset-cells":
    const: 1

reset-cells:
  - id
```

## dts/bindings/rng/hpmicro,hpm-rng.yaml
```yaml
# Copyright (c) 2026 The HPM Zephyr Module Contributors
# SPDX-License-Identifier: Apache-2.0

description: HPMicro random number generator

compatible: "hpmicro,hpm-rng"

include: base.yaml

properties:
  reg:
    required: true

  interrupts:
    required: true

  clocks:
    required: true

  clock-names:
    required: true

  self-test:
    type: boolean
    description: Run the RNG self-test during device initialization.
```

## dts/bindings/sensor/hpmicro,hpm-tsns.yaml
```yaml
# Copyright (c) 2026 The HPM Zephyr Module Contributors
# SPDX-License-Identifier: Apache-2.0

description: HPMicro temperature sensor

compatible: "hpmicro,hpm-tsns"

include: sensor-device.yaml

properties:
  reg:
    required: true

  clocks:
    required: true

  clock-names:
    required: true

  averaging:
    type: int
    enum: [0, 1, 2, 3, 4, 5, 6, 7]
    default: 3
    description: |
      Number of samples averaged, expressed as log2(averages). Value 0
      measures once and value 7 averages up to 128 samples.

  measurement-speed:
    type: int
    default: 96
    description: |
      Step duration in 24 MHz clock cycles. Valid hardware values are 24-255.

  sample-interval-cycles:
    type: int
    default: 0
    description: |
      Continuous-mode sample interval and sample validity period in 24 MHz
      clock cycles. Zero keeps the hardware reset value.
```

## dts/bindings/serial/hpmicro,hpm-uart.yaml
```yaml
# Copyright (c) 2022-2026 HPMicro
# SPDX-License-Identifier: Apache-2.0

description: HPMicro UART

compatible: "hpmicro,hpm-uart"

include: [uart-controller.yaml, pinctrl-device.yaml]

properties:
  reg:
    required: true

  interrupts:
    required: true

  clock-name:
    type: int
    description: HPM SDK clock resource identifier

  clock-src:
    type: int
    description: UART clock source selector

  dmas:
    description: Optional TX and RX DMA specifiers.

  dma-names:
    description: Required when dmas is present; use rx and tx.
```

## dts/bindings/smbus/hpmicro,hpm-smbus.yaml
```yaml
# Copyright (c) 2026 The HPM Zephyr Module Contributors
# SPDX-License-Identifier: Apache-2.0

description: HPMicro SMBus controller layered on the I2C peripheral

compatible: "hpmicro,hpm-smbus"

include: [smbus-controller.yaml]

properties:
  i2c:
    type: phandle
    required: true
    description: I2C controller implementing the same physical bus
```

## dts/bindings/spi/hpmicro,hpm-spi.yaml
```yaml
# Copyright (c) 2026 The HPM Zephyr Module Contributors
# SPDX-License-Identifier: Apache-2.0

description: HPMicro SPI controller

compatible: "hpmicro,hpm-spi"

include: [spi-controller.yaml, pinctrl-device.yaml]

properties:
  reg:
    required: true

  interrupts:
    required: true

  clocks:
    required: true

  clock-names:
    required: true

  clock-name:
    type: int
    required: true
    description: HPM SDK clock resource identifier

  clock-src:
    type: int
    required: true
    description: SPI clock source selector
```

## dts/bindings/usb/hpmicro,hpm-usb.yaml
```yaml
# Copyright (c) 2026 The HPM Zephyr Module Contributors
# SPDX-License-Identifier: Apache-2.0

description: HPMicro USB controller

compatible: "hpmicro,hpm-usb"

include: [usb-controller.yaml, pinctrl-device.yaml]

properties:
  reg:
    required: true

  interrupts:
    required: true

  clocks:
    required: true

  clock-names:
    required: true

  clock-name:
    type: int
    required: true
    description: HPM SDK clock resource identifier

  num-bidir-endpoints:
    type: int
    required: true
    description: Number of bidirectional USB endpoints.

  hpmicro,power-control-active-high:
    type: boolean
    description: |
      Select active-high polarity for the USB0 power-control output. The
      HPM5300EVK uses an active-high USB0_PWR signal.
```

## dts/bindings/watchdog/hpmicro,hpm-ewdg.yaml
```yaml
# Copyright (c) 2026 The HPM Zephyr Module Contributors
# SPDX-License-Identifier: Apache-2.0

description: HPMicro enhanced watchdog

compatible: "hpmicro,hpm-ewdg"

include: base.yaml

properties:
  reg:
    required: true

  interrupts:
    required: true

  clocks:
    required: true

  clock-names:
    required: true
```

## modules/hpm_sdk/Kconfig
```kconfig
# Copyright (c) 2024-2026 HPMicro
# SPDX-License-Identifier: Apache-2.0

config ZEPHYR_HPM_SDK_MODULE
	bool

config NDEBUG_CONSOLE
	bool "HPM SDK no console"

config HAS_HPMSDK_UART
	bool
config HAS_HPMSDK_I2C
	bool
config HAS_HPMSDK_GPIO
	bool
config HAS_HPMSDK_SPI
	bool
config HAS_HPMSDK_DMA
	bool
config HAS_HPMSDK_DMAV2
	bool
config HAS_HPMSDK_GPTMR
	bool
config HAS_HPMSDK_PWM
	bool
config HAS_HPMSDK_PWMV2
	bool
config HAS_HPMSDK_PLLCTL
	bool
config HAS_HPMSDK_PLLCTLV2
	bool
config HAS_HPMSDK_USB
	bool
config HAS_HPMSDK_CAN
	bool
config HAS_HPMSDK_MCAN
	bool
config HAS_HPMSDK_ADC12
	bool
config HAS_HPMSDK_ADC16
	bool
config HAS_HPMSDK_PCFG
	bool
config HAS_HPMSDK_PMP
	bool
config HAS_HPMSDK_PINCTRL
	bool
config HAS_HPMSDK_MCHTMR
	bool
```

## soc/hpmicro/HPM5300/Kconfig.defconfig.series
```kconfig
# Copyright (c) 2026 The HPM Zephyr Module Contributors
# SPDX-License-Identifier: Apache-2.0

if SOC_SERIES_HPM5300

config SOC_SERIES
	default "hpm5300"

config SYS_CLOCK_HW_CYCLES_PER_SEC
	default 24000000

config KERNEL_ENTRY
	default "_start"

config ICACHE
	default y

config DCACHE
	default y

config RISCV_SOC_INTERRUPT_INIT
	default y

config 2ND_LVL_ISR_TBL_OFFSET
	default 12

config 2ND_LVL_INTR_00_OFFSET
	default 11

config MAX_IRQ_PER_AGGREGATOR
	default 128

config NUM_IRQS
	default 140

config CACHE_MANAGEMENT
	default y

config CACHE_ANDES_INIT_PRIORITY
	default 60

choice CACHE_TYPE
	default EXTERNAL_CACHE
endchoice

endif # SOC_SERIES_HPM5300
```

## soc/hpmicro/Kconfig
```kconfig
# Copyright (c) 2026 The HPM Zephyr Module Contributors
# SPDX-License-Identifier: Apache-2.0

if SOC_FAMILY_HPM

rsource "hpm5300/Kconfig"

endif # SOC_FAMILY_HPM
```
