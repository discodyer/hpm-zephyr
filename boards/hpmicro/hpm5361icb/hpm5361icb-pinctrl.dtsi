/*
 * Copyright (c) 2026 The HPM Zephyr Module Contributors
 * SPDX-License-Identifier: Apache-2.0
 */

/* HPM5361ICB carries the LQFP100 HPM5361ICB1 package. */
#include <hpmicro/hpm5361-icb-pinctrl.dtsi>
