## CMakeLists.txt
```
# SPDX-License-Identifier: Apache-2.0

cmake_minimum_required(VERSION 3.20.0)
if(NOT DEFINED EXTRA_CONF_FILE)
  set(EXTRA_CONF_FILE profiles/core.conf CACHE STRING "Hardware acceptance configuration")
endif()
if(NOT DEFINED DTC_OVERLAY_FILE)
  set(DTC_OVERLAY_FILE profiles/core.overlay CACHE STRING "Hardware acceptance overlay")
endif()
find_package(Zephyr REQUIRED HINTS $ENV{ZEPHYR_BASE})
project(hpm5361_hardware_acceptance)
target_sources(app PRIVATE src/main.c)
foreach(profile core counter_capture reset_hwinfo power_domain dma flash watchdog can ptpc motor gpio
		uart lin i2c spi analog front_end pwm qei)
  string(TOUPPER ${profile} symbol)
  target_sources_ifdef(CONFIG_HPM_TEST_${symbol} app PRIVATE src/${profile}.c)
endforeach()

target_sources_ifdef(CONFIG_HPM_TEST_UART_ADDRESS app PRIVATE src/uart_address.c)
target_sources_ifdef(CONFIG_HPM_TEST_UART_RS485 app PRIVATE src/uart_rs485.c)
target_sources_ifdef(CONFIG_HPM_TEST_I2C_FAST app PRIVATE src/i2c.c)
target_sources_ifdef(CONFIG_HPM_TEST_I2C_FAST_PLUS app PRIVATE src/i2c.c)
target_sources_ifdef(CONFIG_HPM_TEST_QEI_PD app PRIVATE src/qei_pd.c)
target_sources_ifdef(CONFIG_HPM_TEST_QEI_UD app PRIVATE src/qei_ud.c)
target_sources_ifdef(CONFIG_HPM_TEST_QEI_SINGLE app PRIVATE src/qei_single.c)
target_sources_ifdef(CONFIG_HPM_TEST_QEI_UVW app PRIVATE src/qei_uvw.c)
target_sources_ifdef(CONFIG_HPM_TEST_USB_DEVICE app PRIVATE src/usb_device.c)
target_sources_ifdef(CONFIG_HPM_TEST_USB_ENDPOINTS app PRIVATE src/usb_endpoints.c)
target_sources_ifdef(CONFIG_HPM_TEST_USB_HOST app PRIVATE src/usb_host.c)
target_sources_ifdef(CONFIG_HPM_TEST_USB_HOST_HID_REPORT app PRIVATE src/usb_host_hid_report.c)

if(CONFIG_HPM_TEST_USB_HOST OR CONFIG_HPM_TEST_USB_HOST_HID_REPORT)
  target_include_directories(app PRIVATE ${ZEPHYR_BASE}/subsys/usb/host)
endif()

if(CONFIG_HPM_TEST_CRYPTO)
  target_sources(app PRIVATE ../hpm5300evk/src/crypto.c)
endif()
```

## Kconfig
```
# SPDX-License-Identifier: Apache-2.0

mainmenu "HPM5361 hardware acceptance"

choice HPM_TEST_PROFILE
	prompt "Isolated acceptance profile"
	default HPM_TEST_CORE

config HPM_TEST_CORE
	bool "core"

config HPM_TEST_COUNTER_CAPTURE
	bool "GPTMR input capture"
	help
	  Verify the standard counter capture API using GPTMR0 channel 0.
	  GPIO PB07 drives GPTMR0_CAPT_0 on PB06 with rising, falling,
	  both-edge, continuous and single-shot cases.

config HPM_TEST_RESET_HWINFO
	bool "reset controller and hwinfo"
	help
	  Verify SYSCTL reset-domain status and argument validation together
	  with the standard hwinfo device-ID and reset-cause APIs. The profile
	  does not execute destructive reset-controller operations.

config HPM_TEST_POWER_DOMAIN
	bool "power domain"
	help
	  Verify the standard device power-domain and runtime-PM APIs using
	  CRC0 as a recoverable SYSCTL resource. Two test consumers validate
	  child notifications, reference counting, state transitions and
	  force-on/force-off readback without external wiring.

config HPM_TEST_DMA
	bool "dma"

config HPM_TEST_CRYPTO
	bool "crypto"

config HPM_TEST_FLASH
	bool "flash"
	help
	  Erase and program the dedicated XPI NOR scratch partition, then
	  verify readback and cache visibility through the XIP mapping.

config HPM_TEST_WATCHDOG
	bool "watchdog"
	help
	  Verify watchdog feeding and timeout callbacks without resetting
	  the board, using the EWDG0 interrupt-only mode.

config HPM_TEST_CAN
	bool "can"
	help
	  Verify classic CAN, CAN FD and PTPC timestamps using internal MCAN0
	  loopback, without requiring an external CAN bus.

config HPM_TEST_PTPC
	bool "PTPC clock, PPS and rate adjustment"
	help
	  Verify both PTPC timestamp channels, shared interrupt dispatch, PPS
	  events, time adjustment and rate adjustment without external wiring.
	  The profile also checks counter initialization from reset and per-channel
	  callback dispatch.

config HPM_TEST_MOTOR
	bool "motor"
	help
	  Verify internal SYNT, PLB, QEO, MMC and GPIOM operations without
	  requiring external motor-control hardware.

config HPM_TEST_GPIO
	bool "gpio"
	help
	  Verify GPIO levels, raw port operations and edge interrupts using
	  an external jumper between the fixture output and input pins.

config HPM_TEST_UART
	bool "uart"
	help
	  Verify UART1 asynchronous DMA transfers and RTS/CTS flow control
	  using external data and flow-control loopback jumpers.

config HPM_TEST_LIN
	bool "LIN"
	help
	  Verify the standard LIN commander/responder API, both checksum
	  modes, header filtering, receive timeout and wakeup generation.
	  The fixture connects UART1 and UART2 directly at TTL level.

config HPM_TEST_UART_ADDRESS
	bool "UART address matching"
	help
	  Verify HPM UART nine-bit address matching using cross-connected
	  UART1 and UART2, including rejection of non-matching addresses.

config HPM_TEST_UART_RS485
	bool "UART RS-485 DE timing"
	help
	  Verify that the UART1 auto-DE output surrounds a complete TX burst and
	  returns low after the final stop bit.

config HPM_TEST_I2C
	bool "i2c"
	help
	  Verify I2C0 controller transfers against an I2C1 target, including
	  7/10-bit addressing, repeated START, SMBus data/PEC and SCL/SDA bus
	  recovery using external loopback wires.

config HPM_TEST_I2C_FAST
	bool "i2c fast mode"
	help
	  Run the I2C0/I2C1 acceptance suite at 400 kHz with the target
	  configured for Fast-mode timing.

config HPM_TEST_I2C_FAST_PLUS
	bool "i2c fast-plus mode"
	help
	  Run the I2C0/I2C1 acceptance suite at 1 MHz with the target
	  configured for Fast-mode Plus timing.

config HPM_TEST_SPI
	bool "spi"
	help
	  Verify SPI1 synchronous and asynchronous DMA transfers in all four
	  modes using an external MOSI-to-MISO loopback wire.

config HPM_TEST_ANALOG
	bool "analog"
	help
	  Enable the analog hardware test for DAC0 output, ADC0 synchronous and
	  asynchronous conversion, preemption DMA, and TRGM-triggered conversion over
	  an external loopback wire.

config HPM_TEST_FRONT_END
	bool "analog front end"
	help
	  Verify the OPAMP0 voltage follower and ACMP1 threshold interrupts
	  using DAC0 output and external signal loopback wires.

config HPM_TEST_PWM
	bool "PWM output and capture"
	help
	  Verify PWM0 output with PWM1 input capture and GPIO readback over
	  external signal loopback wires.

config HPM_TEST_QEI
	bool "Quadrature encoder"
	help
	  Verify QEIV2 digital counts, rotation and comparator callbacks using
	  GPIO-generated A/B quadrature signals over external loopback wires.

config HPM_TEST_QEI_PD
	bool "Pulse/direction encoder"
	help
	  Verify QEIV2 pulse/direction decoding with GPIO-generated pulse and
	  direction signals over external loopback wires.

config HPM_TEST_QEI_UD
	bool "Up/down encoder"
	help
	  Verify QEIV2 up/down decoding with independent GPIO-generated up and
	  down pulse signals over external loopback wires.

config HPM_TEST_QEI_SINGLE
	bool "Single-phase encoder"
	help
	  Verify QEIV2 single-phase decoding using a GPIO-generated pulse
	  train over an external loopback wire.

config HPM_TEST_QEI_UVW
	bool "UVW encoder"
	help
	  Verify QEIV2 UVW decoding with GPIO-generated three-phase U, V and W
	  signals over external loopback wires.

config HPM_TEST_USB_DEVICE
	bool "USB device CDC ACM"
	help
	  Verify USB0 enumeration and CDC ACM data transfers using the board's
	  USB OTG connector and a host running the hardware test peer script.

config HPM_TEST_USB_ENDPOINTS
	bool "USB device endpoint matrix"
	help
	  Verify every non-control USB0 IN/OUT endpoint with checked bulk data
	  and a host running the endpoint peer script.

config HPM_TEST_USB_HOST
	bool "USB host boot keyboard"
	help
	  Verify USB0 host enumeration, HID control requests and interrupt-IN
	  reports using a USB boot keyboard connected through an OTG adapter.

config HPM_TEST_USB_HOST_HID_REPORT
	bool "USB host HID report protocol"
	help
	  Verify USB0 host HID report-descriptor retrieval and interrupt-IN
	  traffic while a boot-capable keyboard operates in report protocol.

endchoice

config HPM_TEST_USB_HOST_HUB
	bool "USB host external hub"
	depends on HPM_TEST_USB_HOST
	help
	  Require the boot keyboard to be connected through an external
	  high-speed USB hub and validate the downstream low-speed split path.
	  The test also checks the Hub parent relationship and negotiated speeds
	  so that a directly connected keyboard cannot satisfy the profile.

source "Kconfig.zephyr"
```

## prj.conf
```kconfig
# SPDX-License-Identifier: Apache-2.0

CONFIG_ZTEST=y
CONFIG_SERIAL=y
CONFIG_CONSOLE=y
CONFIG_UART_CONSOLE=y
CONFIG_GPIO=y
CONFIG_PINCTRL=y
CONFIG_CLOCK_CONTROL=y
CONFIG_XIP=y
CONFIG_FLASH=n
CONFIG_USE_DT_CODE_PARTITION=y
CONFIG_MAIN_STACK_SIZE=4096
CONFIG_TEST_EXTRA_STACK_SIZE=2048
CONFIG_TEST_RANDOM_GENERATOR=n
```

## dts/bindings/hpmicro,hardware-test.yaml
```yaml
# SPDX-License-Identifier: Apache-2.0

description: Pin and GPIO resources used by the HPM hardware acceptance application
compatible: "hpmicro,hardware-test"
include: [base.yaml, pinctrl-device.yaml]
properties:
  out-gpios:
    type: phandle-array
  in-gpios:
    type: phandle-array
  a-gpios:
    type: phandle-array
  b-gpios:
    type: phandle-array
  z-gpios:
    type: phandle-array
  de-gpios:
    type: phandle-array
  tx-gpios:
    type: phandle-array
  scl-gpios:
    type: phandle-array
  sda-gpios:
    type: phandle-array
```

## dts/bindings/hpmicro,power-domain-test-consumer.yaml
```yaml
# Copyright (c) 2026 The HPM Zephyr Module Contributors
# Copyright (c) 2026 Cody Gu <gujiaqi@iscas.ac.cn>
# SPDX-License-Identifier: Apache-2.0

description: HPMicro power-domain API test consumer.

compatible: "hpmicro,power-domain-test-consumer"

include: base.yaml
```

## src/main.c
```c
/* SPDX-License-Identifier: Apache-2.0 */

#include <zephyr/ztest.h>

BUILD_ASSERT(IS_ENABLED(CONFIG_XIP), "Acceptance images must retain the XIP layout");
BUILD_ASSERT(IS_ENABLED(CONFIG_DCACHE), "Keep data cache enabled for DMA/cache acceptance");
BUILD_ASSERT(IS_ENABLED(CONFIG_PMP_DATA_EXECUTION_PREVENTION), "Retain PMP protection");
#if !defined(CONFIG_HPM_TEST_FLASH)
BUILD_ASSERT(!IS_ENABLED(CONFIG_FLASH), "Keep BootROM flash calls in the flash profile");
#endif

#if defined(CONFIG_HPM_TEST_UART)
BUILD_ASSERT(IS_ENABLED(CONFIG_UART_ASYNC_API), "UART profile requires async API");
#endif
#if defined(CONFIG_HPM_TEST_SPI)
BUILD_ASSERT(IS_ENABLED(CONFIG_SPI_HPMICRO_DMA), "SPI profile must exercise DMA");
#endif
#if defined(CONFIG_HPM_TEST_I2C) || defined(CONFIG_HPM_TEST_I2C_FAST) ||                           \
	defined(CONFIG_HPM_TEST_I2C_FAST_PLUS)
BUILD_ASSERT(IS_ENABLED(CONFIG_I2C_HPMICRO_DMA), "I2C profile must exercise DMA");
#endif
#if defined(CONFIG_HPM_TEST_ANALOG)
BUILD_ASSERT(IS_ENABLED(CONFIG_ADC_HPMICRO_ADC16_SEQUENCE_DMA), "Require ADC sequence DMA");
#endif

#if defined(CONFIG_HPM_TEST_CRYPTO)
/* Reuse the SDK-independent known-answer vectors from the build-only suite. */
ZTEST_SUITE(hpm5300evk, NULL, NULL, NULL, NULL, NULL);
#endif
```

## src/analog.c
```c
/* SPDX-License-Identifier: Apache-2.0 */

#include <zephyr/drivers/adc.h>
#include <zephyr/drivers/dac.h>
#include <zephyr/linker/section_tags.h>
#include <zephyr/ztest.h>
#include <drivers/adc/hpmicro_adc16.h>
#include <drivers/dac/hpmicro_dac.h>
#include <drivers/mux/hpmicro_trgm.h>

#define ADC_CHANNEL      13
#define ANALOG_TOLERANCE 160
static const struct device *const adc = DEVICE_DT_GET(DT_NODELABEL(adc0));
static const struct device *const dac = DEVICE_DT_GET(DT_NODELABEL(dac0));
static uint16_t samples[8];
static struct k_poll_signal sample_signal;
static struct adc_sequence sample_sequence;
static struct k_poll_signal external_signal;
static struct adc_sequence external_sequence;
static const struct device *const trgm = DEVICE_DT_GET(DT_NODELABEL(trgm0));
static uint32_t wave0[32] __nocache __aligned(32);
static uint32_t wave1[32] __nocache __aligned(32);

static void analog_before(void *fixture)
{
	const struct adc_channel_cfg adc_config = {
		.gain = ADC_GAIN_1,
		.reference = ADC_REF_INTERNAL,
		.acquisition_time = ADC_ACQ_TIME_DEFAULT,
		.channel_id = ADC_CHANNEL,
	};
	const struct adc_channel_cfg dac_feedback_config = {
		.gain = ADC_GAIN_1,
		.reference = ADC_REF_INTERNAL,
		.acquisition_time = ADC_ACQ_TIME_DEFAULT,
		.channel_id = 11,
	};
	const struct dac_channel_cfg dac_config = {.channel_id = 0, .resolution = 12};

	ARG_UNUSED(fixture);
	zassert_true(device_is_ready(adc));
	zassert_true(device_is_ready(dac));
	zassert_ok(adc_channel_setup(adc, &adc_config));
	zassert_ok(adc_channel_setup(adc, &dac_feedback_config));
	zassert_ok(dac_channel_setup(dac, &dac_config));
}

static void analog_after(void *fixture)
{
	const struct hpm_trgm_output_config disconnected = {0};

	ARG_UNUSED(fixture);
	(void)hpm_trgm_configure_output(trgm, HPM_TRGM_OUTPUT_ADC0_STRGI, &disconnected);
	(void)hpm_adc16_stop_preemption(adc);
	(void)hpm_adc16_set_trigger_source(adc, HPM_ADC16_TRIGGER_SOFTWARE);
	(void)hpm_dac_set_mode(dac, 0, HPM_DAC_MODE_DIRECT);
	(void)dac_write_value(dac, 0, 0);
}

static void check_voltage(uint16_t expected, bool asynchronous)
{
	sample_sequence = (struct adc_sequence){
		.channels = BIT(ADC_CHANNEL),
		.resolution = 12,
		.buffer_size = sizeof(samples[0]),
	};

	k_msleep(5);
	/* The current driver supports one sequence per request, not extra_samplings. */
	for (size_t i = 0; i < ARRAY_SIZE(samples); ++i) {
		sample_sequence.buffer = &samples[i];
		if (asynchronous) {
			struct k_poll_event event;
			unsigned int signaled;
			int result;

			k_poll_signal_init(&sample_signal);
			k_poll_event_init(&event, K_POLL_TYPE_SIGNAL, K_POLL_MODE_NOTIFY_ONLY,
					  &sample_signal);
			zassert_ok(adc_read_async(adc, &sample_sequence, &sample_signal));
			zassert_ok(k_poll(&event, 1, K_SECONDS(2)), "ADC sequence IRQ/DMA timeout");
			k_poll_signal_check(&sample_signal, &signaled, &result);
			zassert_true(signaled);
			zassert_ok(result, "ADC async sequence failed: %d", result);
		} else {
			int result = adc_read(adc, &sample_sequence);

			zassert_ok(result, "ADC sequence failed: %d", result);
		}
		zassert_within(samples[i], expected, ANALOG_TOLERANCE,
			       "DAC->ADC sample %u: got %u, expected %u; check PB08 -> PB05",
			       (unsigned int)i, samples[i], expected);
	}
}

ZTEST(hpm_analog_loop, test_dac_direct_adc_sync_async_sequence)
{
	const uint16_t values[] = {512, 1024, 2048, 3072, 3584};

	for (size_t i = 0; i < ARRAY_SIZE(values); ++i) {
		zassert_ok(dac_write_value(dac, 0, values[i]));
		check_voltage(values[i], i & 1);
	}
}

ZTEST(hpm_analog_loop, test_z_sequence_after_preemption_multichannel)
{
	struct adc_sequence sequence = {
		.channels = BIT(11) | BIT(ADC_CHANNEL),
		.resolution = 12,
		.buffer = samples,
		.buffer_size = 2U * sizeof(samples[0]),
	};
	const uint16_t expected = 2048;

	zassert_ok(dac_write_value(dac, 0, expected));
	zassert_ok(adc_read(adc, &sequence));
	zassert_within(samples[0], expected, ANALOG_TOLERANCE,
		       "ADC IN11 feedback sample %u, expected %u", samples[0], expected);
	zassert_within(samples[1], expected, ANALOG_TOLERANCE,
		       "ADC IN13 feedback sample %u, expected %u", samples[1], expected);
}

ZTEST(hpm_analog_loop, test_dac_step_endpoint)
{
	const struct hpm_dac_step_config config = {
		.direction = HPM_DAC_STEP_UP,
		.round_mode = HPM_DAC_STEP_ONESHOT,
		.start = 1024,
		.end = 2048,
		.step = 1,
	};
	uint32_t status;
	int64_t deadline;

	zassert_ok(hpm_dac_set_mode(dac, 0, HPM_DAC_MODE_STEP));
	zassert_ok(hpm_dac_configure_step(dac, 0, &config));
	zassert_ok(hpm_dac_clear_status(dac, BIT(4)));
	zassert_ok(hpm_dac_trigger_step(dac, 0));
	deadline = k_uptime_get() + 100;
	do {
		zassert_ok(hpm_dac_get_status(dac, &status));
		if ((status & BIT(4)) != 0U) {
			break;
		}
		k_msleep(1);
	} while (k_uptime_get() < deadline);
	zassert_true((status & BIT(4)) != 0U, "DAC step did not complete");
	zassert_ok(hpm_dac_clear_status(dac, BIT(4)));
	check_voltage(config.end, false);
}

ZTEST(hpm_analog_loop, test_dac_buffer_engine)
{
	struct hpm_dac_buffer_config config = {
		.data_mode = HPM_DAC_BUFFER_ONE_POINT,
		.burst = HPM_DAC_BUFFER_BURST_SINGLE,
		.buffer0 = wave0,
		.buffer0_len = ARRAY_SIZE(wave0),
		.buffer1 = wave1,
		.buffer1_len = ARRAY_SIZE(wave1),
	};

	for (size_t i = 0; i < ARRAY_SIZE(wave0); ++i) {
		wave0[i] = 1536;
		wave1[i] = 1536;
	}
	zassert_ok(hpm_dac_set_mode(dac, 0, HPM_DAC_MODE_BUFFER));
	zassert_ok(hpm_dac_configure_buffer(dac, &config));
	zassert_ok(hpm_dac_trigger_buffer(dac));
	check_voltage(1536, true);
}

ZTEST(hpm_analog_loop, test_adc_preemption_dma_result)
{
	const struct hpm_adc16_preemption_config config = {
		.trigger = 0,
		.channel_count = 1,
		.channels = {ADC_CHANNEL},
		.sample_cycle = 20,
	};
	struct hpm_adc16_preemption_result result;
	int ret;
	int64_t deadline;

	zassert_ok(dac_write_value(dac, 0, 2048));
	k_msleep(5);
	zassert_ok(hpm_adc16_configure_preemption(adc, &config));
	zassert_ok(hpm_adc16_trigger_preemption(adc));
	deadline = k_uptime_get() + 1000;
	do {
		ret = hpm_adc16_read_preemption(adc, &result, 1);
		if (ret != -EAGAIN) {
			break;
		}
		k_msleep(1);
	} while (k_uptime_get() < deadline);
	zassert_ok(ret, "ADC preemption failed: %d", ret);
	/* Preemption uses the ADC's native 16-bit conversion scale. */
	zassert_within(result.value, 32768, ANALOG_TOLERANCE * 16);
}

ZTEST(hpm_analog_loop, test_adc_hardware_trigger_via_trgm)
{
	struct hpm_trgm_output_config route = {.source = 0};
	struct k_poll_event event;
	unsigned int signaled;
	int result;

	zassert_ok(dac_write_value(dac, 0, 2048));
	k_msleep(5);
	zassert_ok(hpm_trgm_configure_output(trgm, HPM_TRGM_OUTPUT_ADC0_STRGI, &route));
	zassert_ok(hpm_adc16_set_trigger_source(adc, HPM_ADC16_TRIGGER_EXTERNAL));
	external_sequence = (struct adc_sequence){
		.channels = BIT(ADC_CHANNEL),
		.resolution = 12,
		.buffer = samples,
		.buffer_size = sizeof(samples[0]),
	};
	k_poll_signal_init(&external_signal);
	k_poll_event_init(&event, K_POLL_TYPE_SIGNAL, K_POLL_MODE_NOTIFY_ONLY, &external_signal);
	zassert_ok(adc_read_async(adc, &external_sequence, &external_signal));
	/* An armed ADC must wait for the trigger rather than finish immediately. */
	zassert_equal(k_poll(&event, 1, K_MSEC(5)), -EAGAIN);
	route.source = 1;
	zassert_ok(hpm_trgm_configure_output(trgm, HPM_TRGM_OUTPUT_ADC0_STRGI, &route));
	zassert_ok(k_poll(&event, 1, K_SECONDS(2)), "TRGM rising edge did not trigger ADC");
	k_poll_signal_check(&external_signal, &signaled, &result);
	zassert_true(signaled);
	zassert_ok(result);
	zassert_within(samples[0], 2048, ANALOG_TOLERANCE);
}

ZTEST_SUITE(hpm_analog_loop, NULL, NULL, analog_before, analog_after, NULL);
```

## src/can.c
```c
/* SPDX-License-Identifier: Apache-2.0 */

#include <errno.h>

#include <zephyr/drivers/can.h>
#include <zephyr/drivers/ptp_clock.h>
#include <zephyr/sys/atomic.h>
#include <zephyr/ztest.h>
#include <drivers/can/hpmicro_mcan.h>
#include <drivers/ptp_clock/hpmicro_ptpc.h>

#define CALLBACK_BAD_CONTEXT BIT(0)
#define CALLBACK_BAD_DEVICE  BIT(1)
#define CALLBACK_BAD_USER    BIT(2)
#define CALLBACK_RX_OVERFLOW BIT(3)
#define TSU_64BIT_SLOTS      (HPM_MCAN_TSU_SLOT_COUNT / 2U)

static const struct device *const can = DEVICE_DT_GET(DT_NODELABEL(mcan0));
CAN_MSGQ_DEFINE(received, 4);
static K_SEM_DEFINE(tx_done, 0, 1);
static atomic_t callback_errors;
static atomic_t rx_count;
static atomic_t tx_count;
static int tx_result;
static int filter_id = -1;

static void check_callback(const struct device *dev, void *user_data, const void *expected)
{
	if (!k_is_in_isr()) {
		atomic_or(&callback_errors, CALLBACK_BAD_CONTEXT);
	}
	if (dev != can) {
		atomic_or(&callback_errors, CALLBACK_BAD_DEVICE);
	}
	if (user_data != expected) {
		atomic_or(&callback_errors, CALLBACK_BAD_USER);
	}
}

static void tx_callback(const struct device *dev, int error, void *user_data)
{
	check_callback(dev, user_data, &tx_done);
	tx_result = error;
	atomic_inc(&tx_count);
	k_sem_give(&tx_done);
}

static void rx_callback(const struct device *dev, struct can_frame *frame, void *user_data)
{
	check_callback(dev, user_data, &received);
	atomic_inc(&rx_count);
	if (k_msgq_put(&received, frame, K_NO_WAIT) != 0) {
		atomic_or(&callback_errors, CALLBACK_RX_OVERFLOW);
	}
}

static void can_before(void *fixture)
{
	ARG_UNUSED(fixture);
	zassert_true(device_is_ready(can));
	atomic_clear(&callback_errors);
	atomic_clear(&rx_count);
	atomic_clear(&tx_count);
	k_sem_reset(&tx_done);
	k_msgq_purge(&received);
}

static void can_after(void *fixture)
{
	ARG_UNUSED(fixture);
	(void)can_stop(can);
	if (filter_id >= 0) {
		can_remove_rx_filter(can, filter_id);
		filter_id = -1;
	}
	k_msgq_purge(&received);
	k_sem_reset(&tx_done);
}

static void exchange_frame(const struct can_frame *tx, struct can_frame *rx)
{
	tx_result = -EINPROGRESS;
	zassert_ok(can_send(can, tx, K_SECONDS(1), tx_callback, &tx_done));
	zassert_ok(k_sem_take(&tx_done, K_SECONDS(1)), "MCAN TX completion IRQ timeout");
	zassert_ok(tx_result, "MCAN TX failed");
	zassert_ok(k_msgq_get(&received, rx, K_SECONDS(1)), "MCAN RX interrupt timeout");
	zassert_equal(atomic_get(&callback_errors), 0, "Invalid CAN callback or RX queue overflow");
	zassert_equal(rx->id, tx->id);
	zassert_equal(rx->dlc, tx->dlc);
	zassert_equal(rx->flags & (CAN_FRAME_IDE | CAN_FRAME_RTR | CAN_FRAME_FDF | CAN_FRAME_BRS |
				   CAN_FRAME_ESI),
		      tx->flags);
	zassert_mem_equal(rx->data, tx->data, can_dlc_to_bytes(tx->dlc));
}

static void check_completion_count(unsigned int expected)
{
	struct can_frame extra;

	zassert_equal(k_msgq_get(&received, &extra, K_MSEC(2)), -EAGAIN,
		      "Unexpected extra CAN frame");
	zassert_equal(atomic_get(&rx_count), expected, "Incorrect RX callback count");
	zassert_equal(atomic_get(&tx_count), expected, "Incorrect TX callback count");
	zassert_equal(atomic_get(&callback_errors), 0);
	zassert_ok(can_stop(can));
}

ZTEST(hpm_can_loop, test_classic_and_fd_payloads)
{
	const struct can_filter filter = {.id = 0x536, .mask = CAN_STD_ID_MASK};
	struct can_frame tx = {.id = 0x536, .dlc = 8};
	struct can_frame rx;

	zassert_ok(can_set_mode(can, CAN_MODE_LOOPBACK | CAN_MODE_LISTENONLY | CAN_MODE_FD));
	filter_id = can_add_rx_filter(can, rx_callback, &received, &filter);
	zassert_true(filter_id >= 0);
	zassert_ok(can_start(can));
	for (int n = 0; n < 16; ++n) {
		tx.flags = n & 1 ? CAN_FRAME_FDF | CAN_FRAME_BRS : 0;
		tx.dlc = n & 1 ? 15 : 8;
		size_t size = can_dlc_to_bytes(tx.dlc);

		for (size_t i = 0; i < size; ++i) {
			tx.data[i] = n * 17 + i;
		}
		exchange_frame(&tx, &rx);
	}
	check_completion_count(16);
	printk("MCAN silent loopback: 8 classic 8-byte and 8 FD/BRS 64-byte frames, TX/RX ISR "
	       "OK\n");
}

static uint64_t ptpc_time_ns(const struct net_ptp_time *time)
{
	return time->second * NSEC_PER_SEC + time->nanosecond;
}

ZTEST(hpm_can_loop, test_ptpc_timestamp_capture)
{
	const struct device *ptpc = DEVICE_DT_GET(DT_NODELABEL(ptpc0));
	struct net_ptp_time initial = {.second = 10};
	const struct hpm_mcan_tsu_config config = {
		.timebase = HPM_MCAN_TSU_TIMEBASE_PTPC,
		.timebase_input = HPM_MCAN_TSU_TIMEBASE_INPUT_0,
		.capture_on_sof = true,
		.use_64bit = true,
	};
	const struct can_filter filter = {.id = 0x537, .mask = CAN_STD_ID_MASK};
	struct can_frame tx = {.id = 0x537, .dlc = 1};
	struct can_frame rx;
	uint64_t previous = 0;
	uint32_t seen_slots = 0;
	uint8_t previous_slot = 0;

	zassert_true(device_is_ready(ptpc));
	zassert_ok(ptp_clock_set(ptpc, &initial));
	zassert_ok(hpm_ptpc_configure_tsu_input(ptpc, 0, HPM_PTPC_TSU_INPUT_PTPC0));
	zassert_ok(can_set_mode(can, CAN_MODE_LOOPBACK | CAN_MODE_LISTENONLY));
	zassert_ok(hpm_mcan_configure_tsu(can, &config));
	filter_id = can_add_rx_filter(can, rx_callback, &received, &filter);
	zassert_true(filter_id >= 0);
	zassert_ok(hpm_mcan_set_rx_filter_timestamp(can, filter_id, true));
	zassert_ok(can_start(can));
	for (int i = 0; i < 20; ++i) {
		struct hpm_mcan_tsu_snapshot snapshot;
		struct net_ptp_time before;
		struct net_ptp_time after;
		uint64_t captured_ns;
		uint32_t nanoseconds;

		tx.data[0] = i;
		zassert_ok(ptp_clock_get(ptpc, &before));
		exchange_frame(&tx, &rx);
		zassert_ok(ptp_clock_get(ptpc, &after));
		zassert_ok(hpm_mcan_decode_rx_timestamp(can, rx.timestamp, &snapshot));
		zassert_true(snapshot.timestamp_valid);
		zassert_false(snapshot.timestamp_lost);
		zassert_true(snapshot.is_64bit);
		zassert_true(snapshot.value64 > previous, "TSU timestamp did not advance");
		zassert_true(snapshot.slot < TSU_64BIT_SLOTS, "Invalid 64-bit TSU slot");
		if (i != 0) {
			zassert_equal(snapshot.slot, (previous_slot + 1U) % TSU_64BIT_SLOTS,
				      "TSU slot did not advance or wrap");
		}
		/* PTPC outputs TIMEH seconds and TIMEL nanoseconds to the TSU. */
		nanoseconds = (uint32_t)snapshot.value64;
		zassert_true(nanoseconds < NSEC_PER_SEC, "Invalid PTPC nanosecond field");
		captured_ns = (snapshot.value64 >> 32) * NSEC_PER_SEC + nanoseconds;
		zassert_true(captured_ns >= ptpc_time_ns(&before),
			     "TSU captured before transmission");
		zassert_true(captured_ns <= ptpc_time_ns(&after), "TSU captured after reception");
		seen_slots |= BIT(snapshot.slot);
		printk("MCAN TSU frame %d slot %u: %llu s %u ns, within PTPC send/receive "
		       "interval\n",
		       i, snapshot.slot, (unsigned long long)(snapshot.value64 >> 32), nanoseconds);
		previous = snapshot.value64;
		previous_slot = snapshot.slot;
		k_msleep(1);
	}
	zassert_equal(seen_slots, BIT_MASK(TSU_64BIT_SLOTS), "TSU slots did not wrap");
	check_completion_count(20);
	printk("MCAN PTPC timestamps: 20 frames, all 8 64-bit slots and wrap checked\n");
}

ZTEST_SUITE(hpm_can_loop, NULL, NULL, can_before, can_after, NULL);
```

## src/core.c
```c
/* SPDX-License-Identifier: Apache-2.0 */

#include <string.h>
#include <zephyr/drivers/clock_control.h>
#include <zephyr/drivers/counter.h>
#include <zephyr/drivers/crc.h>
#include <zephyr/drivers/entropy.h>
#include <zephyr/drivers/mbox.h>
#include <zephyr/drivers/otp.h>
#include <zephyr/drivers/ptp_clock.h>
#include <zephyr/drivers/sensor.h>
#include <zephyr/irq_offload.h>
#include <zephyr/ztest.h>
#include <drivers/mux/hpmicro_trgm.h>
#include <drivers/ptp_clock/hpmicro_ptpc.h>

static const struct device *const timer = DEVICE_DT_GET(DT_NODELABEL(gptmr0));
static const struct device *const tsns = DEVICE_DT_GET(DT_NODELABEL(tsns0));
static const struct device *const ptpc = DEVICE_DT_GET(DT_NODELABEL(ptpc0));
static const struct device *const mbx_a = DEVICE_DT_GET(DT_NODELABEL(mbx0a));
static const struct device *const mbx_b = DEVICE_DT_GET(DT_NODELABEL(mbx0b));
static K_SEM_DEFINE(irq_done, 0, 1);
static uint32_t irq_word;
static uint32_t ptpc_events;
static atomic_t top_events;
static int rng_isr_result;
static uint32_t rng_isr_cycles;
static bool rng_in_isr;

static void alarm_cb(const struct device *dev, uint8_t chan, uint32_t ticks, void *data)
{
	ARG_UNUSED(dev);
	ARG_UNUSED(chan);
	ARG_UNUSED(ticks);
	k_sem_give(data);
}

static void top_cb(const struct device *dev, void *data)
{
	ARG_UNUSED(dev);
	atomic_inc((atomic_t *)data);
}

static void mailbox_cb(const struct device *dev, uint32_t chan, void *data, struct mbox_msg *msg)
{
	ARG_UNUSED(dev);
	ARG_UNUSED(chan);
	if (msg != NULL && msg->size == sizeof(irq_word)) {
		memcpy(&irq_word, msg->data, sizeof(irq_word));
		k_sem_give(data);
	}
}

static struct sensor_trigger temp_trigger = {
	.type = SENSOR_TRIG_THRESHOLD,
	.chan = SENSOR_CHAN_DIE_TEMP,
};

static void temperature_cb(const struct device *dev, const struct sensor_trigger *trigger)
{
	ARG_UNUSED(trigger);
	/* Disable before acknowledging a continuously asserted threshold. */
	(void)sensor_trigger_set(dev, &temp_trigger, NULL);
	k_sem_give(&irq_done);
}

static void ptpc_cb(const struct device *dev, uint32_t events, void *data)
{
	ARG_UNUSED(dev);
	ptpc_events = events;
	k_sem_give(data);
}

static void rng_offload(const void *data)
{
	uint8_t buffer[16];
	uint32_t started = k_cycle_get_32();

	rng_in_isr = k_is_in_isr();
	rng_isr_result = entropy_get_entropy_isr(data, buffer, sizeof(buffer), 0);
	rng_isr_cycles = k_cycle_get_32() - started;
}

static void core_after(void *fixture)
{
	ARG_UNUSED(fixture);
	struct counter_top_cfg top_off = {
		.ticks = counter_get_max_top_value(timer),
	};

	(void)counter_cancel_channel_alarm(timer, 0);
	(void)counter_stop(timer);
	(void)counter_set_top_value(timer, &top_off);
	(void)mbox_set_enabled(mbx_a, 0, false);
	(void)mbox_set_enabled(mbx_b, 0, false);
	(void)mbox_register_callback(mbx_a, 0, NULL, NULL);
	(void)mbox_register_callback(mbx_b, 0, NULL, NULL);
	(void)sensor_trigger_set(tsns, &temp_trigger, NULL);
	(void)hpm_ptpc_set_event_callback(ptpc, 0, NULL, NULL);
	struct hpm_ptpc_compare_config disabled = {.enable = false};

	(void)hpm_ptpc_configure_compare(ptpc, &disabled);
	const struct hpm_ptpc_capture_config capture_off = {.edge = HPM_PTPC_CAPTURE_DISABLED};
	const struct hpm_trgm_output_config route_off = {0};

	(void)hpm_ptpc_configure_capture(ptpc, &capture_off);
	(void)hpm_trgm_configure_output(DEVICE_DT_GET(DT_NODELABEL(trgm0)), 46, &route_off);
	k_sem_reset(&irq_done);
}

ZTEST(hpm_core, test_timer_alarm_and_clock_recovery)
{
	const struct device *clk = DEVICE_DT_GET(DT_CLOCKS_CTLR(DT_NODELABEL(gptmr0)));
	clock_control_subsys_t id =
		(clock_control_subsys_t)DT_CLOCKS_CELL(DT_NODELABEL(gptmr0), name);
	struct counter_alarm_cfg alarm = {.callback = alarm_cb, .user_data = &irq_done};
	uint32_t rate;
	uint32_t before;
	uint32_t after;
	int64_t started;
	int wait_ret;

	zassert_true(device_is_ready(timer));
	zassert_ok(counter_stop(timer));
	zassert_ok(clock_control_off(clk, id));
	zassert_ok(clock_control_on(clk, id));
	zassert_ok(clock_control_get_rate(clk, id, &rate));
	zassert_true(rate > 0);
	zassert_ok(counter_start(timer));
	zassert_ok(counter_get_value(timer, &before));
	alarm.ticks = counter_us_to_ticks(timer, 20000);
	started = k_uptime_get();
	zassert_ok(counter_set_channel_alarm(timer, 0, &alarm));
	wait_ret = k_sem_take(&irq_done, K_SECONDS(1));
	if (wait_ret != 0) {
		uint32_t pending = counter_get_pending_int(timer);

		(void)counter_get_value(timer, &after);
		printk("GPTMR alarm diagnostic: before=%u after=%u pending=0x%x\n", before, after,
		       pending);
	}
	zassert_ok(wait_ret, "GPTMR alarm did not interrupt");
	zassert_within(k_uptime_get() - started, 20, 10, "GPTMR/system timer disagreement");
	zassert_ok(counter_get_value(timer, &after));
	zassert_not_equal(before, after);
}

ZTEST(hpm_core, test_counter_top_reload_and_update_flags)
{
	const uint32_t max_top = counter_get_max_top_value(timer);
	const uint32_t top_ticks = counter_us_to_ticks(timer, 2000);
	struct counter_alarm_cfg alarm = {
		.callback = alarm_cb,
		.user_data = &irq_done,
	};
	struct counter_top_cfg top_cfg = {
		.ticks = max_top,
	};
	uint32_t value;

	zassert_true(top_ticks > 1U);
	zassert_ok(counter_stop(timer));
	zassert_ok(counter_set_top_value(timer, &top_cfg));
	zassert_ok(counter_start(timer));

	alarm.ticks = counter_us_to_ticks(timer, 500000);
	zassert_ok(counter_set_channel_alarm(timer, 0, &alarm));
	top_cfg.ticks = max_top / 2U;
	zassert_equal(counter_set_top_value(timer, &top_cfg), -EBUSY,
		      "top update must reject an active alarm");
	zassert_ok(counter_cancel_channel_alarm(timer, 0));
	zassert_ok(counter_stop(timer));

	atomic_clear(&top_events);
	top_cfg = (struct counter_top_cfg){
		.ticks = top_ticks,
		.callback = top_cb,
		.user_data = &top_events,
	};
	zassert_ok(counter_set_top_value(timer, &top_cfg));
	zassert_equal(counter_get_top_value(timer), top_ticks);
	zassert_equal(counter_set_value(timer, top_ticks + 1U), -EINVAL);
	zassert_ok(counter_start(timer));
	k_sleep(K_MSEC(20));
	zassert_true(atomic_get(&top_events) >= 3U, "top callback did not repeat");
	zassert_ok(counter_get_value(timer, &value));
	zassert_true(value <= top_ticks, "counter exceeded configured top");
	zassert_ok(counter_stop(timer));

	zassert_ok(counter_set_value(timer, top_ticks / 4U));
	top_cfg = (struct counter_top_cfg){
		.ticks = top_ticks * 2U,
		.flags = COUNTER_TOP_CFG_DONT_RESET,
	};
	zassert_ok(counter_set_top_value(timer, &top_cfg));
	zassert_ok(counter_get_value(timer, &value));
	zassert_equal(value, top_ticks / 4U, "DONT_RESET readback %u, expected %u", value,
		      top_ticks / 4U);

	zassert_ok(counter_set_value(timer, top_ticks * 2U));
	top_cfg.ticks = top_ticks;
	zassert_equal(counter_set_top_value(timer, &top_cfg), -ETIME,
		      "late DONT_RESET update must report -ETIME");
	top_cfg.flags |= COUNTER_TOP_CFG_RESET_WHEN_LATE;
	zassert_ok(counter_set_top_value(timer, &top_cfg));
	zassert_ok(counter_get_value(timer, &value));
	zassert_equal(value, 0U, "late update did not reset the counter");
	zassert_equal(counter_get_top_value(timer), top_ticks);
}

ZTEST(hpm_core, test_counter_32bit_wrap)
{
	const uint32_t max_top = counter_get_max_top_value(timer);
	const uint32_t delta = counter_us_to_ticks(timer, 5000);
	struct counter_top_cfg top_cfg = {
		.ticks = max_top,
	};
	uint32_t previous;
	uint32_t value;
	uint32_t elapsed;
	int64_t started;
	bool wrapped = false;

	zassert_equal(max_top, UINT32_MAX);
	zassert_true(delta > 1U && delta < max_top / 4U);
	zassert_ok(counter_stop(timer));
	zassert_ok(counter_set_top_value(timer, &top_cfg));
	zassert_ok(counter_set_value(timer, max_top - delta));
	zassert_ok(counter_start(timer));
	zassert_ok(counter_get_value(timer, &previous));
	started = k_uptime_get();

	do {
		zassert_ok(counter_get_value(timer, &value));
		if ((value < previous) && (value < delta * 2U)) {
			wrapped = true;
			break;
		}
		previous = value;
		k_busy_wait(50);
		elapsed = (uint32_t)(k_uptime_get() - started);
	} while (elapsed < 100U);

	zassert_true(wrapped, "GPTMR did not wrap across the 32-bit boundary");
	elapsed = (uint32_t)(k_uptime_get() - started);
	zassert_true(elapsed >= 2U && elapsed <= 50U, "unexpected wrap latency: %u ms", elapsed);
	zassert_true(value < delta * 2U);
	zassert_ok(counter_stop(timer));
}

ZTEST(hpm_core, test_rng_selftest_and_data)
{
	const struct device *dev = DEVICE_DT_GET(DT_NODELABEL(rng));
	uint8_t first[64];
	uint8_t second[64];
	bool varied = false;

	zassert_true(device_is_ready(dev), "RNG initialization/self-test failed");
	zassert_ok(entropy_get_entropy(dev, first, sizeof(first)));
	zassert_ok(entropy_get_entropy(dev, second, sizeof(second)));
	zassert_not_equal(memcmp(first, second, sizeof(first)), 0, "Repeated RNG block");
	for (size_t i = 1; i < sizeof(first); ++i) {
		varied |= first[i] != first[0];
	}
	zassert_true(varied, "Stuck RNG output");
}

ZTEST(hpm_core, test_crc32_streaming_known_answer)
{
	const struct device *dev = DEVICE_DT_GET(DT_NODELABEL(crc0));
	const uint8_t input[] = "123456789";
	struct crc_ctx ctx = {
		.type = CRC32_IEEE,
		.seed = 0xffffffff,
		.polynomial = 0x04c11db7,
		.reversed = CRC_FLAG_REVERSE_INPUT | CRC_FLAG_REVERSE_OUTPUT,
	};
	int first;
	int second;
	int finish;

	zassert_true(device_is_ready(dev));
	zassert_ok(crc_begin(dev, &ctx));
	first = crc_update(dev, &ctx, input, 4);
	second = crc_update(dev, &ctx, input + 4, 5);
	finish = crc_finish(dev, &ctx);
	zassert_ok(first);
	zassert_ok(second);
	zassert_ok(finish);
	zassert_equal(ctx.result, 0xcbf43926, "CRC32/ISO-HDLC vector mismatch");
}

ZTEST(hpm_core, test_rng_nonblocking_isr_budget)
{
	irq_offload(rng_offload, DEVICE_DT_GET(DT_NODELABEL(rng)));
	zassert_true(rng_in_isr);
	zassert_true(rng_isr_result >= 0 && rng_isr_result <= 16);
	zassert_true(k_cyc_to_us_ceil32(rng_isr_cycles) < 500, "Nonblocking RNG blocked in ISR");
}

ZTEST(hpm_core, test_temperature_and_threshold_interrupt)
{
	struct sensor_value value;
	struct sensor_value lower = {.val1 = -50};
	struct sensor_value upper;

	zassert_true(device_is_ready(tsns));
	zassert_ok(sensor_sample_fetch(tsns));
	zassert_ok(sensor_channel_get(tsns, SENSOR_CHAN_DIE_TEMP, &value));
	zassert_true(value.val1 > -40 && value.val1 < 125, "Implausible die temperature");
	printk("TSNS die temperature: %d.%06d C\n", value.val1, value.val2);
	upper = value;
	upper.val1 -= 5;
	/* Deliberately place the upper threshold below the current temperature. */
	zassert_ok(sensor_attr_set(tsns, SENSOR_CHAN_DIE_TEMP, SENSOR_ATTR_LOWER_THRESH, &lower));
	zassert_ok(sensor_attr_set(tsns, SENSOR_CHAN_DIE_TEMP, SENSOR_ATTR_UPPER_THRESH, &upper));
	zassert_ok(sensor_trigger_set(tsns, &temp_trigger, temperature_cb));
	zassert_ok(k_sem_take(&irq_done, K_SECONDS(2)), "TSNS threshold IRQ did not arrive");
}

ZTEST(hpm_core, test_mailbox_bidirectional_order)
{
	zassert_true(device_is_ready(mbx_a));
	zassert_true(device_is_ready(mbx_b));
	for (unsigned int direction = 0; direction < 2; ++direction) {
		const struct device *tx = direction ? mbx_b : mbx_a;
		const struct device *rx = direction ? mbx_a : mbx_b;

		zassert_ok(mbox_register_callback(rx, 0, mailbox_cb, &irq_done));
		zassert_ok(mbox_set_enabled(rx, 0, true));
		for (uint32_t i = 0; i < 32; ++i) {
			uint32_t word = 0xa5360000 | (direction << 8) | i;
			struct mbox_msg msg = {.data = &word, .size = sizeof(word)};

			zassert_ok(mbox_send(tx, 0, &msg));
			zassert_ok(k_sem_take(&irq_done, K_SECONDS(1)), "MBX receive IRQ timeout");
			zassert_equal(irq_word, word, "MBX corruption or ordering error");
		}
		zassert_ok(mbox_set_enabled(rx, 0, false));
	}
}

ZTEST(hpm_core, test_otp_read_only_repeatability)
{
	const struct device *dev = DEVICE_DT_GET(DT_NODELABEL(otp));
	/* Public UUID words 88..91; never print identifiers or read key regions. */
	uint32_t first[4];
	uint32_t second[4];

	zassert_true(device_is_ready(dev));
	zassert_ok(otp_read(dev, 88 * sizeof(uint32_t), first, sizeof(first)));
	zassert_ok(otp_read(dev, 88 * sizeof(uint32_t), second, sizeof(second)));
	zassert_mem_equal(first, second, sizeof(first));
}

ZTEST(hpm_core, test_ptpc_progress_and_compare_irq)
{
	struct net_ptp_time initial = {.second = 10, .nanosecond = 0};
	struct net_ptp_time now;
	struct hpm_ptpc_compare_config compare = {
		.target = {.second = 10, .nanosecond = 100000000},
		.enable = true,
	};

	zassert_true(device_is_ready(ptpc));
	zassert_ok(ptp_clock_set(ptpc, &initial));
	const struct hpm_ptpc_capture_config capture = {
		.edge = HPM_PTPC_CAPTURE_RISING,
		.keep = true,
	};
	/* PTPC compare0 -> TRGM -> PTPC capture0, without an external jumper. */
	const struct hpm_trgm_output_config route = {.source = 4};
	int wait_ret;

	zassert_ok(hpm_trgm_configure_output(DEVICE_DT_GET(DT_NODELABEL(trgm0)), 46, &route));
	zassert_ok(hpm_ptpc_configure_capture(ptpc, &capture));
	zassert_ok(hpm_ptpc_clear_events(ptpc, HPM_PTPC_EVENT_ALL));
	zassert_ok(hpm_ptpc_set_event_callback(ptpc, HPM_PTPC_EVENT_COMPARE, ptpc_cb, &irq_done));
	zassert_ok(hpm_ptpc_configure_compare(ptpc, &compare));
	wait_ret = k_sem_take(&irq_done, K_SECONDS(2));
	if (wait_ret != 0) {
		uint32_t events;

		(void)ptp_clock_get(ptpc, &now);
		(void)hpm_ptpc_get_events(ptpc, &events);
		printk("PTPC diagnostic: time=%u.%09u events=0x%x\n", (uint32_t)now.second,
		       now.nanosecond, events);
	}
	zassert_ok(wait_ret, "PTPC compare IRQ timeout");
	zassert_true(ptpc_events & HPM_PTPC_EVENT_COMPARE);
	zassert_ok(ptp_clock_get(ptpc, &now));
	zassert_equal(now.second, 10);
	zassert_true(now.nanosecond >= 100000000 && now.nanosecond < 300000000);
	zassert_ok(hpm_ptpc_read_capture(ptpc, &now));
	zassert_equal(now.second, compare.target.second);
	zassert_within(now.nanosecond, compare.target.nanosecond, 10000,
		       "PTPC internal capture missed the compare edge");
}

ZTEST_SUITE(hpm_core, NULL, NULL, NULL, core_after, NULL);
```

## src/counter_capture.c
```c
/*
 * Copyright (c) 2026 The HPM Zephyr Module Contributors
 * Copyright (c) 2026 Cody Gu <gujiaqi@iscas.ac.cn>
 * SPDX-License-Identifier: Apache-2.0
 */

#include <string.h>

#include <zephyr/drivers/counter.h>
#include <zephyr/drivers/gpio.h>
#include <zephyr/drivers/pinctrl.h>
#include <zephyr/kernel.h>
#include <zephyr/ztest.h>

#define CAPTURE_CHANNEL    0U
#define CAPTURE_TIMEOUT_MS 100
#define CAPTURE_SETTLE_MS  2

#define CAPTURE_EDGE_FLAGS (COUNTER_CAPTURE_RISING_EDGE | COUNTER_CAPTURE_FALLING_EDGE)

PINCTRL_DT_DEFINE(DT_NODELABEL(hw_fixture));

static const struct device *const timer = DEVICE_DT_GET(DT_NODELABEL(gptmr0));
static const struct gpio_dt_spec trigger = GPIO_DT_SPEC_GET(DT_NODELABEL(hw_fixture), out_gpios);

K_SEM_DEFINE(capture_sem, 0, 1);
static atomic_t capture_count;

static struct {
	const struct device *dev;
	uint8_t channel;
	counter_capture_flags_t flags;
	uint32_t ticks;
} last_capture;

static void capture_cb(const struct device *dev, uint8_t channel, counter_capture_flags_t flags,
		       uint32_t ticks, void *user_data)
{
	ARG_UNUSED(user_data);

	last_capture.dev = dev;
	last_capture.channel = channel;
	last_capture.flags = flags;
	last_capture.ticks = ticks;
	atomic_inc(&capture_count);
	k_sem_give(&capture_sem);
}

static void settle_trigger(int level)
{
	zassert_ok(gpio_pin_set_dt(&trigger, level));
	k_msleep(CAPTURE_SETTLE_MS);
}

static void expect_capture(int level, counter_capture_flags_t flags)
{
	uint32_t before;
	uint32_t after;
	int ret;

	zassert_ok(counter_get_value(timer, &before));
	zassert_ok(gpio_pin_set_dt(&trigger, level));
	ret = k_sem_take(&capture_sem, K_MSEC(CAPTURE_TIMEOUT_MS));
	zassert_ok(ret, "capture callback timeout for level %d", level);
	zassert_ok(counter_get_value(timer, &after));

	zassert_equal(last_capture.dev, timer);
	zassert_equal(last_capture.channel, CAPTURE_CHANNEL);
	zassert_equal(last_capture.flags, flags, "flags 0x%x, expected 0x%x", last_capture.flags,
		      flags);
	zassert_true((last_capture.ticks >= before) && (last_capture.ticks <= after),
		     "capture tick %u outside [%u, %u]", last_capture.ticks, before, after);
}

static void expect_no_capture(void)
{
	zassert_equal(k_sem_take(&capture_sem, K_MSEC(10)), -EAGAIN, "unexpected capture callback");
}

static void start_capture(counter_capture_flags_t flags)
{
	zassert_ok(counter_capture_configure(timer, CAPTURE_CHANNEL, flags, capture_cb, NULL));
	zassert_ok(counter_enable_capture(timer, CAPTURE_CHANNEL));
}

static void stop_capture(void)
{
	zassert_ok(counter_disable_capture(timer, CAPTURE_CHANNEL));
	expect_no_capture();
}

static void capture_before(void *fixture)
{
	ARG_UNUSED(fixture);
	const struct counter_top_cfg top_cfg = {
		.ticks = counter_get_max_top_value(timer),
	};

	zassert_ok(gpio_pin_set_dt(&trigger, 0));
	k_msleep(CAPTURE_SETTLE_MS);
	zassert_ok(counter_stop(timer));
	zassert_ok(counter_disable_capture(timer, CAPTURE_CHANNEL));
	zassert_ok(counter_set_top_value(timer, &top_cfg));
	zassert_ok(counter_reset(timer));
	zassert_ok(counter_start(timer));
	k_sem_reset(&capture_sem);
	atomic_clear(&capture_count);
	memset(&last_capture, 0, sizeof(last_capture));
}

static void capture_after(void *fixture)
{
	ARG_UNUSED(fixture);

	(void)counter_disable_capture(timer, CAPTURE_CHANNEL);
	(void)counter_stop(timer);
	(void)gpio_pin_set_dt(&trigger, 0);
}

static void *capture_setup(void)
{
	zassert_true(device_is_ready(timer));
	zassert_true(gpio_is_ready_dt(&trigger));
	zassert_ok(pinctrl_apply_state(PINCTRL_DT_DEV_CONFIG_GET(DT_NODELABEL(hw_fixture)),
				       PINCTRL_STATE_DEFAULT));
	zassert_ok(gpio_pin_configure_dt(&trigger, GPIO_OUTPUT_INACTIVE));

	return NULL;
}

ZTEST(hpm_counter_capture, test_capture_api_validation)
{
	zassert_equal(counter_capture_configure(timer, CAPTURE_CHANNEL, 0U, capture_cb, NULL),
		      -EINVAL);
	zassert_equal(counter_capture_configure(timer, CAPTURE_CHANNEL, COUNTER_CAPTURE_RISING_EDGE,
						NULL, NULL),
		      -EINVAL);
	zassert_equal(counter_capture_configure(timer, CAPTURE_CHANNEL,
						COUNTER_CAPTURE_RISING_EDGE | BIT(3), capture_cb,
						NULL),
		      -EINVAL);
	zassert_equal(counter_enable_capture(timer, CAPTURE_CHANNEL), -EINVAL);
	zassert_equal(
		counter_capture_configure(timer, 4U, COUNTER_CAPTURE_RISING_EDGE, capture_cb, NULL),
		-ENOTSUP);

	zassert_ok(counter_capture_configure(
		timer, CAPTURE_CHANNEL, COUNTER_CAPTURE_RISING_EDGE | COUNTER_CAPTURE_CONTINUOUS,
		capture_cb, NULL));
	zassert_equal(
		counter_capture_configure(timer, CAPTURE_CHANNEL,
					  COUNTER_CAPTURE_FALLING_EDGE | COUNTER_CAPTURE_CONTINUOUS,
					  capture_cb, NULL),
		-EBUSY);
	zassert_ok(counter_disable_capture(timer, CAPTURE_CHANNEL));
}

ZTEST(hpm_counter_capture, test_rising_edge_continuous)
{
	const counter_capture_flags_t flags =
		COUNTER_CAPTURE_RISING_EDGE | COUNTER_CAPTURE_CONTINUOUS;

	settle_trigger(0);
	start_capture(flags);
	for (uint8_t i = 0U; i < 3U; i++) {
		expect_capture(1, flags);
		settle_trigger(0);
		expect_no_capture();
	}

	stop_capture();
	settle_trigger(1);
	settle_trigger(0);
	expect_no_capture();
	zassert_equal(atomic_get(&capture_count), 3);
}

ZTEST(hpm_counter_capture, test_falling_edge_continuous)
{
	const counter_capture_flags_t flags =
		COUNTER_CAPTURE_FALLING_EDGE | COUNTER_CAPTURE_CONTINUOUS;

	settle_trigger(1);
	start_capture(flags);
	for (uint8_t i = 0U; i < 3U; i++) {
		expect_capture(0, flags);
		settle_trigger(1);
		expect_no_capture();
	}

	stop_capture();
	settle_trigger(0);
	settle_trigger(1);
	expect_no_capture();
	zassert_equal(atomic_get(&capture_count), 3);
}

ZTEST(hpm_counter_capture, test_both_edges_continuous)
{
	const counter_capture_flags_t flags =
		COUNTER_CAPTURE_BOTH_EDGES | COUNTER_CAPTURE_CONTINUOUS;

	settle_trigger(0);
	start_capture(flags);
	for (uint8_t i = 0U; i < 2U; i++) {
		expect_capture(1, flags);
		expect_capture(0, flags);
	}

	stop_capture();
	settle_trigger(1);
	settle_trigger(0);
	expect_no_capture();
	zassert_equal(atomic_get(&capture_count), 4);
}

ZTEST(hpm_counter_capture, test_rising_edge_single_shot)
{
	const counter_capture_flags_t flags =
		COUNTER_CAPTURE_RISING_EDGE | COUNTER_CAPTURE_SINGLE_SHOT;

	settle_trigger(0);
	start_capture(flags);
	expect_capture(1, flags);
	settle_trigger(0);
	settle_trigger(1);
	expect_no_capture();
	zassert_equal(atomic_get(&capture_count), 1);
	zassert_ok(counter_disable_capture(timer, CAPTURE_CHANNEL));
}

ZTEST(hpm_counter_capture, test_falling_edge_single_shot)
{
	const counter_capture_flags_t flags =
		COUNTER_CAPTURE_FALLING_EDGE | COUNTER_CAPTURE_SINGLE_SHOT;

	settle_trigger(1);
	start_capture(flags);
	expect_capture(0, flags);
	settle_trigger(1);
	settle_trigger(0);
	expect_no_capture();
	zassert_equal(atomic_get(&capture_count), 1);
	zassert_ok(counter_disable_capture(timer, CAPTURE_CHANNEL));
}

ZTEST(hpm_counter_capture, test_both_edges_single_shot)
{
	const counter_capture_flags_t flags =
		COUNTER_CAPTURE_BOTH_EDGES | COUNTER_CAPTURE_SINGLE_SHOT;

	settle_trigger(0);
	start_capture(flags);
	expect_capture(1, flags);
	settle_trigger(0);
	settle_trigger(1);
	expect_no_capture();
	zassert_equal(atomic_get(&capture_count), 1);
	zassert_ok(counter_disable_capture(timer, CAPTURE_CHANNEL));
}

ZTEST_SUITE(hpm_counter_capture, NULL, capture_setup, capture_before, capture_after, NULL);
```
