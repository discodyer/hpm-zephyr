/* SPDX-License-Identifier: Apache-2.0 */

&uart1 {
	status = "okay";
	current-speed = <115200>;
	pinctrl-0 = <&pb07_uart1_txd &pb06_uart1_rxd>;
	pinctrl-names = "default";
};

&uart2 {
	status = "okay";
	current-speed = <115200>;
	pinctrl-0 = <&pb08_uart2_txd &pb09_uart2_rxd>;
	pinctrl-names = "default";
};
