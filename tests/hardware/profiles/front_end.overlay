/* SPDX-License-Identifier: Apache-2.0 */

#include <dt-bindings/comparator/hpmicro-acmp.h>

&adc0 {
	status = "okay";
	vref-mv = <3300>;
	pinctrl-0 = <&pb00_analog>;
	pinctrl-names = "default";
};

&dac0 {
	status = "okay";
	pinctrl-0 = <&pb08_analog>;
	pinctrl-names = "default";
};

&acmp1 {
	status = "okay";
	pinctrl-0 = <&pb11_analog>;
	pinctrl-names = "default";
	positive-input = <HPM_ACMP_INPUT_DAC_OUT>;
	negative-input = <HPM_ACMP_INPUT_ANALOG_4>;
	dac-value = <128>;
	hysteresis = <3>;
};

&opamp0 {
	status = "okay";
	pinctrl-0 = <&pb00_analog &pb04_analog>;
	pinctrl-names = "default";
	functional-mode = "follower";
	positive-input = "INP0";
	negative-input = "FLOATING";
	gain = "OPAMP_GAIN_2";
};
